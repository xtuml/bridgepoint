[part 1 of 4: packages /AUTOSAR/Units to /AUTOSAR/SwBaseTypes]
AUTOSAR XML (schema 3.0.2)
# Development Partnership. The AUTOSAR Development Partnership will not be liable
# for any use of this specification. Following the completion of the development
# of the AUTOSAR specifications commercial exploitation licenses will be made
# available to end users by way of written License Agreement only.
# No part of this publication may be reproduced or utilized in any form or by any
# means, electronic or mechanical, including photocopying and microfilm, without
# permission in writing from the publisher." The word AUTOSAR and the AUTOSAR logo
# are registered trademarks.
# Copyright © 2004-2008 AUTOSAR Development Partnership. All rights reserved.
standard types defined: Boolean, SInt16, SInt32, SInt8, UInt16, UInt32, UInt8
package /AUTOSAR/Units
  24 x unit:
    percent: display-name=%  # a percentage is a way of expressing a number as a fraction of 100 (no SI unit).
    percent_per_second: display-name=%/s  # time-derivative of percent
    degree_centigrade: display-name=degC  # temperature, no SI unit, (degC = kelvin - 273.16)
    bar: display-name=bar  # pressure, no SI unit; 1 bar = 100,000 pascals (Pa)
    hertz: display-name=Hz  # SI unit of frequency
    kilogram: display-name=kg  # SI base unit of mass
    kilometer: display-name=km  # length, no SI unit
    meter: display-name=m  # SI base unit of length
    meter_per_second: display-name=m/s  # velocity (derived from SI units)
    meter_per_second_squared: display-name=m/s^2  # acceleration (derived from SI units)
    newton: display-name=N  # SI unit of force
    newton_meter: display-name=Nm  # torque (= kg m^2/s^2) ; (derived from SI units)
    newton_meter_per_second: display-name=Nm/s  # time-derivative of torque
    radian: display-name=rad  # SI unit of measuring plane angle (dimensionless)
    radian_per_second: display-name=rad/s  # angular velocity (derived from SI units)
    radian_per_second_squared: display-name=rad/s^2  # SI unit of angular acceleration
    revolutions_per_minute: display-name=rpm  # revolutions per minute - no SI unit
    rpm_per_second: display-name=rpm/s  # time-derivative of revolutions per minute - no SI unit
    second: display-name=s  # SI base unit of time
    volt: display-name=V  # electric potential difference (derived from SI units)
    hecto_pascal: display-name=hPa  # The pascal (symbol: Pa) is the SI derived unit of pressure or stress (also: Young's modulus and tensile strength). It is equivalent to one newton per square meter. In everyday life, the pascal is perhaps best known from meteorological air-pressure reports, where it occurs in the form of hectopascal (1 hPa = 100 Pa).
    newton_per_meter: display-name=N/m  # surface tension (derived from SI units).
    newton_sec_per_meter: display-name=Ns/m  # damping factor or coefficient (derived from SI units)
    meter_per_second_toPowOf3: display-name=m/s^3  # jerk (derived from SI units), also called jolt (esp. in British English), surge or lurch, is the rate of change of acceleration; more precisely, the derivative of acceleration with respect to time, the second derivative of velocity, or the third derivative of displacement.
package /AUTOSAR/DataTypes
  58 x integer type:
    SInt1: lower-limit=-1, upper-limit=0  # 1 bit signed integer
    SInt10: lower-limit=-512, upper-limit=511  # 10 bit signed integer
    SInt11: lower-limit=-1024, upper-limit=1023  # 11 bit signed integer
    SInt12: lower-limit=-2048, upper-limit=2047  # 12 bit signed integer
    SInt13: lower-limit=-4096, upper-limit=4095  # 13 bit signed integer
    SInt14: lower-limit=-8192, upper-limit=8191  # 14 bit signed integer
    SInt15: lower-limit=-16384, upper-limit=16383  # 15 bit signed integer
    SInt17: lower-limit=-65536, upper-limit=65535  # 17 bit signed integer
    SInt18: lower-limit=-131072, upper-limit=131071  # 18 bit signed integer
    SInt19: lower-limit=-262144, upper-limit=262143  # 19 bit signed integer
    SInt2: lower-limit=-2, upper-limit=1  # 2 bit signed integer
    SInt20: lower-limit=-524288, upper-limit=524287  # 20 bit signed integer
    SInt21: lower-limit=-1048576, upper-limit=1048575  # 21 bit signed integer
    SInt22: lower-limit=-2097152, upper-limit=2097151  # 22 bit signed integer
    SInt23: lower-limit=-4194304, upper-limit=4194303  # 23 bit signed integer
    SInt24: lower-limit=-8388608, upper-limit=8388607  # 24 bit signed integer
    SInt25: lower-limit=-16777216, upper-limit=16777215  # 25 bit signed integer
    SInt26: lower-limit=-33554432, upper-limit=33554431  # 26 bit signed integer
    SInt27: lower-limit=-67108864, upper-limit=67108863  # 27 bit signed integer
    SInt28: lower-limit=-134217728, upper-limit=134217727  # 28 bit signed integer
    SInt29: lower-limit=-268435456, upper-limit=268435455  # 29 bit signed integer
    SInt3: lower-limit=-4, upper-limit=3  # 3 bit signed integer
    SInt30: lower-limit=-536870912, upper-limit=536870911  # 30 bit signed integer
    SInt31: lower-limit=-1073741824, upper-limit=1073741823  # 31 bit signed integer
    SInt4: lower-limit=-8, upper-limit=7  # 4 bit signed integer
    SInt5: lower-limit=-16, upper-limit=15  # 5 bit signed integer
    SInt6: lower-limit=-32, upper-limit=31  # 6 bit signed integer
    SInt7: lower-limit=-64, upper-limit=63  # 7 bit signed integer
    SInt9: lower-limit=-256, upper-limit=255  # 9 bit signed integer
    UInt1: lower-limit=0, upper-limit=1  # 1 bit unsigned integer
    UInt10: lower-limit=0, upper-limit=1023  # 10 bit unsigned integer
    UInt11: lower-limit=0, upper-limit=2047  # 11 bit unsigned integer
    UInt12: lower-limit=0, upper-limit=4095  # 12 bit unsigned integer
    UInt13: lower-limit=0, upper-limit=8191  # 13 bit unsigned integer
    UInt14: lower-limit=0, upper-limit=16383  # 14 bit unsigned integer
    UInt15: lower-limit=0, upper-limit=32767  # 15 bit unsigned integer
    UInt17: lower-limit=0, upper-limit=131071  # 17 bit unsigned integer
    UInt18: lower-limit=0, upper-limit=262143  # 18 bit unsigned integer
    UInt19: lower-limit=0, upper-limit=524287  # 19 bit unsigned integer
    UInt2: lower-limit=0, upper-limit=3  # 2 bit unsigned integer
    UInt20: lower-limit=0, upper-limit=1048575  # 20 bit unsigned integer
    UInt21: lower-limit=0, upper-limit=2097151  # 21 bit unsigned integer
    UInt22: lower-limit=0, upper-limit=4194303  # 22 bit unsigned integer
    UInt23: lower-limit=0, upper-limit=8388607  # 23 bit unsigned integer
    UInt24: lower-limit=0, upper-limit=16777215  # 24 bit unsigned integer
    UInt25: lower-limit=0, upper-limit=33554431  # 25 bit unsigned integer
    UInt26: lower-limit=0, upper-limit=67108863  # 26 bit unsigned integer
    UInt27: lower-limit=0, upper-limit=134217727  # 27 bit unsigned integer
    UInt28: lower-limit=0, upper-limit=268435455  # 28 bit unsigned integer
    UInt29: lower-limit=0, upper-limit=536870911  # 29 bit unsigned integer
    UInt3: lower-limit=0, upper-limit=7  # 3 bit unsigned integer
    UInt30: lower-limit=0, upper-limit=1073741823  # 30 bit unsigned integer
    UInt31: lower-limit=0, upper-limit=2147483647  # 31 bit unsigned integer
    UInt4: lower-limit=0, upper-limit=15  # 4 bit unsigned integer
    UInt5: lower-limit=0, upper-limit=31  # 5 bit unsigned integer
    UInt6: lower-limit=0, upper-limit=63  # 6 bit unsigned integer
    UInt7: lower-limit=0, upper-limit=127  # 7 bit unsigned integer
    UInt9: lower-limit=0, upper-limit=511  # 9 bit unsigned integer
  19 x record type:
    t_StaCentralLocking  # Status of the Central Locking. The status undefined is valid if there are no feedback switches in the latch and the ECU lost the information of actual status
      record element locking_state: type=t_LockingState
      record element trigger_source: type=t_TriggerSource
    t_ReqManAdjustPanel  # Transports atomically which mirror is to be moved at which axis in which direction.
      record element mirror_type: type=t_MirrorType
      record element axis_type: type=t_AxisType
      record element movement_type: type=t_MovementType
    t_ReqAutoAdjustPanelMirror  # Transports atomically a profile and a command
      record element mirror_profile: type=t_StaProfilePerson
      record element operation: type=t_operation
    t_StaMirrorAction  # Transporting feedback from a mirror (identified by mirror_type) regarding its current action being executed (movement_type)
      record element mirror_type: type=t_MirrorType
      record element movement_type: type=t_MovementType
    t_ReqMirrorAutoMove  # Links the profile information with an mirror to support automatic movement
      record element mirror_type: type=t_MirrorType
      record element mirror_profile: type=t_StaProfilePerson
    t_ReqStoreMirrorPos  # The information provided by this record clearly identifies which mirror is to be stroed for a certain profile
      record element mirror_type: type=t_MirrorType
      record element mirror_profile: type=t_StaProfilePerson
    t_MirrorAxisPos  # Represents a position of an axis of a certain mirror. Can be used for status inquiries or for requests.
      record element mirror_type: type=t_MirrorType
      record element axis_type: type=t_AxisType
      record element position: type=t_Position
    t_MirrorAxisMove  # Represents the motion of an axis of a certain mirror. Can be used for status and commands.
      record element mirror_type: type=t_MirrorType
      record element axis_type: type=t_AxisType
      record element movement_type: type=t_MovementType
    t_MirrorPosMemory  # Represents the position of a mirror's axis specific for a profile. Can be used as a request and as a status information.
      4 x record element:
        mirror_type: type=t_MirrorType
        axis_type: type=t_AxisType
        mirror_profile: type=t_StaProfilePerson
        position: type=t_Position
    t_CmdMirrorTinting  # Represents a desired tinting value (in position) for a given mirror.
      record element mirror_type: type=t_MirrorType
      record element position: type=t_Position
    t_CmdBrightness  # Ramp defines a certain &quot;changerate&quot; with which the given percentage value shall be reached (no_ramp means the brightness value shall be effective immediately). A ramp might be chosen in order to avoid that the master component is executed at that rate (e.g. needs very high CPU load) to im-plement a dim curve. The actual ramp times are stored in NVRAM and should be tuneable via diagnostics.
      record element brightness: type=t_promille
      record element ramp: type=t_ramp
    t_AutoAdjust  # Memory button (1..5) Adjust Position {off, store, recall}
      record element memory_button: type=t_MemoryButton
      record element adjust_operation: type=t_operation
    t_SeatMassageProgram  # Defines the seat massage programs which are selected by the user.
      4 x record element, all with type=t_onoff:
        massage_{0..3}
    t_SeatStoragePosition  # Defines a seat storage position of a single axis
      record element seat_profile: type=UInt5
      record element axis_position: type=t_promille
    t_SeatMove  # Auto move data record
      record element seat_profile: type=UInt5
      record element highspeed: type=t_onoff
    t_ActuatorStatus  # Status of a moving actuator
      record element axis_position: type=t_promille
      record element axis_movement: type=t_MovementType
      record element highspeed: type=t_onoff
    t_ReqInfosCentralLocking  # Request for central locking activation
      record element requested_action: type=t_ReqCentralLocking
      record element detection_source: type=t_ReqSourceCentralLocking
    t_auto_front_wiping_request  # This type represents an wiping request for the front windscreen, is-sued automatically by e.g. a rain-sensor.
      record element wiping_mode: type=t_wiping
      record element wiping_immediate: type=t_onoff
    t_date_time  # Represents a point in time.
      6 x record element:
        hour: type=t_date_tm_hour
        minute: type=t_date_tm_minute
        second: type=t_date_tm_second
        day: type=t_date_tm_day
        month: type=t_date_tm_month
        year: type=t_date_tm_year
  integer type t_BatteryVoltage: base-type=UInt8, compu {raw=(0+0,1*phys)/(1) for phys 0..25,2; unit V}, lower-limit=0, upper-limit=252  # It represents the battery voltage level
  integer type t_Position: base-type=UInt14, compu {raw=(0+0,1*phys)/(1) for phys 0..1001; unit %}, lower-limit=0, upper-limit=10010  # It represents a relative position regarding an axis position reference
  integer type t_ReqTintingValue: base-type=UInt7, compu {raw=phys for phys 0..100; unit %}, lower-limit=0, upper-limit=100  # It represents the percentage of tinting value
  integer type t_promille: base-type=UInt10, compu {raw=phys for phys 0..1000; unit %}, lower-limit=0, upper-limit=1000  # t_promille is a percentage to express a number as a fraction of 1000 (no SI unit).
  integer type AR_Percent: base-type=UInt10, compu {raw=(0+0,125*phys)/(1) for phys 0..100; unit %}, lower-limit=0, upper-limit=800  # Generic data type for percentage data
  integer type AR_RPM: base-type=UInt15, compu {raw=(0+0,5*phys)/(1) for phys 0..16383,5; unit rpm}, lower-limit=0, upper-limit=32767  # Rotational speed
  integer type AR_Torque: base-type=SInt16, compu {raw=(0+0,0625*phys)/(1) for phys -2048..2047,9375; unit Nm}, lower-limit=-32768, upper-limit=32767  # Torque (for passenger cars) Use cases: Torque at clutch Torque at crankshaft etc.
  integer type AR_TorqueAtWheel: base-type=SInt22, compu {raw=(0+0,0625*phys)/(1) for phys -131072..131071,9375; unit Nm}, lower-limit=-2097152, upper-limit=2097151  # Generic data type for wheel torques
  integer type Gear: base-type=SInt6, compu {raw=phys for phys -16..16}, lower-limit=-16, upper-limit=16  # This type shows the gear being currently engaged in the gear box. Mapping of physical gear to representation is left open, but according to: Negative values: Reverse gears. (Only for manual transmission: If no information about reverse gears is available then corresponding positive values are used for reverse gears.) Positive values: forward gears; 0 is drive train open (no torque at clutch is transmitted between the running engine(s) and the wheels). Additional Information about Selected Gear you will find in Gear lever position. The use of CVT has to be handled by separate SW-functionalities. Also for CVT 0 is defined as open drive train.
  integer type Temperature2: base-type=SInt13, compu {raw=(0+0,1*phys)/(1) for phys -256..255,9; unit degC}, lower-limit=-2560, upper-limit=2559  # Temperature variant 2 | Second variant of temperature
  integer type Temperature1: base-type=SInt8, compu {raw=(-50+0,5*phys)/(1) for phys -50..75; unit degC}, lower-limit=0, upper-limit=250  # Temperature variant 1 | First variant of temperature
  integer type AR_FactorU14_128: base-type=UInt14, compu {raw=(0+0,0078125*phys)/(1) for phys 0..127,9921875}, lower-limit=0, upper-limit=16383  # Generic data type for factors, range 0 to128
  integer type Percent005: base-type=UInt15, compu {raw=(0+0,005*phys)/(1) for phys 0..100; unit %}, lower-limit=0, upper-limit=20000  # Generic data type for high precision percentage data
  integer type AR_FactorS16_32: base-type=SInt16, compu {raw=(0+0,0009765625*phys)/(1) for phys -32..31,9990234375}, lower-limit=-32768, upper-limit=32767  # Generic data type for factors, range -32 to 32
  integer type AR_Torque_neg: base-type=SInt16, compu {raw=(0+0,0625*phys)/(1) for phys -2048..0; unit Nm}, lower-limit=-32768, upper-limit=0  # Torque (for passenger cars) Use cases: Torque losses
  integer type AR_Torque_pos: base-type=UInt15, compu {raw=(0+0,0625*phys)/(1) for phys 0..2047,9375; unit Nm}, lower-limit=0, upper-limit=32767  # Torque (for passenger cars) Use cases: Inner engine torque
  integer type AbsoluteEstimatedBodyPitchAngle: base-type=SInt11, compu {raw=(0+0,0009765625*phys)/(1) for phys -0,5..0,5; unit rad}, lower-limit=-512, upper-limit=512  # Estimation of the absolute pitch angle of the vehicle body. Same range for pitch and roll.
  integer type AbsoluteEstimatedBodyRollAngle: base-type=SInt11, compu {raw=(0+0,0009765625*phys)/(1) for phys -0,5..0,5; unit rad}, lower-limit=-512, upper-limit=512  # Estimation of the absolute roll angle of the vehicle body. Same range for pitch and roll.
  integer type AbsoluteMeasuredBodyRollAngleBase: base-type=SInt12, compu {raw=(0+0,00098*phys)/(1) for phys -1,5..1,5; unit rad}, lower-limit=-1536, upper-limit=1536  # Measured absolute vehicle body roll angle. Same range for pitch and roll for the sake of consistency.
  compu method compu_AbsoluteMeasuredBodyRollA: raw=(0+0,0009765625*phys)/(1) for phys -1,5..1,5; unit rad
  integer type AbsoluteMeasuredBodyRollAngleStandard: base-type=SInt12, compu {raw=(0+0,00098*phys)/(1) for phys -1,5..1,5; unit rad}, lower-limit=-1531, upper-limit=1531  # Measured absolute vehicle body roll angle. Same range for pitch and roll. (Filtered and offset compensated)
  integer type AccelerationRequest: base-type=SInt13, compu {raw=(0+0,0078125*phys)/(1) for phys -18..18; unit m/s^2}, lower-limit=-2304, upper-limit=2304  # Acceleration Request | Acceleration which is desired if obtainable within comfort limits.
  integer type AcceleratorPedalGradient: base-type=SInt15, compu {raw=(0+0,0625*phys)/(1) for phys -1000..1000; unit %/s}, lower-limit=-16000, upper-limit=16000  # time-derivative of AcceleratorPedalRatio
  integer type ActiveSteerMotorAngleFrontBase: base-type=SInt21, compu {raw=(0+0,0009765625*phys)/(1) for phys -870..870; unit rad}, lower-limit=-890880, upper-limit=890880  # measures the angle of the front steering device at the steer motor (for steering angle superposition systems)
  compu method compu_ActiveSteerMotorAngleFron: raw=(0+0,0009765625*phys)/(1) for phys -870..870; unit rad
  integer type ActiveSteerMotorAngleFrontStandard: base-type=SInt21, compu {raw=(0+0,0009765625*phys)/(1) for phys -870..870; unit rad}, lower-limit=-890880, upper-limit=890880  # Conditioned angle of the front steering device at the steer motor (for steering angle superposition systems) (Filtered and Offset corrected)
  integer type ActiveSteerMotorAngleSpeedFrontStandard: base-type=SInt21, compu {raw=(0+0,0009765625*phys)/(1) for phys -628..628; unit rad/s}, lower-limit=-643072, upper-limit=643072  # Conditioned derivative of the angular position measured at the front steering device with respect to the motor shaft.
  integer type ActualBrakeYawTorque: base-type=SInt16, compu {raw=phys for phys -20000..20000; unit Nm}, lower-limit=-20000, upper-limit=20000  # Component of the total yaw torque realized by brake actuator BrakeYawTorque is defined as the difference of brake forces from left and right wheels times the track width
  integer type ActualExtYawTorque: base-type=SInt16, compu {raw=phys for phys -20000..20000; unit Nm}, lower-limit=-20000, upper-limit=20000  # Component of the total yaw torque realized by ext yaw rate controller using additional actuators (steering, suspension, ...)
  integer type ActualEstimatedRoadWheelAngleFront: base-type=SInt15, compu {raw=(0+0,0009765625*phys)/(1) for phys -5..5; unit rad/s}, lower-limit=-12870, upper-limit=12870  # Road wheel angle at front steered wheels (e.g. calculated by a relation converter: steer wheel angle - road wheel angle using a characteristic map)
  compu method compu_ActualEstimatedRoadWheelA: raw=(0+0,0001220703125*phys)/(1) for phys -1,571..1,571; unit rad
  integer type ActualEstimatedRoadWheelAngleRear: base-type=SInt15, compu {raw=(0+0,0009765625*phys)/(1) for phys -5..5; unit rad/s}, lower-limit=-12870, upper-limit=12870  # Actual estimated road wheel angle at rear steered wheels
  compu method compu_ActualEstimatedRoadWheelA: raw=(0+0,0001220703125*phys)/(1) for phys -1,571..1,571; unit rad
  integer type ActualRollMomentFront: base-type=SInt16, compu {raw=phys for phys -20000..20000; unit Nm}, lower-limit=-20000, upper-limit=20000  # Estimation of roll moment compensated by the front stabilizer.
  integer type ActualRollMomentRear: base-type=SInt16, compu {raw=phys for phys -20000..20000; unit Nm}, lower-limit=-20000, upper-limit=20000  # Estimation of roll moment compensated by the rear stabilizer.
  integer type BrakeLightsIntensity: base-type=UInt7, compu {raw=phys for phys 0..100; unit %}, lower-limit=0, upper-limit=100  # indicates requested intensity of brake lights 0: no brake light activation 100: full intensity
  integer type DriverSteerTorqueBase: base-type=SInt15, compu {raw=(0+0,00390625*phys)/(1) for phys -32..32; unit Nm}, lower-limit=-8192, upper-limit=8192  # Measured driver steer torque at the column (does not include the wheel inertia effect, some friction between the sensor and the steering wheel, the steering kinematics...) (includes pinion torque sensor for rack drive system and ONLY denotes the driver torque)
  integer type DriverSteerTorqueStandard: base-type=SInt15, compu {raw=(0+0,00390625*phys)/(1) for phys -32..32; unit Nm}, lower-limit=-8192, upper-limit=8192  # Measured driver steer torque at the column (does not include the wheel inertia effect, some friction between the sensor and the steering wheel, the steering kinematics...) (includes pinion torque sensor for rack drive system and ONLY denotes the driver torque) Conditioned Signal (Filtering, Offset-Compensation, Model-based Plausibility Check, etc.)
  integer type EngineSpeedGradient: base-type=SInt16, compu {raw=phys for phys -30000..30000}, lower-limit=-30000, upper-limit=30000  # EngineSpeed Gradient Detailed naming and description postponed, not equal to engine speed in 10.2 (e.g. hybrids)
  integer type EPBActuatorTorque: base-type=UInt15, compu {raw=phys*4 for phys 0..80000; unit Nm}, lower-limit=0, upper-limit=20000  # Brake torque applied by EPB actuator. Based on nominal brake parameters (e.g. constant pads friction) and (estimated or measured) brake clamp forces.
  integer type EstimatedDamperForces: base-type=SInt16, compu {raw=phys for phys -20000..20000; unit N}, lower-limit=-20000, upper-limit=20000  # Estimation of the actual damper forces provided by the damper system. Refer to ISO 8855.
  integer type EstimatedRideHeightLevelFront: base-type=SInt9, compu {raw=(0+0,00098*phys)/(1) for phys -0,2..0,2; unit m}, lower-limit=-204, upper-limit=204  # The actual estimated ride height at the front axle.
  integer type EstimatedRideHeightLevelRear: base-type=SInt9, compu {raw=(0+0,00098*phys)/(1) for phys -0,2..0,2; unit m}, lower-limit=-204, upper-limit=204  # The actual estimated ride height at the rear axle.
  integer type EstimatedSpringForces: base-type=SInt13, compu {raw=phys for phys -2500..2500; unit N}, lower-limit=-2500, upper-limit=2500  # Estimation of the actual spring forces provided by the spring system. Refer to ISO 8855.
  integer type EstimatedVehicleBodyVerticalAccel: base-type=SInt14, compu {raw=(0+0,00390625*phys)/(1) for phys -30..30; unit m/s^2}, lower-limit=-7680, upper-limit=7680  # Vector of estimated vehicle vertical body accelerations. Refer to ISO 8855. Location could differ dependening on the number of sensors (2,3,4).
  integer type EstimatedVehicleMass: base-type=UInt13, compu {raw=phys for phys 0..7500; unit kg}, lower-limit=0, upper-limit=7500  # Estimation of the vehicle mass provided by the suspension systems.
  integer type EstimatedVehicleMassFromVLC: base-type=UInt14, compu {raw=phys for phys 0..10000; unit kg}, lower-limit=0, upper-limit=10000  # Estimation of the vehicle mass provided by the VLC based on the longitudinal dynamics of the vehicle.
  integer type EstimatedVerticalWheelForces: base-type=SInt19, compu {raw=phys for phys -150000..150000; unit N}, lower-limit=-150000, upper-limit=150000  # Estimation of the actual vehicle wheel forces provided by the suspension systems. Refer to ISO 8855.
  integer type EstimatedWheelLoadDifferenceFront: base-type=UInt8, compu {raw=(0+0,5*phys)/(1) for phys 0..100; unit %}, lower-limit=0, upper-limit=200  # Estimated wheel load difference on the front axle defined as the total front axle load applied the left wheel (100%: Total axle load on left wheel, 0%: Total axle load on right wheel)
  compu method compu_EstimatedWheelLoadDiffere: raw=(0+0,5*phys)/(1) for phys 0..100; unit %
  integer type EstimatedWheelLoadDifferenceRear: base-type=UInt8, compu {raw=(0+0,5*phys)/(1) for phys 0..100; unit %}, lower-limit=0, upper-limit=200  # Estimated wheel load difference on the rear axle defined as the total rear axle load applied the left wheel (100%: Total axle load on left wheel, 0%: Total axle load on right wheel)
  integer type EstimatedWheelVerticalAcceleration: base-type=SInt17, compu {raw=(0+0,00390625*phys)/(1) for phys -200..200; unit m/s^2}, lower-limit=-51200, upper-limit=51200  # Vector of estimated vehicle vertical wheel acceleration. Refer to ISO 8855.
  integer type ExtYawActuatorStatus: base-type=SInt16, compu {raw=phys for phys -20000..20000; unit Nm}, lower-limit=-20000, upper-limit=20000  # Indicates capability of the ext. yaw rate controller using additional actuators (steering, suspension, ...)
  integer type IntendedVehicleBrakeTorque: base-type=UInt15, compu {raw=phys*4 for phys 0..80000; unit Nm}, lower-limit=0, upper-limit=20000  # Sum of 4 wheel intended brake torques. Result of arbitration between driver and e.g. ACC
  integer type LatAccBase: base-type=SInt16, compu {raw=(0+0,0009765625*phys)/(1) for phys -18..18; unit m/s^2}, lower-limit=-18432, upper-limit=18432  # Lateral acceleration measured at sensor position; compensated for orientation. Coordinate system according to ISO 8855
  integer type LatAccRollCompStandard: base-type=SInt16, compu {raw=(0+0,0009765625*phys)/(1) for phys -18..18; unit m/s^2}, lower-limit=-18432, upper-limit=18432  # Lateral acceleration estimated for vehicle COG (ISO 10392). Coordinate system according to ISO 8855. Compensated for roll movement of the vehicle body. Compensated for long term drift.
  integer type LatAccStandard: base-type=SInt16, compu {raw=(0+0,0009765625*phys)/(1) for phys -18..18; unit m/s^2}, lower-limit=-18432, upper-limit=18432  # Lateral acceleration calculated for estimated COG (ISO 10392). Compensated for long term drift. Coordinate system according to ISO 8855
  integer type EstimatedLateralSpeed: base-type=SInt15, compu {raw=(0+0,00390625*phys)/(1) for phys -50..50; unit m/s}, lower-limit=-12800, upper-limit=12800  # Lateral speed component at COG. Measured in vehicle coordinates. Note that this signal will not be reliable and probably must be replaced by function specific signals.
  integer type LongAccBase: base-type=SInt16, compu {raw=(0+0,0009765625*phys)/(1) for phys -18..18; unit m/s^2}, lower-limit=-18432, upper-limit=18432  # Longitudinal acceleration measured at sensor position; compensated for orientation. Coordinate system according to ISO 8855
  integer type LongAccFromWheelSpeedsStandard: base-type=SInt16, compu {raw=(0+0,0009765625*phys)/(1) for phys -18..18; unit m/s^2}, lower-limit=-18432, upper-limit=18432  # Based on wheel speeds. Coordinate system according to ISO 8855. Remark: Degraded during slip control Invalid in case of failure of slip control functions.
  integer type LongAccPitchCompStandard: base-type=SInt16, compu {raw=(0+0,0009765625*phys)/(1) for phys -18..18; unit m/s^2}, lower-limit=-18432, upper-limit=18432  # Based on accelerometer. Coordinate system according to ISO 8855. Compensated for pitch movement of the vehicle body. Compensated for long term drift. Remark: Transformation into COG not relevant for known receivers.
  integer type LongAccStandard: base-type=SInt16, compu {raw=(0+0,0009765625*phys)/(1) for phys -18..18; unit m/s^2}, lower-limit=-18432, upper-limit=18432  # Based on accelerometer. Compensated for long term drift. Coordinate system according to ISO 8855. Remark: Transformation into COG not relevant for known receivers.
  integer type LongitudinalDisplacement: base-type=SInt16, compu {raw=(0+0,015625*phys)/(1) for phys -500..500; unit m}, lower-limit=-32000, upper-limit=32000  # Longitudinal Displacement | Distance between the ego vehicle and the object(s)
  integer type LowerAccelerationRequestTolerance: base-type=UInt9, compu {raw=(0+0,0078125*phys)/(1) for phys 0..2,55; unit m/s^2}, lower-limit=0, upper-limit=326  # Lower Acceleration Request Tolerance | Allowed acceleration offset below Acceleration Request. Allowable from comfort point of view.
  integer type LowerActuatorAccelerationDeadband: base-type=UInt8, compu {raw=(0+0,01*phys)/(1) for phys 0..2,55; unit m/s^2}, lower-limit=0, upper-limit=255  # Lower Actuator Acceleration Deadband | Information about how much lower acceleration request relative to the internal controller value (VLC actual acceleration) have to be before reduction in acceleration can be expected. Actuator working point dependent, e.g. when brake is close to be engaged, the brake transition behaviour will be reflected.
  integer type LowerBrakeActuatorDeadband: base-type=UInt13, compu {raw=phys*4 for phys 0..20000; unit Nm}, lower-limit=0, upper-limit=5000  # Minimum decrease of the requested torque (relative to the current actual value) which will lead to a change in the current torque
  integer type MaximumAccelerationWithoutShift: base-type=SInt13, compu {raw=(0+0,0078125*phys)/(1) for phys -18..18; unit m/s^2}, lower-limit=-2304, upper-limit=2304  # Maximum Acceleration without Shift | Highest acceleration which can be requested before Shift takes place.
  integer type MaxVehicleSpeedBrakeActuator: base-type=UInt10, compu {raw=(0+0,25*phys)/(1) for phys 0..128; unit m/s}, lower-limit=0, upper-limit=512  # Maximum vehicle speed requested by chassis for safety vehicle speed limitation. Arbitrated with a minimum function in PT domain, together with similar requests from other domains. Limit vehicle speed on case of brake system deterioration
  integer type Mileage: base-type=UInt21, compu {raw=(0+0,5*phys)/(1) for phys 0..1000000; unit km}, lower-limit=0, upper-limit=2000000  # Travelled total distance (in km) of the vehicle.
  integer type MinimumAccelerationWithoutBrakeAndShift: base-type=SInt13, compu {raw=(0+0,0078125*phys)/(1) for phys -18..18; unit m/s^2}, lower-limit=-2304, upper-limit=2304  # Minimum Acceleration without Brake and Shift | Lowest acceleration (often negative, i.e. decceleration) which can be requested before Brake or Shift takes place.
  integer type OverallDataQuality: base-type=UInt8, compu {raw=(0+0,5*phys)/(1) for phys 0..100; unit %}, lower-limit=0, upper-limit=200  # Overall data quality | Scaling will be dependent on type of sensor and signal processing algorithm, therefore requires application of parameters on recieving function side. It refers to the whole set of data in the object data list.
  integer type PinionSteerAngleFrontBase: base-type=SInt15, compu {raw=(0+0,0009765625*phys)/(1) for phys -14,5..14,5; unit rad}, lower-limit=-14848, upper-limit=14848  # pinion steer angle at the front steering device steering angle
  integer type PinionSteerAngleFrontSpeedStandard: base-type=SInt14, compu {raw=(0+0,0078125*phys)/(1) for phys -50..50; unit rad/s}, lower-limit=-6400, upper-limit=6400  # Calculated pinion steer angle speed at the front steering device. Conditioned Signal (Filtering, Offset-Compensation, Model-based Plausibility Check, etc.)
  integer type PinionSteerAngleFrontStandard: base-type=SInt15, compu {raw=(0+0,0009765625*phys)/(1) for phys -14,5..14,5; unit rad}, lower-limit=-14848, upper-limit=14848  # Calculated pinion steer angle at the front steering device. Conditioned Signal (Filtering, Offset-Compensation, Model-based Plausibility Check, etc.) PinionSteerAngleFrontStandard = driver wish + VGR + DAS function + stability related functions steering angle
  integer type PinionSteerAngleRearBase: base-type=SInt15, compu {raw=(0+0,0009765625*phys)/(1) for phys -14,5..14,5; unit rad}, lower-limit=-14848, upper-limit=14848  # Steer angle at steered rear wheels (measured)
  integer type PinionSteerAngleRearSpeedStandard: base-type=SInt14, compu {raw=(0+0,0078125*phys)/(1) for phys -50..50; unit rad/s}, lower-limit=-6400, upper-limit=6400  # Steer angle speed at steered rear wheels. Conditioned Signal (Filtering, Offset-Compensation, Model-based Plausibility Check, etc.)
  integer type PinionSteerAngleRearStandard: base-type=SInt15, compu {raw=(0+0,0009765625*phys)/(1) for phys -14,5..14,5; unit rad}, lower-limit=-14848, upper-limit=14848  # Steer angle at steered rear wheels. Conditioned Signal (Filtering, Offset-Compensation, Model-based Plausibility Check, etc.)
  integer type PitchRateBase: base-type=SInt16, compu {raw=(0+0,000244140625*phys)/(1) for phys -5..5; unit rad/s}, lower-limit=-20480, upper-limit=20480  # Pitch rate measured along vehicle y- axis (i.e. compensated for orientation). Coordinate system according to ISO 8855
  integer type PitchRateStandard: base-type=SInt16, compu {raw=(0+0,000244140625*phys)/(1) for phys -5..5; unit rad/s}, lower-limit=-20480, upper-limit=20480  # Pitch rate calulated along vehicle y-axis. Coordinate system according to ISO 8855 Filtered and offset-compensated
  integer type RelativeEstimatedBodyPitchAngle: base-type=SInt11, compu {raw=(0+0,0009765625*phys)/(1) for phys -0,5..0,5; unit rad}, lower-limit=-512, upper-limit=512  # Estimation of the relative pitch angle of the vehicle body.
  integer type RelativeEstimatedBodyRollAngle: base-type=SInt11, compu {raw=(0+0,0009765625*phys)/(1) for phys -0,5..0,5; unit rad}, lower-limit=-512, upper-limit=512  # Estimation of the relative roll angle of the vehicle body.
  integer type RequestedAbsoluteDriverTorqueFront: base-type=SInt15, compu {raw=(0+0,00390625*phys)/(1) for phys -32..32; unit Nm}, lower-limit=-8192, upper-limit=8192  # Requested absolute driver steering torque (does not include the wheel inertia effect, some friction between the sensor and the steering wheel, the steering kinematics...) Multiple Data Elements (meaning : request can come from different High Level Functions)
  integer type RequestedAbsoluteRoadWheelAngleFront: base-type=SInt15, compu {raw=(0+0,0001220703125*phys)/(1) for phys -1,571..1,571; unit rad}, lower-limit=-12870, upper-limit=12870  # Requested road wheel angle for front steering actuator. Multiple Data Elements (meaning : request can come from different High Level Functions)
  compu method compu_RequestedAbsoluteRoadWhee: raw=(0+0,0001220703125*phys)/(1) for phys -1,571..1,571; unit rad
  integer type RequestedAbsoluteRoadWheelAngleRear: base-type=SInt15, compu {raw=(0+0,0001220703125*phys)/(1) for phys -1,571..1,571; unit rad}, lower-limit=-12870, upper-limit=12870  # Requested absolute road wheel angle for rear wheel steering actuator. Multiple Data Elements (meaning : request can come from different High Level Functions)
  integer type RequestedAddSteerAngleFront: base-type=SInt15, compu {raw=(0+0,0009765625*phys)/(1) for phys -14,5..14,5; unit rad}, lower-limit=-14848, upper-limit=14848  # Requested steer angle for front steering actuator using variable steering ratio (comfort function, steering assistance) Multiple Data Elements angle related to steering wheel
  integer type RequestedBrakeTorquesByYawCtrl: base-type=UInt16, compu {raw=(0+0,5*phys)/(1) for phys 0..20000; unit Nm}, lower-limit=0, upper-limit=40000  # The output requests from YawCtrl outputted for information. Needed for hand-over ESC to RSC and back. Also to enable RSC to &quot;emulate a max arbitration&quot;. Absolute request.
  integer type RequestedDeltaDriverTorqueFront: base-type=SInt15, compu {raw=(0+0,00390625*phys)/(1) for phys -32..32; unit Nm}, lower-limit=-8192, upper-limit=8192  # Requested delta driver steering torque (does not include the wheel inertia effect, some friction between the sensor and the steering wheel, the steering kinematics...) Multiple Data Elements (meaning : request can come from different High Level Functions) driver steering torque measured at the steering column
  integer type RequestedDeltaRoadWheelAngleFront: base-type=SInt15, compu {raw=(0+0,0001220703125*phys)/(1) for phys -1,571..1,571; unit rad}, lower-limit=-12870, upper-limit=12870  # Requested additional (road wheel) steer angle interventions via front steering actuator (= delta steer angle at steered wheels, at angle superposition steering systems: middle front axle delta steering angle). Note: Data Element can be used by different Interfaces(oversteer, understeer, mue-split-steer, lane change,...) angle related to average front wheel angle
  compu method compu_RequestedDeltaRoadWheelAn: raw=(0+0,0001220703125*phys)/(1) for phys -1,571..1,571; unit rad
  integer type RequestedDeltaRoadWheelAngleRear: base-type=SInt15, compu {raw=(0+0,0001220703125*phys)/(1) for phys -1,571..1,571; unit rad}, lower-limit=-12870, upper-limit=12870  # Requested additional road wheel steer angle interventions via rear steering actuator (= delta steer angle at steered wheels Note: Data Element can be used by different Interfaces(oversteer, understeer, mue-split-steer, lane change,...)
  integer type RequestedExtYawTorque: base-type=SInt16, compu {raw=phys for phys -20000..20000; unit Nm}, lower-limit=-20000, upper-limit=20000  # Component of the total yaw torque to be realized by ext yaw rate controller using additional actuators (steering, suspenssion, ...)
  integer type RequestedMaxWheelBrakeSlipByRSC: base-type=UInt12, compu {raw=(0+0,00048828125*phys)/(1) for phys 0..1}, lower-limit=0, upper-limit=2048  # Requested maximum whell brake slip from RSC to ESC for individual wheels. ABS is expected to limit the wheel slips to these maximum values.
  integer type RequestedVehicleBrakeTorque: base-type=UInt15, compu {raw=phys*4 for phys 0..80000; unit Nm}, lower-limit=0, upper-limit=20000  # Requested longitudinal vehicle brake torque based on nominal brake parameters and (estimated) brake pressures (clamp forces).
  integer type RequestedWheelBrakeTorquebyRSC: base-type=UInt16, compu {raw=phys for phys 0..60000; unit Nm}, lower-limit=0, upper-limit=60000  # Requested Brake Torque to be acting on the wheels. Based on nominal brake parameters and (estimated) brake pressures (clamp forces). Absolute requested.
  integer type RoadBankAccelEstimation: base-type=SInt15, compu {raw=(0+0,0009765625*phys)/(1) for phys -8,5..8,5; unit m/s^2}, lower-limit=-8704, upper-limit=8704  # Acceleration component resulting from a banked road. Rotation about x-axis, angle betweeen z-y-axis. Coordinate system according to ISO 8855. Note that this signal will not be reliable and probably must be replaced by function specific signals, e.g. to prevent wrong interventions
  integer type RoadInclinationAccelEstimation: base-type=SInt15, compu {raw=(0+0,0009765625*phys)/(1) for phys -8,5..8,5; unit m/s^2}, lower-limit=-8704, upper-limit=8704  # Acceleration component resulting from road inclination. Measured in vehicle coordinates! Calculated from LongAcc from wheel speeds and acceleration sensor. Resolution corresponds to 0,25% slope
  integer type ActualEstimatedRoadWheelAngleFrontSpeed: base-type=SInt14, compu {raw=(0+0,0009765625*phys)/(1) for phys -5..5; unit rad/s}, lower-limit=-5120, upper-limit=5120  # time-derivative of ActualEstimatedRoadWheelAngleFront
  integer type RollMomentDistribution: base-type=UInt8, compu {raw=(0+0,5*phys)/(1) for phys 0..100; unit %}, lower-limit=0, upper-limit=200  # Estimated stabilizer roll moment difference front to rear defined relative to the total stabilizer moment (front and rear) (100%: Only stabilizer moment on front, 0%: Only stabilizer moment on rear)
  integer type RollRateBase: base-type=SInt16, compu {raw=(0+0,000244140625*phys)/(1) for phys -5..5; unit rad/s}, lower-limit=-20480, upper-limit=20480  # Roll Rate from sensor element. Coordinate system according to ISO 8855.
  integer type RollRateExtdRangeBase: base-type=SInt15, compu {raw=(0+0,0009765625*phys)/(1) for phys -10..10; unit rad/s}, lower-limit=-10240, upper-limit=10240  # Roll Rate from sensor element. Coordinate system according to ISO 8855. Extended signal range
  integer type RollRateStandard: base-type=SInt16, compu {raw=(0+0,000244140625*phys)/(1) for phys -5..5; unit rad/s}, lower-limit=-20480, upper-limit=20480  # Roll Rate from sensor element. Coordinate system according to ISO 8855. Compensated for long-term drift
  integer type SpringTravel: base-type=SInt12, compu {raw=(0+0,000244140625*phys)/(1) for phys -0,3..0,3; unit m}, lower-limit=-1229, upper-limit=1229  # Spring travel continuous values at individual wheels (one for each corner)
  integer type SSM2EPBRequestedVehicleBrakeTorque: base-type=UInt15, compu {raw=phys*16 for phys 0..1000000; unit Nm/s}, lower-limit=0, upper-limit=20000  # Requested total vehicle brake torque from SSM to EPB. Based on nominal brake parameters (e.g. constant pads friction) and (estimated or measured) brake clamp forces.
  compu method compu_SSM2EPBRequestedVehicleBr: raw=phys*4 for phys 0..80000; unit Nm
  integer type SSM2EPBRequestedVehicleBrakeTorqueGradient: base-type=UInt16, compu {raw=phys*16 for phys 0..1000000; unit Nm/s}, lower-limit=0, upper-limit=62500  # Time Derivative of the requested total vehicle brake torque from SSM to EPB. Based on nominal brake parameters (e.g. constant pads friction) and (estimated or measured) brake clamp forces. In Dynamic Mode, value set to default (0 Nm/s)
  integer type SSM2ESCRequestedVehicleBrakeTorque: base-type=UInt15, compu {raw=phys*16 for phys 0..1000000; unit Nm/s}, lower-limit=0, upper-limit=20000  # Requested longitudinal vehicle force Based on nominal brake parameters and (estimated) brake pressures (clamp forces).
  compu method compu_SSM2ESCRequestedVehicleBr: raw=phys*4 for phys 0..80000; unit Nm
  integer type SSM2ESCRequestedVehicleBrakeTorqueGradient: base-type=UInt16, compu {raw=phys*16 for phys 0..1000000; unit Nm/s}, lower-limit=0, upper-limit=62500  # Time Derivative of the requested total vehicle brake torque from SSM to ESC. Based on nominal brake parameters (e.g. constant pads friction) and (estimated or measured) brake clamp forces
  integer type SteeringWheelAngle: base-type=SInt15, compu {raw=(0+0,0009765625*phys)/(1) for phys -14,5..14,5; unit rad}, lower-limit=-14848, upper-limit=14848  # Steer angle at steering postioned between the steering wheel and the BSAS system if it is there.
  integer type SteeringWheelAngleSpeed: base-type=SInt14, compu {raw=(0+0,0078125*phys)/(1) for phys -50..50; unit rad/s}, lower-limit=-6400, upper-limit=6400  # Steer angle speed at steering postioned between the steering wheel and the BSAS system if it is there.
  integer type TimeStamp: base-type=UInt20, compu {raw=(0+0,001*phys)/(1) for phys 0..1000; unit s}, lower-limit=0, upper-limit=1000000  # Time Stamp | Absolute time stamp used in sensor fusion to match data samples from different points in time. <= 1ms
  integer type UpperAccelerationRequestTolerance: base-type=UInt9, compu {raw=(0+0,0078125*phys)/(1) for phys 0..2,55; unit m/s^2}, lower-limit=0, upper-limit=326  # Upper Acceleration Request Tolerance | Allowed acceleration offset above Acceleration Request. Allowable from comfort point of view.
  integer type UpperActuatorAccelerationDeadband: base-type=UInt9, compu {raw=(0+0,0078125*phys)/(1) for phys 0..2,55; unit m/s^2}, lower-limit=0, upper-limit=326  # Upper Actuator Acceleration Deadband | Information about how much higher acceleration request relative to the internal controller value (VLC actual acceleration) have to be before increase in acceleration can be expected. Actuator working point dependent.
  integer type UpperBrakeActuatorDeadband: base-type=UInt13, compu {raw=phys*4 for phys 0..20000; unit Nm}, lower-limit=0, upper-limit=5000  # Minimum increase of the requested torque (relative to the current actual value) which will lead to a change in the current torque
  integer type VehicleLongitudinalSpeed: base-type=UInt16, compu {raw=(0+0,00390625*phys)/(1) for phys 0..128; unit m/s}, lower-limit=0, upper-limit=32768  # Based on wheel speeds. Possibly extended by acceleration sensor. Coordinate system according to ISO 8855. Refers to COG Remark: Behaviour t.b.d. during slip control or failure of slip control functions.
  integer type WheelAngularAccelerationStandard: base-type=SInt14, compu {raw=(0+0,125*phys)/(1) for phys -1000..1000; unit rad/s^2}, lower-limit=-8000, upper-limit=8000  # Angular acceleration of an individual wheel.
  integer type WheelAngularVelocityStandard: base-type=UInt15, compu {raw=(0+0,015625*phys)/(1) for phys 0..500; unit rad/s}, lower-limit=0, upper-limit=32000  # Angular velocity of an individual wheel, filtered
  integer type WheelBrakeTorque: base-type=UInt15, compu {raw=phys for phys 0..20000; unit Nm}, lower-limit=0, upper-limit=20000  # Brake torque acting on one wheel. Based on nominal brake parameters (e.g. constant pads friction) and (estimated) brake pressures (clamp forces). Not included: parking brake torque.
  integer type WheelCircumSpeedsStandard: base-type=UInt16, compu {raw=(0+0,00390625*phys)/(1) for phys 0..128; unit m/s}, lower-limit=0, upper-limit=32768  # Wheel circum speed determined on the base of angular velocity and standard rolling radius. If signal is not provided (optional) the radius must be available as a parameter
  integer type WheelRadiusToleranceCoefficient: base-type=UInt11, compu {raw=(0,7+0,00048828125*phys)/(1) for phys 0,7..1,2}, lower-limit=0, upper-limit=1024  # Factor to be used to compensate the static rolling radius of tyres, not including slip
  integer type WheelTravelledDistanceStandard: base-type=UInt14, compu {raw=(0+0,00390625*phys)/(1) for phys 0..32; unit m}, lower-limit=0, upper-limit=8192  # Distance travelled by every wheel at circumference, determined on the base of wheel rotation and standard rolling radius; not compensated for wheel slip
  integer type YawRateBase: base-type=SInt16, compu {raw=(0+0,000244140625*phys)/(1) for phys -5..5; unit rad/s}, lower-limit=-20480, upper-limit=20480  # Yaw rate measured along vehicle z- axis (i.e. compensated for orientation). Coordinate system according to ISO 8855
  integer type YawRateGradientStandard: base-type=SInt16, compu {raw=(0+0,00390625*phys)/(1) for phys -75..75; unit rad/s^2}, lower-limit=-19200, upper-limit=19200  # Time-derivative of YawRateStandard
  integer type YawRateOffsetStandard: base-type=SInt16, compu {raw=(0+0,000244140625*phys)/(1) for phys -5..5; unit rad/s}, lower-limit=-20480, upper-limit=20480  # Yaw rate offset calulated (dynamic value) along vehicle z-axis. Coordinate system according to ISO 8855
  integer type YawRateReferenceValue: base-type=SInt16, compu {raw=(0+0,000244140625*phys)/(1) for phys -5..5; unit rad/s}, lower-limit=-20480, upper-limit=20480  # Target yaw rate of the Yaw Stability Control feature.
  integer type YawRateStandard: base-type=SInt16, compu {raw=(0+0,000244140625*phys)/(1) for phys -5..5; unit rad/s}, lower-limit=-20480, upper-limit=20480  # Yaw rate calulated along vehicle z-axis. Coordinate system according to ISO 8855 Filtered and offset-compensated
  integer type YawStabilityInformation: base-type=SInt8, compu {raw=phys for phys -128..127; unit %}, lower-limit=-128, upper-limit=127  # Negative shows understeer. Positive shows oversteer. 0 is designed vehicle stable state. +/-100 is start of Yaw Control intervention.
  integer type EstimatedDriverRoadWheelAngleFrontWish: base-type=SInt15, compu {raw=(0+0,0009765625*phys)/(1) for phys -5..5; unit rad/s}, lower-limit=-12870, upper-limit=12870  # EstimatedDriverRoadWheelAngleFrontWish = driver angle wish + VGR + DAS function angle
  compu method compu_EstimatedDriverRoadWheelA: raw=(0+0,0001220703125*phys)/(1) for phys -1,571..1,571; unit rad
  integer type EstimatedDriverRoadWheelAngleFrontSpeedWish: base-type=SInt14, compu {raw=(0+0,0009765625*phys)/(1) for phys -5..5; unit rad/s}, lower-limit=-5120, upper-limit=5120  # EstimatedDriverRoadWheelAngleFrontSpeedWish = driver angle speed wish + VGR speed + DAS function angle speed
  integer type EstimatedRollMomentFront: base-type=SInt16, compu {raw=phys for phys -20000..20000; unit Nm}, lower-limit=-20000, upper-limit=20000  # Estimation of roll moment compensated by the front stabilizer.
  integer type EstimatedRollMomentRear: base-type=SInt16, compu {raw=phys for phys -20000..20000; unit Nm}, lower-limit=-20000, upper-limit=20000  # Estimation of roll moment compensated by the rear stabilizer.
  integer type MeasuredRideHeightLevelFrontBase: base-type=SInt9, compu {raw=(0+0,00098*phys)/(1) for phys -0,2..0,2; unit m}, lower-limit=-204, upper-limit=204  # The actual measured ride height at the front axle.
  compu method compu_MeasuredRideHeightLevelFr: raw=(0+0,00098*phys)/(1) for phys -0,2..0,2; unit m
  integer type MeasuredRideHeightLevelFrontStandard: base-type=SInt9, compu {raw=(0+0,00098*phys)/(1) for phys -0,2..0,2; unit m}, lower-limit=-204, upper-limit=204  # The actual measured ride height at the front axle. (Filtered and offset compensated)
  integer type MeasuredRideHeightLevelRearBase: base-type=SInt9, compu {raw=(0+0,00098*phys)/(1) for phys -0,2..0,2; unit m}, lower-limit=-204, upper-limit=204  # The actual measured ride height at the rear axle.
  compu method compu_MeasuredRideHeightLevelRe: raw=(0+0,00098*phys)/(1) for phys -0,2..0,2; unit m
  integer type MeasuredRideHeightLevelRearStandard: base-type=SInt9, compu {raw=(0+0,00098*phys)/(1) for phys -0,2..0,2; unit m}, lower-limit=-204, upper-limit=204  # The actual measured ride height at the rear axle. (Filtered and offset compensated)
  integer type MeasuredVehicleBodyVerticalAccelBase: base-type=SInt14, compu {raw=(0+0,00391*phys)/(1) for phys -30..30; unit m/s^2}, lower-limit=-7673, upper-limit=7673  # Measured vehicle vertical body acceleration. Refer to ISO 8855. Location could differ dependening on the number of sensors (2,3,4).
  compu method compu_MeasuredVehicleBodyVertic: raw=(0+0,00391*phys)/(1) for phys -30..30; unit m/s^2
  integer type MeasuredVehicleBodyVerticalAccelStandard: base-type=SInt14, compu {raw=(0+0,00391*phys)/(1) for phys -30..30; unit m/s^2}, lower-limit=-7673, upper-limit=7673  # Measured vehicle vertical body acceleration. Refer to ISO 8855. Location could differ dependening on the number of sensors (2,3,4). (Filtered and offset compensated)
  integer type MaximumJerkRequest: base-type=SInt15, compu {raw=(0+0,00390625*phys)/(1) for phys -32..32; unit m/s^3}, lower-limit=-8192, upper-limit=8192  # Maximum acceleration change rate which is acceptable from function point of view. E.g. from traffic point of view if Follow Control is sender of request.
  integer type MinimumJerkRequest: base-type=SInt15, compu {raw=(0+0,00390625*phys)/(1) for phys -32..32; unit m/s^3}, lower-limit=-8192, upper-limit=8192  # Minimum acceleration change rate which is acceptable from function point of view. E.g. from traffic point of view if Follow Control is sender of request.
  integer type VehicleBodyLevelsStandard: base-type=SInt10, compu {raw=(0+0,001*phys)/(1) for phys -0,5..0,5; unit m}, lower-limit=-500, upper-limit=500  # Spring travel (filtered and offset compensated)
  integer type WheelVerticalAccelerationBase: base-type=SInt17, compu {raw=(0+0,00391*phys)/(1) for phys -200..200; unit m/s^2}, lower-limit=-51151, upper-limit=51151  # Measured vertical wheel acceleration.
  compu method compu_WheelVerticalAcceleration: raw=(0+0,00391*phys)/(1) for phys -200..200; unit m/s^2
  integer type WheelVerticalAccelerationStandard: base-type=SInt17, compu {raw=(0+0,00391*phys)/(1) for phys -200..200; unit m/s^2}, lower-limit=-51151, upper-limit=51151  # Calculated vertical wheel acceleration, filtered and off-set compensated. Refer to ISO 8855.
  integer type t_date_tm_day: base-type=UInt5, compu {raw=phys for phys 1..31}, lower-limit=1, upper-limit=31  # It represents the value of a day in a month
  integer type t_date_tm_hour: base-type=UInt5, compu {raw=phys for phys 0..23}, lower-limit=0, upper-limit=23  # It represents the value of an hour in a day (24h format)
  integer type t_date_tm_minute: base-type=UInt6, compu {raw=phys for phys 0..59}, lower-limit=0, upper-limit=59  # It represents the value of a minute in one hour
  integer type t_date_tm_second: base-type=UInt6, compu {raw=phys for phys 0..59}, lower-limit=0, upper-limit=59  # It represents the value of a second in one minute
  integer type t_date_tm_month: base-type=UInt4, compu {raw=phys for phys 1..12}, lower-limit=1, upper-limit=12  # It represents the value of a month in a calendar year
  integer type t_date_tm_year: base-type=UInt7, compu {raw=phys for phys 0..99}, lower-limit=0, upper-limit=99  # It represents the value of a year in a century
  integer type TransmissionType: base-type=UInt4, compu {raw=phys for phys 0..99}, lower-limit=0, upper-limit=15  # Information on standard transmission. Other transmission types on value 5 - 15
  compu method enum_TransmissionType: 0=MT, 1=AT, 2=AMT, 3=CVT, 4=DCT, 5..15=Reserved1..Reserved11  # Enumeration{ MT, AT, AMT, CVT, DCT, Reserved1, Reserved2, Reserved3, Reserved4, Reserved5, Reserved6, Reserved7, Reserved8, Reserved9, Reserved10, Reserved11 }
  integer type ClutchState: base-type=UInt2, compu {raw=phys for phys 0..99}, lower-limit=0, upper-limit=3  # The interface informs about the current state of the clutch. There exist 4 principal states: open, intermediate, near closed, hard closed (Note: The definition of intermediate and near closed has to be made for each project separately) Definition of &quot;Clutch&quot;: - for AT, CVT it is the converter clutch - for MT, AMT it is the clutch between the gear box and the engine drivetrain Be aware that this information is not necessarily equal with the drivetrain open information. If a torque converter clutch is open, the drivetrain can still be closed. In contrary the drivetrain is open for MT and AMT, if the clutch is open!
  compu method enum_ClutchState: 0=open, 1=intermediate, 2=nearClosed, 3=hardClosed  # Enumeration{ open, intermediate, nearClosed, hardClosed }
  integer type GearLeverPosition: base-type=UInt3, compu {raw=phys for phys 0..99}, lower-limit=0, upper-limit=7  # Only defined for automatic transmissions. The signal is based on the lever position.
  compu method enum_GearLeverPosition: 0=N, 1=P, 2=R, 3=D, 4=S, 5=D1, 6=D2, 7=D3  # Enumeration{ N, P, R, D, S, D1, D2, D3 }
  integer type GearShiftPrevention: base-type=UInt2, compu {raw=phys for phys 0..99}, lower-limit=0, upper-limit=3  # Gear shift prevention 0 - no request, 1 - inhibit upshift, 2 - inhibit down shift, 3 - inhibit all shifts
  compu method enum_GearShiftPrevention: 0=noRequest, 1=inhibitUpShift, 2=inhibitDownShift, 3=inhibitAllShifts  # Enumeration{ noRequest, inhibitUpShift, inhibitDownShift, inhibitAllShifts }
  integer type t_StaCrash: base-type=UInt2, compu {raw=phys for phys 0..99}, lower-limit=0, upper-limit=4  # Simplistic crash information
  compu method enum_t_StaCrash: 0=not_applicable, 1=pre_crash, 2=post_crash, 3=not_applicable, 4=not_applicable  # Enumeration{ not_applicable, pre_crash, post_crash, not_applicable, not_applicable }
  integer type t_StaEnergyMgmt: base-type=UInt4, compu {raw=phys for phys 0..99}, lower-limit=0, upper-limit=14  # This interface is to reflect the load dump&quot; stages in case of improper battery/generator balance. The handling of over- or under-voltage is not covered within this interface. Length (bit) = 4; Recommendations: Init value= full_funct
  compu method enum_t_StaEnergyMgmt: 0=no_funct_possible, 1=safety_funct_only, 2=hibernate_level_1, 3=hibernate_level_2, 4=hibernate_level_3, 5..8=lim_comf_level_1..lim_comf_level_4, 9=full_funct, 10=consume_energy, 11..14=reserved_1..reserved_4  # Enumeration{ no_funct_possible, safety_funct_only, hibernate_level_1, hibernate_level_2, hibernate_level_3, lim_comf_level_1, lim_comf_level_2, lim_comf_level_3, lim_comf_level_4, full_funct, consume_energy, reserved_1, reserved_2, reserved_3, reserved_4 }
  integer type t_StaProfilePerson: base-type=UInt4, compu {raw=phys for phys 0..99}, lower-limit=0, upper-limit=15  # Determines different profiles of vehicle users. The profile is in many cases associated with a key. Length (bit) = 4 Recommendations: Init value=no_profile, can invalidate=No
  compu method enum_t_StaProfilePerson: 0=no_prfile, 1..15=profile1..profile15  # Enumeration{ no_prfile, profile1, profile2, profile3, profile4, profile5, profile6, profile7, profile8, profile9, profile10, profile11, profile12, profile13, profile14, profile15 }
  integer type t_onoff: base-type=UInt0, compu {raw=phys for phys 0..99}, lower-limit=0, upper-limit=1  # Generic On/Off Information Length (bit) = 1 Recommendations: Init value= off, can invalidate =No
  compu method enum_t_onoff: 0=off, 1=on  # Enumeration{ off, on }
  integer type t_LockingState: base-type=UInt2, compu {raw=phys for phys 0..99}, lower-limit=0, upper-limit=4  # It represents the status of the locking state of the doors
  compu method enum_t_LockingState: 0=undefined, 1=open, 2=closed, 3=locked, 4=safed  # Enumeration{ undefined, open, closed, locked, safed }
  integer type t_TriggerSource: base-type=UInt5, compu {raw=phys for phys 0..99}, lower-limit=0, upper-limit=31  # Lock operations triggering source.
  compu method enum_t_TriggerSource: 0=no_trigger_source, 1=remote_key, 2=keyless, 3=mechanical_key, 4=keypad, 5=speed, 6=crash, 7=interior_switch, 8=autolock, 9=lockout_prevention, 10=trunk_unlock, 11=flipper_glass, 12..31=trigger_source1..trigger_source20  # Enumeration{ no_trigger_source, remote_key, keyless, mechanical_key, keypad, speed, crash, interior_switch, autolock, lockout_prevention, trunk_unlock, flipper_glass, trigger_source1, trigger_source2, trigger_source3, trigger_source4, trigger_source5, trigger_source6, trigger_source7, trigger_source8, trigger_source9, trigger_source10, trigger_source11, trigger_source12, trigger_source13, trigger_source14, trigger_source15, trigger_source16, trigger_source17, trigger_source18, trigger_source19, trigger_source20 }
  integer type t_ReqLockingFeedback: base-type=UInt2, compu {raw=phys for phys 0..99}, lower-limit=0, upper-limit=3  # Transports the currently executed locking request. Length (bit) = 2 (see data type) Recommendations: Init value= off , can invalidate=No
  compu method enum_t_ReqLockingFeedback: 0=off, 1=unlock, 2=lock, 3=safe  # Enumeration{ off, unlock, lock, safe }
  integer type t_ReqLockUnlock: base-type=UInt1, compu {raw=phys for phys 0..99}, lower-limit=0, upper-limit=2  # Locking Request, usually executed by a lock Length (bit) = 2 Recommendations: Init value= implausible, can invalidate =No no user request
  compu method enum_t_ReqLockUnlock: 0=idle, 1=unlock, 2=lock  # Enumeration{ idle, unlock, lock }
  integer type t_StaDoor: base-type=UInt2, compu {raw=phys for phys 0..99}, lower-limit=0, upper-limit=4  # Status of the door. Length (bit) = 3 Recommendations: Init value=unknown, can invalidate =Yes initialisation phase
  compu method enum_t_StaDoor: 0=unknown, 1=open, 2=closed, 3=ajar, 4=invalid  # Enumeration{ unknown, open, closed, ajar, invalid }
  integer type t_StaLock: base-type=UInt2, compu {raw=phys for phys 0..99}, lower-limit=0, upper-limit=4  # Status of the lock. In some countries the state safed is not supported.
  compu method enum_t_StaLock: 0=implausible, 1=unlocked, 2=locked, 3=safed, 4=moving  # Enumeration{ implausible, unlocked, locked, safed, moving }
  integer type t_CmdLock: base-type=UInt2, compu {raw=phys for phys 0..99}, lower-limit=0, upper-limit=3  # User command for a lock
  compu method enum_t_CmdLock: 0=off, 1=unlock, 2=lock, 3=safe  # Enumeration{ off, unlock, lock, safe }
  integer type t_CmdChildProt: base-type=UInt1, compu {raw=phys for phys 0..99}, lower-limit=0, upper-limit=2  # Interface to activate and deactivate the child protected for the rear seat passengers.
  compu method enum_t_CmdChildProt: 0=off, 1=activate, 2=deactivate  # Enumeration{ off, activate, deactivate }
  integer type t_CmdPullAid: base-type=UInt1, compu {raw=phys for phys 0..99}, lower-limit=0, upper-limit=2  # Indicates the pull aid command
  compu method enum_t_CmdPullAid: 0=off, 1=open, 2=close  # Enumeration{ off, open, close }
  integer type t_MirrorType: base-type=UInt2, compu {raw=phys for phys 0..99}, lower-limit=0, upper-limit=3  # It indicates the slected mirror
  compu method enum_t_MirrorType: 0=no_mirror, 1=driver_mirror, 2=passenger_door, 3=interior_mirror  # Enumeration{ no_mirror, driver_mirror, passenger_door, interior_mirror }
  integer type t_AxisType: base-type=UInt1, compu {raw=phys for phys 0..99}, lower-limit=0, upper-limit=2  # It indicates the direction of movement of the selected mirror
  compu method enum_t_AxisType: 0=no_axis, 1=horiz_axis, 2=vert_axis  # Enumeration{ no_axis, horiz_axis, vert_axis }
  integer type t_MovementType: base-type=UInt1, compu {raw=phys for phys 0..99}, lower-limit=0, upper-limit=2  # It indicates the sense of the movement of the mirror on the selected axis.
  compu method enum_t_MovementType: 0=idle, 1=increase, 2=decrease  # Enumeration{ idle, increase, decrease }
  integer type t_operation: base-type=UInt1, compu {raw=phys for phys 0..99}, lower-limit=0, upper-limit=2  # It indicates the type of operation of a mirror related to the position storing or restoring.
  compu method enum_t_operation: 0=off, 1=recall, 2=store  # Enumeration{ off, recall, store }
  integer type t_StaMirrorFault: base-type=UInt0, compu {raw=phys for phys 0..99}, lower-limit=0, upper-limit=1  # Indicates if a mirror is operational or defective
  compu method enum_t_StaMirrorFault: 0=operational, 1=defective  # Enumeration{ operational, defective }
  integer type t_StaAutoTinting: base-type=UInt1, compu {raw=phys for phys 0..99}, lower-limit=0, upper-limit=2  # Indicates the tinting status from the mirror component including the fault state
  compu method enum_t_StaAutoTinting: 0=error, 1=on, 2=off  # Enumeration{ error, on, off }
  integer type t_StaMirrorTinting: base-type=UInt1, compu {raw=phys for phys 0..99}, lower-limit=0, upper-limit=2  # Indicates the tinting status of the actuator component including the fault state
  compu method enum_t_StaMirrorTinting: 0=deactivated, 1=activated, 2=defective  # Enumeration{ deactivated, activated, defective }
  integer type t_ReqIntLight: base-type=UInt2, compu {raw=phys for phys 0..99}, lower-limit=0, upper-limit=4  # Indicates a generic request for an Interior Light source.
  compu method enum_t_ReqIntLight: 0=unknown, 1=off, 2=on, 3=auto, 4=invalid  # Enumeration{ unknown, off, on, auto, invalid }
  integer type t_StaOutSideBrightness: base-type=UInt3, compu {raw=phys for phys 0..99}, lower-limit=0, upper-limit=7  # Indicates outside brightness status
  compu method enum_t_StaOutSideBrightness: 0=unknown, 1=night, 2..5=Twilight_1..Twilight_4, 6=day, 7=invalid  # Enumeration{ unknown, night, Twilight_1, Twilight_2, Twilight_3, Twilight_4, day, invalid }
  integer type t_DisParkingLights: base-type=UInt2, compu {raw=phys for phys 0..99}, lower-limit=0, upper-limit=3  # Indicates the Parking lights activation status
  compu method enum_t_DisParkingLights: 0=off, 1=left, 2=right, 3=both  # Enumeration{ off, left, right, both }
  integer type t_ReqComingHomeLeavingHome: base-type=UInt1, compu {raw=phys for phys 0..99}, lower-limit=0, upper-limit=2  # Indicates the coming home and leaving home requests.
  compu method enum_t_ReqComingHomeLeavingHome: 0=off, 1=coming_home, 2=leaving_home  # Enumeration{ off, coming_home, leaving_home }
  integer type t_ReqVisualAlarm: base-type=UInt3, compu {raw=phys for phys 0..99}, lower-limit=0, upper-limit=7  # Indicates what is the Alarm current active state in the car
  compu method enum_t_ReqVisualAlarm: 0=no_alarm, 1..7=alarm_type_1..alarm_type_7  # Enumeration{ no_alarm, alarm_type_1, alarm_type_2, alarm_type_3, alarm_type_4, alarm_type_5, alarm_type_6, alarm_type_7 }
  integer type t_ramp: base-type=UInt3, compu {raw=phys for phys 0..99}, lower-limit=0, upper-limit=7  # Custom definition for fade in/fade out times of Interior Lights
  compu method enum_t_ramp: 0=no_ramp, 1..7=ramp1..ramp7  # Enumeration{ no_ramp, ramp1, ramp2, ramp3, ramp4, ramp5, ramp6, ramp7 }
  integer type t_StaLightFault: base-type=UInt0, compu {raw=phys for phys 0..99}, lower-limit=0, upper-limit=1  # Indicates the operational or defective status of the Lights actuator
  compu method enum_t_StaLightFault: 0=operational, 1=defective  # Enumeration{ operational, defective }
  integer type t_MemoryButton: base-type=UInt3, compu {raw=phys for phys 0..99}, lower-limit=0, upper-limit=5  # Indicates the selected memory button
  compu method enum_t_MemoryButton: 0=no_button, 1..5=button_1..button_5  # Enumeration{ no_button, button_1, button_2, button_3, button_4, button_5 }
  integer type t_EasyEntry: base-type=UInt2, compu {raw=phys for phys 0..99}, lower-limit=0, upper-limit=4  # Indicates the easy entry status of the front/rear seats
  compu method enum_t_EasyEntry: 0=idle, 1=activate_easyentry_front, 2=release_easyentry_front, 3=activate_easyentry_rear, 4=release_easyentry_rear  # Enumeration{ idle, activate_easyentry_front, release_easyentry_front, activate_easyentry_rear, release_easyentry_rear }
  integer type t_openclosed: base-type=UInt0, compu {raw=phys for phys 0..99}, lower-limit=0, upper-limit=1  # Indicates open / closed status
  compu method enum_t_openclosed: 0=open, 1=closed  # Enumeration{ open, closed }
  integer type t_ReqCentralLocking: base-type=UInt3, compu {raw=phys for phys 0..99}, lower-limit=0, upper-limit=6  # Indicates the type of the generic request for the Central locking system without specifying the actuator and the source of the request
  compu method enum_t_ReqCentralLocking: 0=idle, 1=unlock, 2=lock, 3=safe, 4=comfort_open, 5=comfort_close, 6=selected_unlock  # Enumeration{ idle, unlock, lock, safe, comfort_open, comfort_close, selected_unlock }
  integer type t_ReqSourceCentralLocking: base-type=UInt4, compu {raw=phys for phys 0..99}, lower-limit=0, upper-limit=15  # Information which source sends CentralLockingRequest
  compu method enum_t_ReqSourceCentralLocking: 0=undefined, 1=mechanical_key, 2=remote_key, 3=key_pad, 4=central_lock_master, 5=access_keyless_driver_door, 6=access_keyless_passenger_door, 7=access_keyless_right_rear_door, 8=access_keyless_left_rear_door, 9=access_keyless_rear_lid, 10=access_keyless_undefined, 11..15=further_source1..further_source5  # Enumeration{ undefined, mechanical_key, remote_key, key_pad, central_lock_master, access_keyless_driver_door, access_keyless_passenger_door, access_keyless_right_rear_door, access_keyless_left_rear_door, access_keyless_rear_lid, access_keyless_undefined, further_source1, further_source2, further_source3, further_source4, further_source5 }
  integer type t_country_code: base-type=UInt5, compu {raw=phys for phys 0..99}, lower-limit=0, upper-limit=25  # Indicates the country coding
  compu method enum_t_country_code: 0=t_country_code_australia, 1=t_country_code_belgium, 2=t_country_code_brazil, 3=t_country_code_canada, 4=t_country_code_china, 5=t_country_code_egypt, 6=t_country_code_england, 7=t_country_code_european_community, 8=t_country_code_germany, 9=t_country_code_gulf_region, 10=t_country_code_india, 11=t_country_code_indonesia, 12=t_country_code_invalid_signal, 13=t_country_code_japan, 14=t_country_code_korea, 15=t_country_code_malaysia, 16=t_country_code_mexico, 17=t_country_code_nordic_countries, 18=t_country_code_philippine, 19=t_country_code_rest_of_world, 20=t_country_code_south_africa, 21=t_country_code_switzerland, 22=t_country_code_taiwan, 23=t_country_code_thailand, 24=t_country_code_usa, 25=t_country_code_vietnam  # Enumeration{ t_country_code_australia, t_country_code_belgium, t_country_code_brazil, t_country_code_canada, t_country_code_china, t_country_code_egypt, t_country_code_england, t_country_code_european_community, t_country_code_germany, t_country_code_gulf_region, t_country_code_india, t_country_code_indonesia, t_country_code_invalid_signal, t_country_code_japan, t_country_code_korea, t_country_code_malaysia, t_country_code_mexico, t_country_code_nordic_countries, t_country_code_philippine, t_country_code_rest_of_world, t_country_code_south_africa, t_country_code_switzerland, t_country_code_taiwan, t_country_code_thailand, t_country_code_usa, t_country_code_vietnam }
  integer type t_failure: base-type=UInt0, compu {raw=phys for phys 0..99}, lower-limit=0, upper-limit=1  # This type represents a generic failure condition
  compu method enum_t_failure: 0=t_failure_operational, 1=t_failure_defective  # Enumeration{ t_failure_operational, t_failure_defective }
  integer type t_interval_wiping_speed: base-type=UInt3, compu {raw=phys for phys 0..99}, lower-limit=0, upper-limit=7  # Represents the interval speeds of a window wiper
  compu method enum_t_interval_wiping_speed: 0=t_interval_wiping_speed_implausible, 1..7=t_interval_wiping_speed_interval1..t_interval_wiping_speed_interval7  # Enumeration{ t_interval_wiping_speed_implausible, t_interval_wiping_speed_interval1, t_interval_wiping_speed_interval2, t_interval_wiping_speed_interval3, t_interval_wiping_speed_interval4, t_interval_wiping_speed_interval5, t_interval_wiping_speed_interval6, t_interval_wiping_speed_interval7 }
  integer type t_low_level_washer_fluid: base-type=UInt1, compu {raw=phys for phys 0..99}, lower-limit=0, upper-limit=2  # Provides information if the low limit of washer fluid is reached.
  compu method enum_t_low_level_washer_fluid: 2=t_low_level_washer_fluid_empty, 0=t_low_level_washer_fluid_enough, 1=t_low_level_washer_fluid_low_level  # Enumeration{ t_low_level_washer_fluid_empty, t_low_level_washer_fluid_enough, t_low_level_washer_fluid_low_level }
  integer type t_rainsensing_sensitivity: base-type=UInt3, compu {raw=phys for phys 0..99}, lower-limit=0, upper-limit=7  # This type represents different sensitivity levels for rain-sensing.
  compu method enum_t_rainsensing_sensitivity: 0=t_rainsensing_sensitivity_implausible, 1..7=t_rainsensing_sensitivity_sensitivity1..t_rainsensing_sensitivity_sensitivity7  # Enumeration{ t_rainsensing_sensitivity_implausible, t_rainsensing_sensitivity_sensitivity1, t_rainsensing_sensitivity_sensitivity2, t_rainsensing_sensitivity_sensitivity3, t_rainsensing_sensitivity_sensitivity4, t_rainsensing_sensitivity_sensitivity5, t_rainsensing_sensitivity_sensitivity6, t_rainsensing_sensitivity_sensitivity7 }
  integer type t_wiper_pos_meas: base-type=UInt3, compu {raw=phys for phys 0..99}, lower-limit=0, upper-limit=5  # Defines defined wiper-positions on a window which can be measured
  compu method enum_t_wiper_pos_meas: 5=t_wiper_pos_meas_intermediate_position, 1=t_wiper_pos_meas_lower_reverse_position, 0=t_wiper_pos_meas_park_position, 3=t_wiper_pos_meas_service_position, 2=t_wiper_pos_meas_upper_reverse_position, 4=t_wiper_pos_meas_winter_position  # Enumeration{ t_wiper_pos_meas_intermediate_position, t_wiper_pos_meas_lower_reverse_position, t_wiper_pos_meas_park_position, t_wiper_pos_meas_service_position, t_wiper_pos_meas_upper_reverse_position, t_wiper_pos_meas_winter_position }
  integer type t_wiper_pos_req: base-type=UInt2, compu {raw=phys for phys 0..99}, lower-limit=0, upper-limit=4  # Defines defined wiper-positions on a window which can be requested.
  compu method enum_t_wiper_pos_req: 1=t_wiper_pos_req_lower_reverse_position, 0=t_wiper_pos_req_park_position, 3=t_wiper_pos_req_service_position, 2=t_wiper_pos_req_upper_reverse_position, 4=t_wiper_pos_req_winter_position  # Enumeration{ t_wiper_pos_req_lower_reverse_position, t_wiper_pos_req_park_position, t_wiper_pos_req_service_position, t_wiper_pos_req_upper_reverse_position, t_wiper_pos_req_winter_position }
  integer type t_wiping: base-type=UInt5, compu {raw=phys for phys 0..99}, lower-limit=0, upper-limit=17  # It represents the selection of the interval time or the speed of the wiper. The exact timings and wipe speeds are not standardized and need therefore to be parameterized.
  compu method enum_t_wiping: 1..7=t_wiping_interval1..t_wiping_interval7, 0=t_wiping_Off, 8..15=t_wiping_speed1..t_wiping_speed8, 16=wiping_mode1, 17=wiping_mode2  # Enumeration{ t_wiping_interval1, t_wiping_interval2, t_wiping_interval3, t_wiping_interval4, t_wiping_interval5, t_wiping_interval6, t_wiping_interval7, t_wiping_Off, t_wiping_speed1, t_wiping_speed2, t_wiping_speed3, t_wiping_speed4, t_wiping_speed5, t_wiping_speed6, t_wiping_speed7, t_wiping_speed8, wiping_mode1, wiping_mode2 }
  integer type t_wiping_user_request: base-type=UInt2, compu {raw=phys for phys 0..99}, lower-limit=0, upper-limit=4  # It represents the selection of the interval time or the speed of the wiper requested by the user. The exact timings and wipe speeds are not standardized and need therefore to be parameterized.
  compu method enum_t_wiping_user_request: 4=t_wiping_user_request_high_speed, 2=t_wiping_user_request_interval, 3=t_wiping_user_request_low_speed, 0=t_wiping_user_request_off, 1=t_wiping_user_request_one_strike  # Enumeration{ t_wiping_user_request_high_speed, t_wiping_user_request_interval, t_wiping_user_request_low_speed, t_wiping_user_request_off, t_wiping_user_request_one_strike }
  integer type ActualDamperControlTuning: base-type=UInt3, compu {raw=phys for phys 0..99}, lower-limit=0, upper-limit=7  # Damper tuning mode displayed to the driver
  compu method enum_ActualDamperControlTuning: 0=damper_mode_0, 1=damper_mode_1_comfort, 2=damper_mode_2_standard, 3=damper_mode_3_sport, 4=damper_mode_4_off_road, 5=damper_mode_5, 6=damper_mode_6, 7=damper_mode_7  # Enumeration{ damper_mode_0, damper_mode_1_comfort, damper_mode_2_standard, damper_mode_3_sport, damper_mode_4_off_road, damper_mode_5, damper_mode_6, damper_mode_7 }
  integer type DirectionIndication: base-type=UInt1, compu {raw=phys for phys 0..99}, lower-limit=0, upper-limit=2  # Information about if driver has activated turning indicators, and if so in which direction (left/right).
  compu method enum_DirectionIndication: 0=off, 1=left, 2=right  # Enumeration{ off, left, right }
  integer type BrakeActuatorMode: base-type=UInt2, compu {raw=phys for phys 0..99}, lower-limit=0, upper-limit=4  # Indicates the action executed by the brake actuator or its state, with regards to parking brake functionality
  compu method enum_BrakeActuatorMode: 0=released, 1=during_release, 2=during_apply, 3=applied, 4=dynamic_braking_control  # Enumeration{ released, during_release, during_apply, applied, dynamic_braking_control }
  integer type BrakeActuatorSaturation: base-type=UInt1, compu {raw=phys for phys 0..99}, lower-limit=0, upper-limit=2  # indicates that a brake actuator is in saturation mode
  compu method enum_BrakeActuatorSaturation: 0=No_saturation, 1=Act_Lim_Saturation, 2=Road_Frict_Saturation  # Enumeration{ No_saturation, Act_Lim_Saturation, Road_Frict_Saturation }
  integer type EPBActuatorMode: base-type=UInt3, compu {raw=phys for phys 0..99}, lower-limit=0, upper-limit=7  # Indicates the action executed by the parking brake actuator or its state.
  compu method enum_EPBActuatorMode: 0=released, 1=during_release, 2=during_apply, 3=applied, 4=dynamic_braking_control, 5=feedback_5, 6=feedback_6, 7=feedback_7  # Enumeration{ released, during_release, during_apply, applied, dynamic_braking_control, feedback_5, feedback_6, feedback_7 }
  integer type EPBControlButtonState: base-type=UInt3, compu {raw=phys for phys 0..99}, lower-limit=0, upper-limit=7  # Indicates the state of EPB control button. Note: depending on implementation of HMI. Case 1: push only type will use values 0,3,4 Case 2: push/pull type will use values 0,1,2,4 More info can be added in the reserved bits, e.g. qualifiers or states for fail degraded operation, see also generic qualifier concept
  compu method enum_EPBControlButtonState: 0=No_request, 1=Apply_request, 2=Release_request, 3=Activated, 4=unknown, 5=Reserved_5, 6=Reserved_6, 7=Reserved_7  # Enumeration{ No_request, Apply_request, Release_request, Activated, unknown, Reserved_5, Reserved_6, Reserved_7 }
  integer type HoldOnDemand_state: base-type=UInt1, compu {raw=phys for phys 0..99}, lower-limit=0, upper-limit=2  # Indicates a failure state of the HOD fuction
  compu method enum_HoldOnDemand_state: 0=HOD_available, 1=HOD_not_available_vehicle_moving, 2=HOD_not_available_failure  # Enumeration{ HOD_available, HOD_not_available_vehicle_moving, HOD_not_available_failure }
  integer type PulseGeneratorMode: base-type=UInt3, compu {raw=phys for phys 0..99}, lower-limit=0, upper-limit=7  # Switch that enables / disables the pulse generator (for haptic driver feedback / vibration) which residues within the low level actuator SW Component. Mode definition has to be decided on project level (e.g.: set of amplitude, direction,etc.)
  compu method enum_PulseGeneratorMode: 0..7=Pulse_Mode_0..Pulse_Mode_7  # Enumeration{ Pulse_Mode_0, Pulse_Mode_1, Pulse_Mode_2, Pulse_Mode_3, Pulse_Mode_4, Pulse_Mode_5, Pulse_Mode_6, Pulse_Mode_7 }
  integer type SSM2EPBRequestType: base-type=UInt2, compu {raw=phys for phys 0..99}, lower-limit=0, upper-limit=3  # Status of SSM to EPB that indicates whether a vehicle decelleration force is requested. Here other types of commands can be added for specific purposes. NOTE ON SELF-LOCKING: Due to mechanical self-locking properties of EPB actuator, once a traget is reached and no decrease/increase request is set by SSM, no changes in nominal torque at EPB brake is expected. Hence, control path is as follows: 1) SSM sets target torque and &quot;EPB_actuator_set&quot;: command to EPB set 2) EPB actuator applies to target and feeds back actual torque via EPBActuatorTorque 3) as soon as target torque at EPB is reached, &quot;applied&quot; is set at EPBActuatorMode 4) now SSM2EPBRequestType can be set to &quot;No_Change_Request&quot;; EPB actuator remains on target due to self-locking If new target has to be reached (e.g. release to 0 Nm or increase torque), the process starts again; the same applies if e.g. due to brakes cooling, the actuator feeds back a decrease in torque via EPBActuatorTorque and SSM sets again the (same) torque target to the EPB. Alternatively, for brake cooling adjustment, also DIY EPB can be implemented (see also note to EPBActuatorMode)
  compu method enum_SSM2EPBRequestType: 0=No_Change_Request, 1=EPB_actuator_set, 2=Special_Mode, 3=Reserved  # Enumeration{ No_Change_Request, EPB_actuator_set, Special_Mode, Reserved }
  integer type SSM2ESCVehicleBrakeTorqueRequestType: base-type=UInt3, compu {raw=phys for phys 0..99}, lower-limit=0, upper-limit=7  # Indicates whether a vehicle deceleration force is requested. More modes can be required here NOTE ON SELF-UNLOCKING PROPERTIES OF SERVICE BRAKE: since the wheel brakes are designed to be self-unlocking,
  compu method enum_SSM2ESCVehicleBrakeTorqueR: 0=No_Request, 1=Command_to_ESC_set, 2=Dynamic_Braking_Request, 3..7=Reserved_3..Reserved_7  # Enumeration{ No_Request, Command_to_ESC_set, Dynamic_Braking_Request, Reserved_3, Reserved_4, Reserved_5, Reserved_6, Reserved_7 }
  integer type StatusESC: base-type=UInt2, compu {raw=phys for phys 0..99}, lower-limit=0, upper-limit=4  # Information on activation/ deactivation of ESC
  compu method enum_StatusESC: 0=Init, 1=OK, 2=Temporary_Error, 3=Permanent_Error, 4=User_Off  # Enumeration{ Init, OK, Temporary_Error, Permanent_Error, User_Off }
  integer type SwitchableSpringStatus: base-type=UInt1, compu {raw=phys for phys 0..99}, lower-limit=0, upper-limit=2  # Status provided by switchable spring
  compu method enum_SwitchableSpringStatus: 0=on, 1=off, 2=fault  # Enumeration{ on, off, fault }
  integer type VehicleMotionState: base-type=UInt2, compu {raw=phys for phys 0..99}, lower-limit=0, upper-limit=3  # Information about if vehicle is moving forward or backward or if it is in stand-still. On project level tolerances in speed and hysteresis needs to be defined
  compu method enum_VehicleMotionState: 0=Rolling_backward, 1=Stand_Still, 2=Rolling_forward, 3=Unknown  # Enumeration{ Rolling_backward, Stand_Still, Rolling_forward, Unknown }
  integer type ErrorStatusSteeringBSTS: base-type=UInt2, compu {raw=phys for phys 0..99}, lower-limit=0, upper-limit=3  # steering status visualisation BSTS error lamp (red), warning lamp (yellow) and/ or acoustic signal.
  compu method enum_ErrorStatusSteeringBSTS: 0..3=Error_Status_0..Error_Status_3  # Enumeration{ Error_Status_0, Error_Status_1, Error_Status_2, Error_Status_3 }
  integer type ErrorStatusSteeringBSAS: base-type=UInt2, compu {raw=phys for phys 0..99}, lower-limit=0, upper-limit=3  # steering status visualisation BSAS error lamp (red), warning lamp (yellow) and/ or acoustic signal.
  compu method enum_ErrorStatusSteeringBSAS: 0..3=Error_Status_0..Error_Status_3  # Enumeration{ Error_Status_0, Error_Status_1, Error_Status_2, Error_Status_3 }
  integer type ErrorStatusSteeringBRWS: base-type=UInt2, compu {raw=phys for phys 0..99}, lower-limit=0, upper-limit=3  # steering status visualisation BRWS error lamp (red), warning lamp (yellow) and/ or acoustic signal.
  compu method enum_ErrorStatusSteeringBRWS: 0..3=Error_Status_0..Error_Status_3  # Enumeration{ Error_Status_0, Error_Status_1, Error_Status_2, Error_Status_3 }
  integer type ActualBodyLevelMode: base-type=UInt3, compu {raw=phys for phys 0..99}, lower-limit=0, upper-limit=5  # Actual or target body level displayed to the driver and provided to other systems. (Actual in case of BodyLevelControl==HOLD)
  compu method enum_ActualBodyLevelMode: 0=Low, 1=Normal, 2=High, 3=Reserved_3, 4=Reserved_4, 5=Reserved_5  # Enumeration{ Low, Normal, High, Reserved_3, Reserved_4, Reserved_5 }
  integer type ActiveDamperStatus: base-type=UInt3, compu {raw=phys for phys 0..99}, lower-limit=0, upper-limit=5  # Status provided by the semi-active or switchable damper. Status of the damper system (not damper individual).
  compu method enum_ActiveDamperStatus: 0=on, 1=off, 2=fault, 3=Reserved_3, 4=Reserved_4, 5=Reserved_5  # Enumeration{ on, off, fault, Reserved_3, Reserved_4, Reserved_5 }
  integer type ActiveStabilizerStatus: base-type=UInt3, compu {raw=phys for phys 0..99}, lower-limit=0, upper-limit=5  # Status provided by the active or switchable stabilizer on one axle
  compu method enum_ActiveStabilizerStatus: 0=on, 1=open, 2=closed, 3=off, 4=fault, 5=Reserved_5  # Enumeration{ on, open, closed, off, fault, Reserved_5 }
  integer type ActualSuspensionControlTuning: base-type=UInt3, compu {raw=phys for phys 0..99}, lower-limit=0, upper-limit=5  # Suspension tuning mode displayed to driver and provided to other systems.
  compu method enum_ActualSuspensionControlTun: 0=susp_mode_0_standard, 1=susp_mode_1_comfort, 2=susp_mode_2_sport, 3=susp_mode_3_off_road, 4=Reserved_4, 5=Reserved_5  # Enumeration{ susp_mode_0_standard, susp_mode_1_comfort, susp_mode_2_sport, susp_mode_3_off_road, Reserved_4, Reserved_5 }
  integer type BodyLevelActuatorStatus: base-type=UInt3, compu {raw=phys for phys 0..99}, lower-limit=0, upper-limit=5  # Status provided by body level actuator system.
  compu method enum_BodyLevelActuatorStatus: 0=on, 1=off, 2=fault, 3=Reserved_3, 4=Reserved_4, 5=Reserved_5  # Enumeration{ on, off, fault, Reserved_3, Reserved_4, Reserved_5 }
  integer type BodyLevelControl: base-type=UInt3, compu {raw=phys for phys 0..99}, lower-limit=0, upper-limit=5  # Activity of the body level control. Direction of the body movement
  compu method enum_BodyLevelControl: 0=hold, 1=up, 2=down, 3=Reserved_3, 4=Reserved_4, 5=Reserved_5  # Enumeration{ hold, up, down, Reserved_3, Reserved_4, Reserved_5 }
  integer type FullActiveSuspensionStatus: base-type=UInt3, compu {raw=phys for phys 0..99}, lower-limit=0, upper-limit=5  # Status provided by full active suspension system (ON, OFF, FAULT).
  compu method enum_FullActiveSuspensionStatus: 0=on, 1=off, 2=fault, 3=Reserved_3, 4=Reserved_4, 5=Reserved_5  # Enumeration{ on, off, fault, Reserved_3, Reserved_4, Reserved_5 }
  integer type EPBActuatorStatus: base-type=UInt0, compu {raw=phys for phys 0..99}, lower-limit=0, upper-limit=1  # Indicates the fault state of the parking brake actuators
  compu method enum_EPBActuatorStatus: 0=no_fault, 1=fault  # Enumeration{ no_fault, fault }
  integer type SSM2EPBRequestStatus: base-type=UInt0, compu {raw=phys for phys 0..99}, lower-limit=0, upper-limit=1  # Indicates a failure state of the SSM requests to EPB brake system
  compu method enum_SSM2EPBRequestStatus: 0=no_fault, 1=fault  # Enumeration{ no_fault, fault }
  integer type SSM2ESCRequestStatus: base-type=UInt0, compu {raw=phys for phys 0..99}, lower-limit=0, upper-limit=1  # Indicates a failure state of the SSM requests to ESC brake system
  compu method enum_SSM2ESCRequestStatus: 0=no_fault, 1=fault  # Enumeration{ no_fault, fault }
  integer type WheelRotationalDirectionStandard: base-type=UInt0, compu {raw=phys for phys 0..99}, lower-limit=0, upper-limit=1  # scalar assigned to one wheel which indicates if the wheel is moving ahead/standstill or in reverse
  compu method enum_WheelRotationalDirectionSt: 0=wheel_aheadORstandstill, 1=wheel_reverse  # Enumeration{ wheel_aheadORstandstill, wheel_reverse }
package /AUTOSAR/SwBaseTypes
  58 x base type, all with category=FIXED_LENGTH:
    SInt1: base-type-size=1  # 1 bit signed integer
    SInt{10..15}: base-type-size={10..15}  # {10..15} bit signed integer
    SInt{17..19}: base-type-size={17..19}  # {17..19} bit signed integer
    SInt2: base-type-size=2  # 2 bit signed integer
    SInt{20..29}: base-type-size={20..29}  # {20..29} bit signed integer
    SInt3: base-type-size=3  # 3 bit signed integer
    SInt30: base-type-size=30  # 30 bit signed integer
    SInt31: base-type-size=31  # 31 bit signed integer
    SInt{4..7}: base-type-size={4..7}  # {4..7} bit signed integer
    SInt9: base-type-size=9  # 9 bit signed integer
    UInt1: base-type-size=1  # 1 bit unsigned integer
    UInt{10..15}: base-type-size={10..15}  # {10..15} bit unsigned integer
    UInt{17..19}: base-type-size={17..19}  # {17..19} bit unsigned integer
    UInt2: base-type-size=2  # 2 bit unsigned integer
    UInt{20..29}: base-type-size={20..29}  # {20..29} bit unsigned integer
    UInt3: base-type-size=3  # 3 bit unsigned integer
    UInt30: base-type-size=30  # 30 bit unsigned integer
    UInt31: base-type-size=31  # 31 bit unsigned integer
    UInt{4..7}: base-type-size={4..7}  # {4..7} bit unsigned integer
    UInt9: base-type-size=9  # 9 bit unsigned integer
