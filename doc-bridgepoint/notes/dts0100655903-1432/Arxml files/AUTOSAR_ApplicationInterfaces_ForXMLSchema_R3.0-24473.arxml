[part 3 of 4: package /AUTOSAR/ComponentTypes]
AUTOSAR XML (schema 3.0.2)
# Development Partnership. The AUTOSAR Development Partnership will not be liable
# for any use of this specification. Following the completion of the development
# of the AUTOSAR specifications commercial exploitation licenses will be made
# available to end users by way of written License Agreement only.
# No part of this publication may be reproduced or utilized in any form or by any
# means, electronic or mechanical, including photocopying and microfilm, without
# permission in writing from the publisher." The word AUTOSAR and the AUTOSAR logo
# are registered trademarks.
# Copyright © 2004-2008 AUTOSAR Development Partnership. All rights reserved.
# items are licensed under the same rules as applicable to the AUTOSAR Standard.
package /AUTOSAR/ComponentTypes  (continued)
  83 x composition type:  (continued)
    CentralLockingMaster
      20 x provide port:
        DriverDoorLockingCmd: provided-interface=CmdLock
        PassengerDoorLockingCmd: provided-interface=CmdLock
        RearLeftDoorLockingCmd: provided-interface=CmdLock
        RearRightDoorLockingCmd: provided-interface=CmdLock
        RearLidLockingCmd: provided-interface=CmdLock
        BackliteWindowLockingCmd: provided-interface=CmdLock
        RearLeftDoorChildDoorCmd: provided-interface=CmdChildProt
        RearRightDoorChildDoorCmd: provided-interface=CmdChildProt
        DriverDoorPullAid: provided-interface=CmdPullAid
        PassengerDoorPullAid: provided-interface=CmdPullAid
        RearLeftDoorPullAid: provided-interface=CmdPullAid
        RearRightDoorPullAid: provided-interface=CmdPullAid
        RearLidPullAid: provided-interface=CmdPullAid
        BackliteWindowPullAid: provided-interface=CmdPullAid
        TankFlapLockingCmd: provided-interface=CmdLock
        GloveboxLockingCmd: provided-interface=CmdLock
        ComfortOpenClose: provided-interface=ReqCentralLocking
        CentralLocking: provided-interface=StaCentralLocking
        LockingFeedback: provided-interface=ReqLockingFeedback
        StaHotelMode: provided-interface=StaHotelMode
      44 x require port:
        EmergencyLocking: required-interface=ReqLockUnlock
        RearLidHMIInt: required-interface=ReqReleaseLatch
        RearLidHMIExt: required-interface=ReqReleaseLatch
        BackliteWindowHMI: required-interface=ReqReleaseLatch
        TankFlapHMI: required-interface=ReqReleaseLatch
        GloveBoxHMI: required-interface=ReqToggle
        AccessKeyless: required-interface=ReqCentralLocking
        AccessRemoteKey: required-interface=ReqCentralLocking
        AccessRemoteRearLid: required-interface=ReqCentralLocking
        VehicleLongitudinalSpeed: required-interface=VehicleLongitudinalSpeed
        Crash: required-interface=StaCrash
        Voltage: required-interface=BatteryVoltage
        DriverDoorState: required-interface=StaDoor
        PassengerDoorState: required-interface=StaDoor
        RearLeftDoorState: required-interface=StaDoor
        RearRightDoorState: required-interface=StaDoor
        RearLidState: required-interface=StaDoor
        BackliteWindowState: required-interface=StaDoor
        DriverDoorMechKey: required-interface=ReqCentralLocking
        PassengerDoorMechKey: required-interface=ReqCentralLocking
        RearLeftDoorMechKey: required-interface=ReqCentralLocking
        RearRightDoorMechKey: required-interface=ReqCentralLocking
        RearLidMechKey: required-interface=ReqCentralLocking
        DriverDoorLockState: required-interface=StaLock
        PassengerDoorLockState: required-interface=StaLock
        RearLeftDoorLockState: required-interface=StaLock
        RearRightDoorLockState: required-interface=StaLock
        RearLidLockState: required-interface=StaLock
        BackliteWindowLockState: required-interface=StaLock
        RearLeftDoorChildDoorState: required-interface=StaChildProt
        RearRightDoorChildDoorState: required-interface=StaChildProt
        DriverDoorKeypadDoor: required-interface=ReqCentralLocking
        PassengerDoorKeypadDoor: required-interface=ReqCentralLocking
        RearLeftKeypadDoor: required-interface=ReqCentralLocking
        RearRightKeypadDoor: required-interface=ReqCentralLocking
        RearLidKeypadDoor: required-interface=ReqCentralLocking
        DriverDoorKeypadRearLid: required-interface=ReqCentralLocking
        PassengerDoorKeypadRearLid: required-interface=ReqCentralLocking
        RearLeftDoorKeypadRearLid: required-interface=ReqCentralLocking
        RearRightDoorKeypadRearLid: required-interface=ReqCentralLocking
        RearLidKeypadRearLid: required-interface=ReqCentralLocking
        TankFlapLockingState: required-interface=StaLock
        GloveboxState: required-interface=StaOpenClosed
        GloveboxLockState: required-interface=StaLock
    DriverDoorLock
      provide port DriverDoorState: provided-interface=StaDoor
      provide port DriverDoorMechKey: provided-interface=ReqCentralLocking
      provide port DriverDoorLockState: provided-interface=StaLock
      require port DriverDoorLockingCmd: required-interface=CmdLock
      require port DriverDoorPullAid: required-interface=CmdPullAid
    PassengerDoorLock
      provide port PassengerDoorState: provided-interface=StaDoor
      provide port PassengerDoorMechKey: provided-interface=ReqCentralLocking
      provide port PassengerDoorLockState: provided-interface=StaLock
      require port PassengerDoorLockingCmd: required-interface=CmdLock
      require port PassengerDoorPullAid: required-interface=CmdPullAid
    RearLeftDoorLock
      4 x provide port:
        RearLeftDoorState: provided-interface=StaDoor
        RearLeftDoorMechKey: provided-interface=ReqCentralLocking
        RearLeftDoorLockState: provided-interface=StaLock
        RearLeftDoorChildDoorState: provided-interface=StaChildProt
      require port RearLeftDoorLockingCmd: required-interface=CmdLock
      require port RearLeftDoorChildDoorCmd: required-interface=CmdChildProt
      require port RearLeftDoorPullAid: required-interface=CmdPullAid
    RearRightDoorLock
      4 x provide port:
        RearRightDoorState: provided-interface=StaDoor
        RearRightDoorMechKey: provided-interface=ReqCentralLocking
        RearRightDoorLockState: provided-interface=StaLock
        RearRightDoorChildDoorState: provided-interface=StaChildProt
      require port RearRightDoorLockingCmd: required-interface=CmdLock
      require port RearRightDoorChildDoorCmd: required-interface=CmdChildProt
      require port RearRightDoorPullAid: required-interface=CmdPullAid
    RearLidDoorLock
      provide port RearLidState: provided-interface=StaDoor
      provide port RearLidMechKey: provided-interface=ReqCentralLocking
      provide port RearLidLockState: provided-interface=StaLock
      require port RearLidLockingCmd: required-interface=CmdLock
      require port RearLidPullAid: required-interface=CmdPullAid
    BackliteWindowDoorLock
      provide port BackliteWindowState: provided-interface=StaDoor
      provide port BackliteWindowLockState: provided-interface=StaLock
      require port BackliteWindowLockingCmd: required-interface=CmdLock
      require port BackliteWindowPullAid: required-interface=CmdPullAid
    GloveBox
      provide port GloveboxState: provided-interface=StaOpenClosed
      provide port GloveboxLockState: provided-interface=StaLock
      require port GloveboxLockingCmd: required-interface=CmdLock
    TankFlap
      provide port TankFlapLockingState: provided-interface=StaLock
      require port TankFlapLockingCmd: required-interface=CmdLock
    InteriorLight
      29 x require port:
        CentralLocking: required-interface=StaCentralLocking
        AccessKeyless: required-interface=ReqCentralLocking
        AccessRemoteKey: required-interface=ReqCentralLocking
        VehicleLongitudinalSpeed: required-interface=VehicleLongitudinalSpeed
        Voltage: required-interface=BatteryVoltage
        DriverDoorState: required-interface=StaDoor
        PassengerDoorState: required-interface=StaDoor
        RearLeftDoorState: required-interface=StaDoor
        RearRightDoorState: required-interface=StaDoor
        RearLidState: required-interface=StaDoor
        BackliteWindowState: required-interface=StaDoor
        DriverDoorMechKey: required-interface=ReqCentralLocking
        PassengerDoorMechKey: required-interface=ReqCentralLocking
        RearLeftDoorMechKey: required-interface=ReqCentralLocking
        RearRightDoorMechKey: required-interface=ReqCentralLocking
        RearLidMechKey: required-interface=ReqCentralLocking
        CabinLightFnCeIntLightHMI: required-interface=ReqIntLight
        HazardWarningSwitchIlluminationIntLightHMI: required-interface=ReqIntLight
        DashBoardBrightness: required-interface=ReqBrightness
        OutsideBrightness: required-interface=StaOutsideBrightness
        GlobalDimLight: required-interface=CmdGlobalDimLight
        LowBeamInd: required-interface=DisExtLight
        DisplayParkingLights: required-interface=DisParkingLights
        CHLHome: required-interface=ReqComingHomeLeavingHome
        CarFinder: required-interface=ReqCarFinder
        VisualAlarm: required-interface=ReqVisualAlarm
        Crash: required-interface=StaCrash
        HazardWarning: required-interface=DisExtLight
        NightPanelActive: required-interface=ReqNightPanel
      component InteriorLightManager: type=InteriorLightManager
      component CabinLightFnCe: type=InteriorLightActuator
      component HazardWarningSwitchIllumination: type=InteriorLightActuator
      connect CabinLightFnCe.Fault -> InteriorLightManager.CabinLightFnCeFault
      connect HazardWarningSwitchIllumination.Fault -> InteriorLightManager.HazardWarningSwitchIlluminationFault
      connect InteriorLightManager.CabinLightFnCeActivation -> CabinLightFnCe.Activation
      connect InteriorLightManager.HazardWarningSwitchIlluminationActivation -> HazardWarningSwitchIllumination.Activation
      delegate InteriorLightManager.CentralLocking <-> outer port InteriorLight/CentralLocking
      delegate InteriorLightManager.AccessKeyless <-> outer port InteriorLight/AccessKeyless
      delegate InteriorLightManager.AccessRemoteKey <-> outer port InteriorLight/AccessRemoteKey
      delegate InteriorLightManager.VehicleLongitudinalSpeed <-> outer port InteriorLight/VehicleLongitudinalSpeed
      delegate CabinLightFnCe.Voltage <-> outer port InteriorLight/Voltage
      delegate HazardWarningSwitchIllumination.Voltage <-> outer port InteriorLight/Voltage
      delegate InteriorLightManager.DriverDoorState <-> outer port InteriorLight/DriverDoorState
      delegate InteriorLightManager.PassengerDoorState <-> outer port InteriorLight/PassengerDoorState
      delegate InteriorLightManager.RearLeftDoorState <-> outer port InteriorLight/RearLeftDoorState
      delegate InteriorLightManager.RearRightDoorState <-> outer port InteriorLight/RearRightDoorState
      delegate InteriorLightManager.RearLidState <-> outer port InteriorLight/RearLidState
      delegate InteriorLightManager.BackliteWindowState <-> outer port InteriorLight/BackliteWindowState
      delegate InteriorLightManager.DriverDoorMechKey <-> outer port InteriorLight/DriverDoorMechKey
      delegate InteriorLightManager.PassengerDoorMechKey <-> outer port InteriorLight/PassengerDoorMechKey
      delegate InteriorLightManager.RearLeftDoorMechKey <-> outer port InteriorLight/RearLeftDoorMechKey
      delegate InteriorLightManager.RearRightDoorMechKey <-> outer port InteriorLight/RearRightDoorMechKey
      delegate InteriorLightManager.RearLidMechKey <-> outer port InteriorLight/RearLidMechKey
      delegate InteriorLightManager.CabinLightFnCeIntLightHMI <-> outer port InteriorLight/CabinLightFnCeIntLightHMI
      delegate InteriorLightManager.HazardWarningSwitchIlluminationIntLightHMI <-> outer port InteriorLight/HazardWarningSwitchIlluminationIntLightHMI
      delegate InteriorLightManager.DashBoardBrightness <-> outer port InteriorLight/DashBoardBrightness
      delegate InteriorLightManager.OutsideBrightness <-> outer port InteriorLight/OutsideBrightness
      delegate InteriorLightManager.GlobalDimLight <-> outer port InteriorLight/GlobalDimLight
      delegate InteriorLightManager.LowBeamInd <-> outer port InteriorLight/LowBeamInd
      delegate InteriorLightManager.DisplayParkingLights <-> outer port InteriorLight/DisplayParkingLights
      delegate InteriorLightManager.CHLHome <-> outer port InteriorLight/CHLHome
      delegate InteriorLightManager.CarFinder <-> outer port InteriorLight/CarFinder
      delegate InteriorLightManager.VisualAlarm <-> outer port InteriorLight/VisualAlarm
      delegate InteriorLightManager.Crash <-> outer port InteriorLight/Crash
      delegate CabinLightFnCe.HazardWarning <-> outer port InteriorLight/HazardWarning
      delegate HazardWarningSwitchIllumination.HazardWarning <-> outer port InteriorLight/HazardWarning
      delegate InteriorLightManager.NightPanelActive <-> outer port InteriorLight/NightPanelActive
    InteriorLightManager
      provide port CabinLightFnCeActivation: provided-interface=CmdBrightness
      provide port HazardWarningSwitchIlluminationActivation: provided-interface=CmdBrightness
      29 x require port:
        CentralLocking: required-interface=StaCentralLocking  # automatic re-lock of car may require interior light activity (use case: automatic re-lock of the car after user has - maybe unintenionally - unlocked the car but not opened any door)
        AccessKeyless: required-interface=ReqCentralLocking  # Activation or deactivation of interior light if car is locked or unlocked by keyless-entry system. Access request (from detected source) to lock / unlock the latch from keyless entry system may trigger interior light activities. HINT: Init Value is {undefined; idle}
        AccessRemoteKey: required-interface=ReqCentralLocking  # Activation or deactivation of interior light if car is locked or unlocked by remote key. Access request generated e.g. by remote key receiver unit may trigger interior light activities. The content is derived from the user request by remote key.
        VehicleLongitudinalSpeed: required-interface=VehicleLongitudinalSpeed  # certain int.light sources may switched off above certain speed
        DriverDoorState: required-interface=StaDoor  # Information whether the driver door is open or closed. Activation of the interior lights if one of the doors was opened.
        PassengerDoorState: required-interface=StaDoor  # Information whether the passenger door is open or closed. Activation of the interior lights if one of the doors was opened.
        RearLeftDoorState: required-interface=StaDoor  # Information whether the rear door is open or closed. Activation of the interior lights if one of the doors was opened.
        RearRightDoorState: required-interface=StaDoor  # Information whether the rear door is open or closed. Activation of the interior lights if one of the doors was opened.
        RearLidState: required-interface=StaDoor  # Information whether the rear lid is open or closed. Activation of the interior lights if one of the doors was opened.
        BackliteWindowState: required-interface=StaDoor  # information whether the backlite window is open or closed. Activation of the interior lights if one of the doors was opened.
        DriverDoorMechKey: required-interface=ReqCentralLocking  # Activation or deactivation of interior light if car is locked or unlocked by mechanical driver/passenger door lock. Mechanical key can also request comfort close and comfort open. The request for comfort open may not always be allowed, depending on the security status of the vehicle. Unlocking and locking of doors can trigger interior light activities.
        PassengerDoorMechKey: required-interface=ReqCentralLocking  # Activation or deactivation of interior light if car is locked or unlocked by mechanical driver/passenger door lock. Mechanical key can also request comfort close and comfort open. The request for comfort open may not always be allowed, depending on the security status of the vehicle.
        RearLeftDoorMechKey: required-interface=ReqCentralLocking  # Activation or deactivation of interior light if car is locked or unlocked by mechanical driver/passenger door lock. Mechanical key can also request comfort close and comfort open. The request for comfort open may not always be allowed, depending on the security status of the vehicle. Note - might be applicable for Sliding Doors too!
        RearRightDoorMechKey: required-interface=ReqCentralLocking  # Activation or deactivation of interior light if car is locked or unlocked by mechanical driver/passenger door lock. Mechanical key can also request comfort close and comfort open. The request for comfort open may not always be allowed, depending on the security status of the vehicle. Note - might be applicable for Sliding Doors too!
        RearLidMechKey: required-interface=ReqCentralLocking  # Activation or deactivation of interior light if car is locked or unlocked by mechanical driver/passenger door lock. Mechanical key can also request comfort close and comfort open. The request for comfort open may not always be allowed, depending on the security status of the vehicle.
        CabinLightFnCeIntLightHMI: required-interface=ReqIntLight  # User request to activate / deactivate cabin_light_front_middle (switch on/off or automatic mode). Please note that this port is representative for many other ports [IntLightSrc]HMI used to request to activate / deactivate an interior light actuator denoted by [Int-LightSrc] or a virtual interior light group also denoted by [IntLightSrc]. This interface is not necessary for each interior light actuator, it is not intended for hardwired interior lights.Comment: this interface is specific to interior lighting. User requests within exterior lighting are of type switch on/off.
        HazardWarningSwitchIlluminationIntLightHMI: required-interface=ReqIntLight
        DashBoardBrightness: required-interface=ReqBrightness  # Interior Light Manager requires information how to set dashboard brightness (e.g. sets the illumination brightness of the instrument cluster). Tradionally the driver interface is a potentiometer.
        OutsideBrightness: required-interface=StaOutsideBrightness  # Activation or brightness of the interior lights may depend on the outside brightness (quantized in some levels. These values need to be calibrated against light levels for each car).
        GlobalDimLight: required-interface=CmdGlobalDimLight  # This interface gives the information of the actual outside brightness (0% means full darkness; 100% means maximum brightness.). E.g. exterior or interior light can use this information to adapt their own dimming calculation depending on outside brightness by means of smooth transitions (e.g. ramp resulting from switching from &quot;night&quot; to &quot;twi-light_1&quot;). HINT: might be calculated from StaOutsideBrightness in order to allow smooth transitions (e.g. ramp or visual effects of exterior or interior light) while switching e.g. from &quot;night&quot; to &quot;twilight_1&quot;.
        LowBeamInd: required-interface=DisExtLight  # Activation of the interior lights may depend on the status of the low beam. (Use case: after switching ignition off, activate the interior lights only if the low beams currently or a short time before are switched on). Information supposed to be provided by exterior light as feedback to e.g. the MMI whether the lowbeam lights are to be displayed as active.
        DisplayParkingLights: required-interface=DisParkingLights  # Activation of the interior lights may depend on the status of the park-ing lights. (Use case: Instrument cluster is illuminated when parking lights are switched on by driver.) Information is supposed to be provided by exterior light as feedback to e.g. the MMI whether the left parking lights are to be displayed as active.
        CHLHome: required-interface=ReqComingHomeLeavingHome  # (De-)Activate interior light(s) in case of &quot;coming/leaving home&quot; request. This seems at a first glance redundant information, as also ReqAccess_* is available. Using also ReqChlh allows synchronization with exterior light to illuminate the car internally and externally at the same time. Addition-ally it allows coordinated reactions to the outside brightness (i.e. should avoid that CHLH functionality starts, but interior light does not start due to different activation levels of the outside brightness.
        CarFinder: required-interface=ReqCarFinder  # Demand to activate/ deactivate carfinder functionality. May activate interior light(s) in order to easily find the car at night.
        VisualAlarm: required-interface=ReqVisualAlarm  # Request alarm blinking e.g. in case of an unauthorized car access detected by the alarm system. May also trigger interior light activities in case of theft alarm.
        Crash: required-interface=StaCrash  # The current crash status is required (values like pre-crash, post-crash, ... ). May also trigger interior light activities.
        CabinLightFnCeFault: required-interface=StaLightFault
        HazardWarningSwitchIlluminationFault: required-interface=StaLightFault
        NightPanelActive: required-interface=ReqNightPanel  # &quot;Night-Panel-Switch&quot; (e.g. switch for dimming down all interior lights except for speedometer)
    InteriorLightActuator
      provide port Fault: provided-interface=StaLightFault  # initial value: operational
      require port Voltage: required-interface=BatteryVoltage  # used for over-/under voltage compensation
      require port Activation: required-interface=CmdBrightness  # The brightness of cabin_light_front_middle is requested by InteriorLightManager. The percentage value (independent of light actuator type and environment e.g. voltage of electrical system) depends on the functionality that the light source shall be switched on for.100 percent means full power of the light actuator. High resolution required (less than 1%). Initial value: {0;0}
      require port HazardWarning: required-interface=DisExtLight  # use case: illumination of hazard switch is often used for functional indication too.
    MirrorAdjustment
      provide port MirrorMoveStatus: provided-interface=StaMirrorMove
      provide port MirrorPosition: provided-interface=StaMirrorPos
      15 x require port:
        MirrorManualMovementHMI: required-interface=ReqManAdjustPanel
        MirrorAutoAdjStorePr0HMI: required-interface=ReqAutoAdjustPanelMirror
        MirrorAutoAdjReStorePr0HMI: required-interface=ReqAutoAdjustPanelMirror
        MirrorAutoAdjStorePr1HMI: required-interface=ReqAutoAdjustPanelMirror
        MirrorAutoAdjReStorePr1HMI: required-interface=ReqAutoAdjustPanelMirror
        MirrorAutoAdjStorePr2HMI: required-interface=ReqAutoAdjustPanelMirror
        MirrorAutoAdjReStorePr2HMI: required-interface=ReqAutoAdjustPanelMirror
        MirrorAutoAdjStorePr3HMI: required-interface=ReqAutoAdjustPanelMirror
        MirrorAutoAdjReStorePr3HMI: required-interface=ReqAutoAdjustPanelMirror
        AccessRemoteKey: required-interface=ReqCentralLocking
        AccessKeyless: required-interface=ReqCentralLocking
        ActualGear: required-interface=ActualGear
        Voltage: required-interface=BatteryVoltage
        VehicleLongitudinalSpeed: required-interface=VehicleLongitudinalSpeed
        CentralLocking: required-interface=StaCentralLocking
      5 x component:
        AutoAdjustUserRequestManagerMirror: type=AutoAdjustUserRequestManagerMirror
        MirrorAdjustManager: type=MirrorAdjustManager
        MirrorActuator: type=MirrorActuator
        MirrorMemoryAdapter: type=MirrorMemoryAdapter
        MirrorActuatorAdapter: type=MirrorActuatorAdapter
      connect MirrorAdjustManager.MirrorActionState -> AutoAdjustUserRequestManagerMirror.MirrorActionState
      connect AutoAdjustUserRequestManagerMirror.AutoMove -> MirrorAdjustManager.AutoMove
      connect AutoAdjustUserRequestManagerMirror.StorePosition -> MirrorAdjustManager.StorePosition
      connect MirrorAdjustManager.MirrorMove -> MirrorActuatorAdapter.MirrorMove
      connect MirrorAdjustManager.StorePositionMem -> MirrorMemoryAdapter.StorePositionMem
      connect MirrorMemoryAdapter.RestorePosition -> MirrorAdjustManager.RestorePosition
      connect MirrorActuatorAdapter.MirrorActivation -> MirrorActuator.MirrorActivation
      connect MirrorActuator.MirrorMoveStatus -> MirrorActuatorAdapter.MirrorMoveStatus
      connect MirrorActuator.MirrorPosition -> MirrorActuatorAdapter.MirrorPosition
      connect MirrorActuator.MirrorFault -> MirrorActuatorAdapter.MirrorFault
      delegate AutoAdjustUserRequestManagerMirror.MirrorManualMovementHMI <-> outer port MirrorAdjustment/MirrorManualMovementHMI
      delegate MirrorAdjustManager.MirrorManualMovementHMI <-> outer port MirrorAdjustment/MirrorManualMovementHMI
      delegate AutoAdjustUserRequestManagerMirror.MirrorAutoAdjStorePr0HMI <-> outer port MirrorAdjustment/MirrorAutoAdjStorePr0HMI
      delegate AutoAdjustUserRequestManagerMirror.MirrorAutoAdjReStorePr0HMI <-> outer port MirrorAdjustment/MirrorAutoAdjReStorePr0HMI
      delegate AutoAdjustUserRequestManagerMirror.MirrorAutoAdjStorePr1HMI <-> outer port MirrorAdjustment/MirrorAutoAdjStorePr1HMI
      delegate AutoAdjustUserRequestManagerMirror.MirrorAutoAdjReStorePr1HMI <-> outer port MirrorAdjustment/MirrorAutoAdjReStorePr1HMI
      delegate AutoAdjustUserRequestManagerMirror.MirrorAutoAdjStorePr2HMI <-> outer port MirrorAdjustment/MirrorAutoAdjStorePr2HMI
      delegate AutoAdjustUserRequestManagerMirror.MirrorAutoAdjReStorePr2HMI <-> outer port MirrorAdjustment/MirrorAutoAdjReStorePr2HMI
      delegate AutoAdjustUserRequestManagerMirror.MirrorAutoAdjStorePr3HMI <-> outer port MirrorAdjustment/MirrorAutoAdjStorePr3HMI
      delegate AutoAdjustUserRequestManagerMirror.MirrorAutoAdjReStorePr3HMI <-> outer port MirrorAdjustment/MirrorAutoAdjReStorePr3HMI
      delegate AutoAdjustUserRequestManagerMirror.AccessRemoteKey <-> outer port MirrorAdjustment/AccessRemoteKey
      delegate AutoAdjustUserRequestManagerMirror.AccessKeyless <-> outer port MirrorAdjustment/AccessKeyless
      delegate MirrorAdjustManager.ActualGear <-> outer port MirrorAdjustment/ActualGear
      delegate MirrorAdjustManager.Voltage <-> outer port MirrorAdjustment/Voltage
      delegate MirrorAdjustManager.VehicleLongitudinalSpeed <-> outer port MirrorAdjustment/VehicleLongitudinalSpeed
      delegate MirrorAdjustManager.CentralLocking <-> outer port MirrorAdjustment/CentralLocking
      delegate MirrorActuator.MirrorMoveStatus <-> outer port MirrorAdjustment/MirrorMoveStatus
      delegate MirrorActuator.MirrorPosition <-> outer port MirrorAdjustment/MirrorPosition
    AutoAdjustUserRequestManagerMirror
      provide port AutoMove: provided-interface=ReqMirrorAutoMove
      provide port StorePosition: provided-interface=ReqStoreMirrorPos
      12 x require port:
        MirrorManualMovementHMI: required-interface=ReqManAdjustPanel  # User request to move the axis of the mirror manually in a certain direction.
        MirrorAutoAdjStorePr0HMI: required-interface=ReqAutoAdjustPanelMirror  # User request to move the mirror automatically or to store the mirror position to the given profile.
        MirrorAutoAdjReStorePr0HMI: required-interface=ReqAutoAdjustPanelMirror  # User request to move the mirror automatically or to store the mirror position to the given profile.
        MirrorAutoAdjStorePr1HMI: required-interface=ReqAutoAdjustPanelMirror  # User request to move the mirror automatically or to store the mirror position to the given profile.
        MirrorAutoAdjReStorePr1HMI: required-interface=ReqAutoAdjustPanelMirror  # User request to move the mirror automatically or to store the mirror position to the given profile.
        MirrorAutoAdjStorePr2HMI: required-interface=ReqAutoAdjustPanelMirror  # User request to move the mirror automatically or to store the mirror position to the given profile.
        MirrorAutoAdjReStorePr2HMI: required-interface=ReqAutoAdjustPanelMirror  # User request to move the mirror automatically or to store the mirror position to the given profile.
        MirrorAutoAdjStorePr3HMI: required-interface=ReqAutoAdjustPanelMirror  # User request to move the mirror automatically or to store the mirror position to the given profile.
        MirrorAutoAdjReStorePr3HMI: required-interface=ReqAutoAdjustPanelMirror  # User request to move the mirror automatically or to store the mirror position to the given profile.
        AccessRemoteKey: required-interface=ReqCentralLocking  # user access request by remote key resulting in car is locked or unlocked by remote key.
        AccessKeyless: required-interface=ReqCentralLocking  # Access request (from detected source) to lock / unlock the latch from keyless entry system.
        MirrorActionState: required-interface=StaMirrorAction  # Feedback from the mirror manager about the kind of action that is currently running (mirror moving or mirror stopped). It might be necessary to immediately stop automatic positioning if the driver hits any key (panic-stop).
    MirrorAdjustManager
      provide port MirrorActionState: provided-interface=StaMirrorAction
      provide port MirrorMove: provided-interface=ReqMirrorMove
      provide port StorePositionMem: provided-interface=ReqStorePosMemory
      8 x require port:
        MirrorManualMovementHMI: required-interface=ReqManAdjustPanel
        ActualGear: required-interface=ActualGear  # This interface provides the selected gear. This status is provided by the gear box. The selected gear information has to be filtered to e. g. not see in the status the rear position while moving the gear shift lever from park position over rear position to drive position.
        Voltage: required-interface=BatteryVoltage  # This interface provides the actual voltage level as measured at the battery.
        VehicleLongitudinalSpeed: required-interface=VehicleLongitudinalSpeed  # This interface provides the information about the current speed of the car. Note, that this is an absolute value, i.e. a negative physical speed shall appear as a positive value.
        CentralLocking: required-interface=StaCentralLocking  # Status of Central Locking: Use case: folding outer mirrors with locking
        AutoMove: required-interface=ReqMirrorAutoMove  # Request to move the mirror automatically to a certain position. This position could be determined by a user request from the mirror panel, an access from the remote key, a keyless access or if reverse gear was detected, to down outer mirror angle to provide the best view to the curb.
        StorePosition: required-interface=ReqStoreMirrorPos  # Request to store the position of a certain mirror to the corresponding profile number.
        RestorePosition: required-interface=StaMirrorPosMemory  # Memory-position data from storage memory for the current profile of a certain mirror and axis.
    MirrorActuator
      provide port MirrorMoveStatus: provided-interface=StaMirrorMove  # Status of movement of a mirror on an axis in a certain direction.
      provide port MirrorPosition: provided-interface=StaMirrorPos  # Used to retrieve from the actuator the mirror's actual position.
      provide port MirrorFault: provided-interface=StaMirrorFault  # Used as feedback from an actuator component to indicate that the mirror is broken or not. Note that no details of the fault are transmit-ted, but just an operational / defective fault indication. This enables a control component to decide whether a mirror is broken and should not be actuated. Note:The interface is not used for detailed diagnostics.
      require port MirrorActivation: required-interface=CmdMirrorMove  # Command to move the axis in a certain direction.
    MirrorMemoryAdapter
      provide port RestorePosition: provided-interface=StaMirrorPosMemory
      require port StorePositionMem: required-interface=ReqStorePosMemory  # Request to store the position of a certain mirror and axis to the mem-ory position 'profile'.
    MirrorActuatorAdapter
      provide port MirrorActivation: provided-interface=CmdMirrorMove
      4 x require port:
        MirrorMove: required-interface=ReqMirrorMove  # Request to move the axis of the mentioned mirror to the indicated position.
        MirrorMoveStatus: required-interface=StaMirrorMove
        MirrorPosition: required-interface=StaMirrorPos
        MirrorFault: required-interface=StaMirrorFault
    MirrorTinting
      provide port AutoTintStatus: provided-interface=StaAutoTinting
      5 x require port:
        OutsideBrightness: required-interface=StaMirrorOutsideBrightness
        MirrorPosition: required-interface=StaMirrorPos
        MirrorMoveStatus: required-interface=StaMirrorMove
        Voltage: required-interface=BatteryVoltage
        AutoTintRequest: required-interface=ReqAutoTinting
      component TintingValueManager: type=TintingValueManager
      component TintingManager: type=TintingManager
      component TintingActuator: type=TintingActuator
      connect TintingValueManager.TintingValue -> TintingManager.TintingValue
      connect TintingManager.TintingActivation -> TintingActuator.TintingActivation
      connect TintingActuator.TintingStatus -> TintingManager.TintingStatus
      delegate TintingValueManager.OutsideBrightness <-> outer port MirrorTinting/OutsideBrightness
      delegate TintingManager.MirrorPosition <-> outer port MirrorTinting/MirrorPosition
      delegate TintingManager.MirrorMoveStatus <-> outer port MirrorTinting/MirrorMoveStatus
      delegate TintingManager.Voltage <-> outer port MirrorTinting/Voltage
      delegate TintingManager.AutoTintRequest <-> outer port MirrorTinting/AutoTintRequest
      delegate TintingManager.AutoTintStatus <-> outer port MirrorTinting/AutoTintStatus
    TintingValueManager
      provide port TintingValue: provided-interface=ReqTintingValue
      require port OutsideBrightness: required-interface=StaMirrorOutsideBrightness
    TintingManager
      provide port AutoTintStatus: provided-interface=StaAutoTinting  # Status of automatic tinting
      provide port TintingActivation: provided-interface=CmdMirrorTinting
      6 x require port:
        MirrorPosition: required-interface=StaMirrorPos
        MirrorMoveStatus: required-interface=StaMirrorMove
        Voltage: required-interface=BatteryVoltage  # This interface provides the actual voltage level as measured at the battery.
        AutoTintRequest: required-interface=ReqAutoTinting  # user request to set the mirrors tinting automatically
        TintingValue: required-interface=ReqTintingValue  # Deliveres the desired value for mirror tinting.
        TintingStatus: required-interface=StaMirrorTinting  # Current status of tinting as feedback in order to control the tinting command to the actuator component
    TintingActuator
      provide port TintingStatus: provided-interface=StaMirrorTinting
      require port TintingActivation: required-interface=CmdMirrorTinting  # Command for tinting to the actuator component.
    SeatAdjustment
      provide port MassageStatus: provided-interface=StaMassageAdjust
      10 x require port:
        Voltage: required-interface=BatteryVoltage
        ActualGear: required-interface=ActualGear
        VehicleLongitudinalSpeed: required-interface=VehicleLongitudinalSpeed
        CentralLocking: required-interface=StaCentralLocking
        AutoAdjustPanel: required-interface=ReqAutoAdjust
        Entry: required-interface=ReqEntry
        ManAdjustPanel: required-interface=ReqManAdjust
        MassageAdjust: required-interface=ReqMassageAdjust
        DriverDoorState: required-interface=StaDoor
        PassengerDoorState: required-interface=StaDoor
      5 x component:
        AutoAdjustUserRequestManagerSeat: type=AutoAdjustUserRequestManagerSeat
        SeatAdjustManager: type=SeatAdjustManager
        SeatAxisActuator: type=SeatAxisActuator
        SeatMemoryAdapter: type=SeatMemoryAdapter
        SeatActuatorAdapter: type=SeatActuatorAdapter
      connect AutoAdjustUserRequestManagerSeat.AutoMove -> SeatAdjustManager.AutoMove
      connect AutoAdjustUserRequestManagerSeat.StorePos -> SeatAdjustManager.StorePos
      connect SeatAdjustManager.MoveHeight -> SeatActuatorAdapter.MoveHeight
      connect SeatAdjustManager.MoveFrHeight -> SeatActuatorAdapter.MoveFrHeight
      connect SeatAdjustManager.MoveRrHeight -> SeatActuatorAdapter.MoveRrHeight
      connect SeatAdjustManager.MoveSlide -> SeatActuatorAdapter.MoveSlide
      connect SeatAdjustManager.MoveIncline -> SeatActuatorAdapter.MoveIncline
      connect SeatAdjustManager.MoveHdHeight -> SeatActuatorAdapter.MoveHdHeight
      connect SeatAdjustManager.MoveLumExtend -> SeatActuatorAdapter.MoveLumExtend
      connect SeatAdjustManager.MoveLumHeight -> SeatActuatorAdapter.MoveLumHeight
      connect SeatAdjustManager.MoveCushExtend -> SeatActuatorAdapter.MoveCushExtend
      connect SeatAdjustManager.MoveTopIncline -> SeatActuatorAdapter.MoveTopIncline
      connect SeatAdjustManager.MoveHdFold -> SeatActuatorAdapter.MoveHdFold
      connect SeatAdjustManager.MoveHdTilt -> SeatActuatorAdapter.MoveHdTilt
      connect SeatAdjustManager.MoveBkRBolster -> SeatActuatorAdapter.MoveBkRBolster
      connect SeatAdjustManager.MoveBkLBolster -> SeatActuatorAdapter.MoveBkLBolster
      connect SeatAdjustManager.MoveCushRBolster -> SeatActuatorAdapter.MoveCushRBolster
      connect SeatAdjustManager.MoveCushLBolster -> SeatActuatorAdapter.MoveCushLBolster
      connect SeatActuatorAdapter.Actuation -> SeatAxisActuator.Actuation
      connect SeatAxisActuator.PositionHeight -> SeatAdjustManager.PositionHeight
      connect SeatAxisActuator.PositionHeight -> SeatActuatorAdapter.PositionHeight
      connect SeatAxisActuator.PositionFrHeight -> SeatAdjustManager.PositionFrHeight
      connect SeatAxisActuator.PositionFrHeight -> SeatActuatorAdapter.PositionFrHeight
      connect SeatAxisActuator.PositionRrHeight -> SeatAdjustManager.PositionRrHeight
      connect SeatAxisActuator.PositionRrHeight -> SeatActuatorAdapter.PositionRrHeight
      connect SeatAxisActuator.PositionSlide -> SeatAdjustManager.PositionSlide
      connect SeatAxisActuator.PositionSlide -> SeatActuatorAdapter.PositionSlide
      connect SeatAxisActuator.PositionIncline -> SeatAdjustManager.PositionIncline
      connect SeatAxisActuator.PositionIncline -> SeatActuatorAdapter.PositionIncline
      connect SeatAxisActuator.PositionHdHeight -> SeatAdjustManager.PositionHdHeight
      connect SeatAxisActuator.PositionHdHeight -> SeatActuatorAdapter.PositionHdHeight
      connect SeatAxisActuator.PositionLumExtend -> SeatAdjustManager.PositionLumExtend
      connect SeatAxisActuator.PositionLumExtend -> SeatActuatorAdapter.PositionLumExtend
      connect SeatAxisActuator.PositionLumHeight -> SeatAdjustManager.PositionLumHeight
      connect SeatAxisActuator.PositionLumHeight -> SeatActuatorAdapter.PositionLumHeight
      connect SeatAxisActuator.PositionCushExtend -> SeatAdjustManager.PositionCushExtend
      connect SeatAxisActuator.PositionCushExtend -> SeatActuatorAdapter.PositionCushExtend
      connect SeatAxisActuator.PositionTopIncline -> SeatAdjustManager.PositionTopIncline
      connect SeatAxisActuator.PositionTopIncline -> SeatActuatorAdapter.PositionTopIncline
      connect SeatAxisActuator.PositionHdFold -> SeatAdjustManager.PositionHdFold
      connect SeatAxisActuator.PositionHdFold -> SeatActuatorAdapter.PositionHdFold
      connect SeatAxisActuator.PositionHdTilt -> SeatAdjustManager.PositionHdTilt
      connect SeatAxisActuator.PositionHdTilt -> SeatActuatorAdapter.PositionHdTilt
      connect SeatAxisActuator.PositionBkRBolster -> SeatAdjustManager.PositionBkRBolster
      connect SeatAxisActuator.PositionBkRBolster -> SeatActuatorAdapter.PositionBkRBolster
      connect SeatAxisActuator.PositionBkLBolster -> SeatAdjustManager.PositionBkLBolster
      connect SeatAxisActuator.PositionBkLBolster -> SeatActuatorAdapter.PositionBkLBolster
      connect SeatAxisActuator.PositionCushRBolster -> SeatAdjustManager.PositionCushRBolster
      connect SeatAxisActuator.PositionCushRBolster -> SeatActuatorAdapter.PositionCushRBolster
      connect SeatAxisActuator.PositionCushLBolster -> SeatAdjustManager.PositionCushLBolster
      connect SeatAxisActuator.PositionCushLBolster -> SeatActuatorAdapter.PositionCushLBolster
      connect SeatAdjustManager.StorePositionHeight -> SeatMemoryAdapter.StorePositionHeight
      connect SeatAdjustManager.StorePositionFrHeight -> SeatMemoryAdapter.StorePositionFrHeight
      connect SeatAdjustManager.StorePositionRrHeight -> SeatMemoryAdapter.StorePositionRrHeight
      connect SeatAdjustManager.StorePositionSlide -> SeatMemoryAdapter.StorePositionSlide
      connect SeatAdjustManager.StorePositionIncline -> SeatMemoryAdapter.StorePositionIncline
      connect SeatAdjustManager.StorePositionHdHeight -> SeatMemoryAdapter.StorePositionHdHeight
      connect SeatAdjustManager.StorePositionLumExtend -> SeatMemoryAdapter.StorePositionLumExtend
      connect SeatAdjustManager.StorePositionLumHeight -> SeatMemoryAdapter.StorePositionLumHeight
      connect SeatAdjustManager.StorePositionCushExtend -> SeatMemoryAdapter.StorePositionCushExtend
      connect SeatAdjustManager.StorePositionTopIncline -> SeatMemoryAdapter.StorePositionTopIncline
      connect SeatAdjustManager.StorePositionHdFold -> SeatMemoryAdapter.StorePositionHdFold
      connect SeatAdjustManager.StorePositionHdTilt -> SeatMemoryAdapter.StorePositionHdTilt
      connect SeatAdjustManager.StorePositionBkRBolster -> SeatMemoryAdapter.StorePositionBkRBolster
      connect SeatAdjustManager.StorePositionBkLBolster -> SeatMemoryAdapter.StorePositionBkLBolster
      connect SeatAdjustManager.StorePositionCushRBolster -> SeatMemoryAdapter.StorePositionCushRBolster
      connect SeatAdjustManager.StorePositionCushLBolster -> SeatMemoryAdapter.StorePositionCushLBolster
      connect SeatMemoryAdapter.PositionMemoryHeight -> SeatAdjustManager.PositionMemoryHeight
      connect SeatMemoryAdapter.PositionMemoryFrHeight -> SeatAdjustManager.PositionMemoryFrHeight
      connect SeatMemoryAdapter.PositionMemoryRrheight -> SeatAdjustManager.PositionMemoryRrheight
      connect SeatMemoryAdapter.PositionMemorySlide -> SeatAdjustManager.PositionMemorySlide
      connect SeatMemoryAdapter.PositionMemoryIncline -> SeatAdjustManager.PositionMemoryIncline
      connect SeatMemoryAdapter.PositionMemoryHdHeight -> SeatAdjustManager.PositionMemoryHdHeight
      connect SeatMemoryAdapter.PositionMemoryLumExtend -> SeatAdjustManager.PositionMemoryLumExtend
      connect SeatMemoryAdapter.PositionMemoryLumHeight -> SeatAdjustManager.PositionMemoryLumHeight
      connect SeatMemoryAdapter.PositionMemoryCushExtend -> SeatAdjustManager.PositionMemoryCushExtend
      connect SeatMemoryAdapter.PositionMemoryTopIncline -> SeatAdjustManager.PositionMemoryTopIncline
      connect SeatMemoryAdapter.PositionMemoryHdFold -> SeatAdjustManager.PositionMemoryHdFold
      connect SeatMemoryAdapter.PositionMemoryHdTilt -> SeatAdjustManager.PositionMemoryHdTilt
      connect SeatMemoryAdapter.PositionMemoryBkRBolster -> SeatAdjustManager.PositionMemoryBkRBolster
      connect SeatMemoryAdapter.PositionMemoryBkLBolster -> SeatAdjustManager.PositionMemoryBkLBolster
      connect SeatMemoryAdapter.PositionMemoryCushRBolster -> SeatAdjustManager.PositionMemoryCushRBolster
      connect SeatMemoryAdapter.PositionMemoryCushLBolster -> SeatAdjustManager.PositionMemoryCushLBolster
      delegate SeatAxisActuator.Voltage <-> outer port SeatAdjustment/Voltage
      delegate AutoAdjustUserRequestManagerSeat.ActualGear <-> outer port SeatAdjustment/ActualGear
      delegate SeatAdjustManager.VehicleLongitudinalSpeed <-> outer port SeatAdjustment/VehicleLongitudinalSpeed
      delegate AutoAdjustUserRequestManagerSeat.CentralLocking <-> outer port SeatAdjustment/CentralLocking
      delegate AutoAdjustUserRequestManagerSeat.AutoAdjustPanel <-> outer port SeatAdjustment/AutoAdjustPanel
      delegate AutoAdjustUserRequestManagerSeat.Entry <-> outer port SeatAdjustment/Entry
      delegate AutoAdjustUserRequestManagerSeat.ManAdjustPanel <-> outer port SeatAdjustment/ManAdjustPanel
      delegate SeatAdjustManager.ManAdjustPanel <-> outer port SeatAdjustment/ManAdjustPanel
      delegate SeatAdjustManager.MassageAdjust <-> outer port SeatAdjustment/MassageAdjust
      delegate AutoAdjustUserRequestManagerSeat.DriverDoorState <-> outer port SeatAdjustment/DriverDoorState
      delegate AutoAdjustUserRequestManagerSeat.PassengerDoorState <-> outer port SeatAdjustment/PassengerDoorState
      delegate SeatAdjustManager.MassageStatus <-> outer port SeatAdjustment/MassageStatus
    AutoAdjustUserRequestManagerSeat
      provide port AutoMove: provided-interface=ReqAutoMove  # Use case: the request manager determines that conditions are correct to request automatic seat movement to a certain position. This position could be determined by a user request from the seat panel, an access from the remote key, a keyless access, driver-easy-entry request or if reverse gear was detected, to move the head-rest to the &quot;down position&quot;. If it is clear, that the driver is outside the car (e.g. easy entry) it may be necessary or possible to move the seat very fast. In this case 'high-speed' indicates this situation.
      provide port StorePos: provided-interface=ReqStorePosition  # Use case: the request manager determines conditions are correct to request storage of the position of the seat to the corresponding profile number.
      7 x require port:
        ActualGear: required-interface=ActualGear  # Use case: move the head-rest of rear seats to down position if the drivers demand for reversing is detected.
        CentralLocking: required-interface=StaCentralLocking  # Use case: seat adjustment to a certain position on unlock command; update current position to the given profile on lock command
        AutoAdjustPanel: required-interface=ReqAutoAdjust  # User request to move the seat automatically or to store the seat position to the given profile. 5 memory buttons are to be supported.
        Entry: required-interface=ReqEntry  # User's demand (for example push button) for moving the front seat backwards or forwards to a certain position for easier entry to the front or rear of the vehicle (front easy-entry or auto glide functionality respectively).
        ManAdjustPanel: required-interface=ReqManAdjust  # User request to move the axis of the seat manually in a certain direction
        DriverDoorState: required-interface=StaDoor  # Use case: Enable easy entry only if corresponding door is open
        PassengerDoorState: required-interface=StaDoor  # Use case: Enable easy entry only if corresponding door is open
    SeatAdjustManager
      33 x provide port:
        MassageStatus: provided-interface=StaMassageAdjust  # Feedback of the seat manager indicating which kind of massage program is currently running. This information may be used by a seat's massage control panel to switch status LEDs
        MoveHeight: provided-interface=ReqMove  # Request to move the specified axis of the seat to the indicated position (resolution 0.1%). In case of manually adjustment there would appear 0% or 100%. One value is reserved for &quot;Stop moving&quot;
        MoveFrHeight: provided-interface=ReqMove  # Request to move the specified axis of the seat to the indicated position (resolution 0.1%). In case of manually adjustment there would appear 0% or 100%. One value is reserved for &quot;Stop moving&quot;
        MoveRrHeight: provided-interface=ReqMove  # Request to move the specified axis of the seat to the indicated position (resolution 0.1%). In case of manually adjustment there would appear 0% or 100%. One value is reserved for &quot;Stop moving&quot;
        MoveSlide: provided-interface=ReqMove  # Request to move the specified axis of the seat to the indicated position (resolution 0.1%). In case of manually adjustment there would appear 0% or 100%. One value is reserved for &quot;Stop moving&quot;
        MoveIncline: provided-interface=ReqMove  # Request to move the specified axis of the seat to the indicated position (resolution 0.1%). In case of manually adjustment there would appear 0% or 100%. One value is reserved for &quot;Stop moving&quot;
        MoveHdHeight: provided-interface=ReqMove  # Request to move the specified axis of the seat to the indicated position (resolution 0.1%). In case of manually adjustment there would appear 0% or 100%. One value is reserved for &quot;Stop moving&quot;
        MoveLumExtend: provided-interface=ReqMove  # Request to move the specified axis of the seat to the indicated position (resolution 0.1%). In case of manually adjustment there would appear 0% or 100%. One value is reserved for &quot;Stop moving&quot;
        MoveLumHeight: provided-interface=ReqMove  # Request to move the specified axis of the seat to the indicated position (resolution 0.1%). In case of manually adjustment there would appear 0% or 100%. One value is reserved for &quot;Stop moving&quot;
        MoveCushExtend: provided-interface=ReqMove  # Request to move the specified axis of the seat to the indicated position (resolution 0.1%). In case of manually adjustment there would appear 0% or 100%. One value is reserved for &quot;Stop moving&quot;
        MoveTopIncline: provided-interface=ReqMove  # Request to move the specified axis of the seat to the indicated position (resolution 0.1%). In case of manually adjustment there would appear 0% or 100%. One value is reserved for &quot;Stop moving&quot;
        MoveHdFold: provided-interface=ReqMove  # Request to move the specified axis of the seat to the indicated position (resolution 0.1%). In case of manually adjustment there would appear 0% or 100%. One value is reserved for &quot;Stop moving&quot;
        MoveHdTilt: provided-interface=ReqMove  # Request to move the specified axis of the seat to the indicated position (resolution 0.1%). In case of manually adjustment there would appear 0% or 100%. One value is reserved for &quot;Stop moving&quot;
        MoveBkRBolster: provided-interface=ReqMove  # Request to move the specified axis of the seat to the indicated position (resolution 0.1%). In case of manually adjustment there would appear 0% or 100%. One value is reserved for &quot;Stop moving&quot;
        MoveBkLBolster: provided-interface=ReqMove  # Request to move the specified axis of the seat to the indicated position (resolution 0.1%). In case of manually adjustment there would appear 0% or 100%. One value is reserved for &quot;Stop moving&quot;
        MoveCushRBolster: provided-interface=ReqMove  # Request to move the specified axis of the seat to the indicated position (resolution 0.1%). In case of manually adjustment there would appear 0% or 100%. One value is reserved for &quot;Stop moving&quot;
        MoveCushLBolster: provided-interface=ReqMove  # Request to move the specified axis of the seat to the indicated position (resolution 0.1%). In case of manually adjustment there would appear 0% or 100%. One value is reserved for &quot;Stop moving&quot;
        StorePositionHeight: provided-interface=CmdStorePosition  # Request to store the position of a certain seat axis to the memory position 'profile'. Use case: driver activates &quot;store&quot; function on the memory control panel.
        StorePositionFrHeight: provided-interface=CmdStorePosition  # Request to store the position of a certain seat axis to the memory position 'profile'. Use case: driver activates &quot;store&quot; function on the memory control panel.
        StorePositionRrHeight: provided-interface=CmdStorePosition  # Request to store the position of a certain seat axis to the memory position 'profile'. Use case: driver activates &quot;store&quot; function on the memory control panel.
        StorePositionSlide: provided-interface=CmdStorePosition  # Request to store the position of a certain seat axis to the memory position 'profile'. Use case: driver activates &quot;store&quot; function on the memory control panel.
        StorePositionIncline: provided-interface=CmdStorePosition  # Request to store the position of a certain seat axis to the memory position 'profile'. Use case: driver activates &quot;store&quot; function on the memory control panel.
        StorePositionHdHeight: provided-interface=CmdStorePosition  # Request to store the position of a certain seat axis to the memory position 'profile'. Use case: driver activates &quot;store&quot; function on the memory control panel.
        StorePositionLumExtend: provided-interface=CmdStorePosition  # Request to store the position of a certain seat axis to the memory position 'profile'. Use case: driver activates &quot;store&quot; function on the memory control panel.
        StorePositionLumHeight: provided-interface=CmdStorePosition  # Request to store the position of a certain seat axis to the memory position 'profile'. Use case: driver activates &quot;store&quot; function on the memory control panel.
        StorePositionCushExtend: provided-interface=CmdStorePosition  # Request to store the position of a certain seat axis to the memory position 'profile'. Use case: driver activates &quot;store&quot; function on the memory control panel.
        StorePositionTopIncline: provided-interface=CmdStorePosition  # Request to store the position of a certain seat axis to the memory position 'profile'. Use case: driver activates &quot;store&quot; function on the memory control panel.
        StorePositionHdFold: provided-interface=CmdStorePosition  # Request to store the position of a certain seat axis to the memory position 'profile'. Use case: driver activates &quot;store&quot; function on the memory control panel.
        StorePositionHdTilt: provided-interface=CmdStorePosition  # Request to store the position of a certain seat axis to the memory position 'profile'. Use case: driver activates &quot;store&quot; function on the memory control panel.
        StorePositionBkRBolster: provided-interface=CmdStorePosition  # Request to store the position of a certain seat axis to the memory position 'profile'. Use case: driver activates &quot;store&quot; function on the memory control panel.
        StorePositionBkLBolster: provided-interface=CmdStorePosition  # Request to store the position of a certain seat axis to the memory position 'profile'. Use case: driver activates &quot;store&quot; function on the memory control panel.
        StorePositionCushRBolster: provided-interface=CmdStorePosition  # Request to store the position of a certain seat axis to the memory position 'profile'. Use case: driver activates &quot;store&quot; function on the memory control panel.
        StorePositionCushLBolster: provided-interface=CmdStorePosition  # Request to store the position of a certain seat axis to the memory position 'profile'. Use case: driver activates &quot;store&quot; function on the memory control panel.
      37 x require port:
        VehicleLongitudinalSpeed: required-interface=VehicleLongitudinalSpeed  # Use case: easy-entry only possible below a certain vehicle speed
        ManAdjustPanel: required-interface=ReqManAdjust  # User request to move the axis of the seat manually in a certain direction
        MassageAdjust: required-interface=ReqMassageAdjust  # User request to activate a massage program. One or more programs are possible simultaneously
        AutoMove: required-interface=ReqAutoMove  # Use case: the request manager determines that conditions are correct to request automatic seat movement to a certain position. This position could be determined by a user request from the seat panel, an access from the remote key, a keyless access, driver-easy-entry request or if reverse gear was detected, to move the head-rest to the &quot;down position&quot;. If it is clear, that the driver is outside the car (e.g. easy entry) it may be necessary or possible to move the seat very fast. In this case 'high-speed' indicates this situation.
        StorePos: required-interface=ReqStorePosition  # Use case: the request manager determines conditions are correct to request storage of the position of the seat to the corresponding profile number.
        PositionHeight: required-interface=StaAxisPos  # This provides information about the current status of the seat axis actuator. There are three parts: current movement, speed and position. Position: Use case: the SeatActuatorAdapter needs the actual position to compare against the desired position (from SeatAdjustManager). Use case: the SeatAdjustManager needs the actual position so that it can be stored when necessary. Speed: Feedback due to requested speed (see af_cmd_speed) Movement: Distinction necessary between ... - Anti-pinch detected: reverse movement may be requested for protection of a person - actuator is blocked: just stop for protection of motor Uses actuator status to recalculate constraints on movement and remove the move command, if necessary.
        PositionFrHeight: required-interface=StaAxisPos  # This provides information about the current status of the seat axis actuator. There are three parts: current movement, speed and position. Position: Use case: the SeatActuatorAdapter needs the actual position to compare against the desired position (from SeatAdjustManager). Use case: the SeatAdjustManager needs the actual position so that it can be stored when necessary. Speed: Feedback due to requested speed (see af_cmd_speed) Movement: Distinction necessary between ... - Anti-pinch detected: reverse movement may be requested for protection of a person - actuator is blocked: just stop for protection of motor Uses actuator status to recalculate constraints on movement and remove the move command, if necessary.
        PositionRrHeight: required-interface=StaAxisPos  # This provides information about the current status of the seat axis actuator. There are three parts: current movement, speed and position. Position: Use case: the SeatActuatorAdapter needs the actual position to compare against the desired position (from SeatAdjustManager). Use case: the SeatAdjustManager needs the actual position so that it can be stored when necessary. Speed: Feedback due to requested speed (see af_cmd_speed) Movement: Distinction necessary between ... - Anti-pinch detected: reverse movement may be requested for protection of a person - actuator is blocked: just stop for protection of motor Uses actuator status to recalculate constraints on movement and remove the move command, if necessary.
        PositionSlide: required-interface=StaAxisPos  # This provides information about the current status of the seat axis actuator. There are three parts: current movement, speed and position. Position: Use case: the SeatActuatorAdapter needs the actual position to compare against the desired position (from SeatAdjustManager). Use case: the SeatAdjustManager needs the actual position so that it can be stored when necessary. Speed: Feedback due to requested speed (see af_cmd_speed) Movement: Distinction necessary between ... - Anti-pinch detected: reverse movement may be requested for protection of a person - actuator is blocked: just stop for protection of motor Uses actuator status to recalculate constraints on movement and remove the move command, if necessary.
        PositionIncline: required-interface=StaAxisPos  # This provides information about the current status of the seat axis actuator. There are three parts: current movement, speed and position. Position: Use case: the SeatActuatorAdapter needs the actual position to compare against the desired position (from SeatAdjustManager). Use case: the SeatAdjustManager needs the actual position so that it can be stored when necessary. Speed: Feedback due to requested speed (see af_cmd_speed) Movement: Distinction necessary between ... - Anti-pinch detected: reverse movement may be requested for protection of a person - actuator is blocked: just stop for protection of motor Uses actuator status to recalculate constraints on movement and remove the move command, if necessary.
        PositionHdHeight: required-interface=StaAxisPos  # This provides information about the current status of the seat axis actuator. There are three parts: current movement, speed and position. Position: Use case: the SeatActuatorAdapter needs the actual position to compare against the desired position (from SeatAdjustManager). Use case: the SeatAdjustManager needs the actual position so that it can be stored when necessary. Speed: Feedback due to requested speed (see af_cmd_speed) Movement: Distinction necessary between ... - Anti-pinch detected: reverse movement may be requested for protection of a person - actuator is blocked: just stop for protection of motor Uses actuator status to recalculate constraints on movement and remove the move command, if necessary.
        PositionLumExtend: required-interface=StaAxisPos  # This provides information about the current status of the seat axis actuator. There are three parts: current movement, speed and position. Position: Use case: the SeatActuatorAdapter needs the actual position to compare against the desired position (from SeatAdjustManager). Use case: the SeatAdjustManager needs the actual position so that it can be stored when necessary. Speed: Feedback due to requested speed (see af_cmd_speed) Movement: Distinction necessary between ... - Anti-pinch detected: reverse movement may be requested for protection of a person - actuator is blocked: just stop for protection of motor Uses actuator status to recalculate constraints on movement and remove the move command, if necessary.
        PositionLumHeight: required-interface=StaAxisPos  # This provides information about the current status of the seat axis actuator. There are three parts: current movement, speed and position. Position: Use case: the SeatActuatorAdapter needs the actual position to compare against the desired position (from SeatAdjustManager). Use case: the SeatAdjustManager needs the actual position so that it can be stored when necessary. Speed: Feedback due to requested speed (see af_cmd_speed) Movement: Distinction necessary between ... - Anti-pinch detected: reverse movement may be requested for protection of a person - actuator is blocked: just stop for protection of motor Uses actuator status to recalculate constraints on movement and remove the move command, if necessary.
        PositionCushExtend: required-interface=StaAxisPos  # This provides information about the current status of the seat axis actuator. There are three parts: current movement, speed and position. Position: Use case: the SeatActuatorAdapter needs the actual position to compare against the desired position (from SeatAdjustManager). Use case: the SeatAdjustManager needs the actual position so that it can be stored when necessary. Speed: Feedback due to requested speed (see af_cmd_speed) Movement: Distinction necessary between ... - Anti-pinch detected: reverse movement may be requested for protection of a person - actuator is blocked: just stop for protection of motor Uses actuator status to recalculate constraints on movement and remove the move command, if necessary.
        PositionTopIncline: required-interface=StaAxisPos  # This provides information about the current status of the seat axis actuator. There are three parts: current movement, speed and position. Position: Use case: the SeatActuatorAdapter needs the actual position to compare against the desired position (from SeatAdjustManager). Use case: the SeatAdjustManager needs the actual position so that it can be stored when necessary. Speed: Feedback due to requested speed (see af_cmd_speed) Movement: Distinction necessary between ... - Anti-pinch detected: reverse movement may be requested for protection of a person - actuator is blocked: just stop for protection of motor Uses actuator status to recalculate constraints on movement and remove the move command, if necessary.
        PositionHdFold: required-interface=StaAxisPos  # This provides information about the current status of the seat axis actuator. There are three parts: current movement, speed and position. Position: Use case: the SeatActuatorAdapter needs the actual position to compare against the desired position (from SeatAdjustManager). Use case: the SeatAdjustManager needs the actual position so that it can be stored when necessary. Speed: Feedback due to requested speed (see af_cmd_speed) Movement: Distinction necessary between ... - Anti-pinch detected: reverse movement may be requested for protection of a person - actuator is blocked: just stop for protection of motor Uses actuator status to recalculate constraints on movement and remove the move command, if necessary.
        PositionHdTilt: required-interface=StaAxisPos  # This provides information about the current status of the seat axis actuator. There are three parts: current movement, speed and position. Position: Use case: the SeatActuatorAdapter needs the actual position to compare against the desired position (from SeatAdjustManager). Use case: the SeatAdjustManager needs the actual position so that it can be stored when necessary. Speed: Feedback due to requested speed (see af_cmd_speed) Movement: Distinction necessary between ... - Anti-pinch detected: reverse movement may be requested for protection of a person - actuator is blocked: just stop for protection of motor Uses actuator status to recalculate constraints on movement and remove the move command, if necessary.
        PositionBkRBolster: required-interface=StaAxisPos  # This provides information about the current status of the seat axis actuator. There are three parts: current movement, speed and position. Position: Use case: the SeatActuatorAdapter needs the actual position to compare against the desired position (from SeatAdjustManager). Use case: the SeatAdjustManager needs the actual position so that it can be stored when necessary. Speed: Feedback due to requested speed (see af_cmd_speed) Movement: Distinction necessary between ... - Anti-pinch detected: reverse movement may be requested for protection of a person - actuator is blocked: just stop for protection of motor Uses actuator status to recalculate constraints on movement and remove the move command, if necessary.
        PositionBkLBolster: required-interface=StaAxisPos  # This provides information about the current status of the seat axis actuator. There are three parts: current movement, speed and position. Position: Use case: the SeatActuatorAdapter needs the actual position to compare against the desired position (from SeatAdjustManager). Use case: the SeatAdjustManager needs the actual position so that it can be stored when necessary. Speed: Feedback due to requested speed (see af_cmd_speed) Movement: Distinction necessary between ... - Anti-pinch detected: reverse movement may be requested for protection of a person - actuator is blocked: just stop for protection of motor Uses actuator status to recalculate constraints on movement and remove the move command, if necessary.
        PositionCushRBolster: required-interface=StaAxisPos  # This provides information about the current status of the seat axis actuator. There are three parts: current movement, speed and position. Position: Use case: the SeatActuatorAdapter needs the actual position to compare against the desired position (from SeatAdjustManager). Use case: the SeatAdjustManager needs the actual position so that it can be stored when necessary. Speed: Feedback due to requested speed (see af_cmd_speed) Movement: Distinction necessary between ... - Anti-pinch detected: reverse movement may be requested for protection of a person - actuator is blocked: just stop for protection of motor Uses actuator status to recalculate constraints on movement and remove the move command, if necessary.
        PositionCushLBolster: required-interface=StaAxisPos  # This provides information about the current status of the seat axis actuator. There are three parts: current movement, speed and position. Position: Use case: the SeatActuatorAdapter needs the actual position to compare against the desired position (from SeatAdjustManager). Use case: the SeatAdjustManager needs the actual position so that it can be stored when necessary. Speed: Feedback due to requested speed (see af_cmd_speed) Movement: Distinction necessary between ... - Anti-pinch detected: reverse movement may be requested for protection of a person - actuator is blocked: just stop for protection of motor Uses actuator status to recalculate constraints on movement and remove the move command, if necessary.
        PositionMemoryHeight: required-interface=StaStorePosition  # Memory-position data from storage memory for the current profile of a certain seat axis. Use case: driver activates &quot;recall&quot; function on the memory control panel.
        PositionMemoryFrHeight: required-interface=StaStorePosition  # Memory-position data from storage memory for the current profile of a certain seat axis. Use case: driver activates &quot;recall&quot; function on the memory control panel.
        PositionMemoryRrheight: required-interface=StaStorePosition  # Memory-position data from storage memory for the current profile of a certain seat axis. Use case: driver activates &quot;recall&quot; function on the memory control panel.
        PositionMemorySlide: required-interface=StaStorePosition  # Memory-position data from storage memory for the current profile of a certain seat axis. Use case: driver activates &quot;recall&quot; function on the memory control panel.
        PositionMemoryIncline: required-interface=StaStorePosition  # Memory-position data from storage memory for the current profile of a certain seat axis. Use case: driver activates &quot;recall&quot; function on the memory control panel.
        PositionMemoryHdHeight: required-interface=StaStorePosition  # Memory-position data from storage memory for the current profile of a certain seat axis. Use case: driver activates &quot;recall&quot; function on the memory control panel.
        PositionMemoryLumExtend: required-interface=StaStorePosition  # Memory-position data from storage memory for the current profile of a certain seat axis. Use case: driver activates &quot;recall&quot; function on the memory control panel.
        PositionMemoryLumHeight: required-interface=StaStorePosition  # Memory-position data from storage memory for the current profile of a certain seat axis. Use case: driver activates &quot;recall&quot; function on the memory control panel.
        PositionMemoryCushExtend: required-interface=StaStorePosition  # Memory-position data from storage memory for the current profile of a certain seat axis. Use case: driver activates &quot;recall&quot; function on the memory control panel.
        PositionMemoryTopIncline: required-interface=StaStorePosition  # Memory-position data from storage memory for the current profile of a certain seat axis. Use case: driver activates &quot;recall&quot; function on the memory control panel.
        PositionMemoryHdFold: required-interface=StaStorePosition  # Memory-position data from storage memory for the current profile of a certain seat axis. Use case: driver activates &quot;recall&quot; function on the memory control panel.
        PositionMemoryHdTilt: required-interface=StaStorePosition  # Memory-position data from storage memory for the current profile of a certain seat axis. Use case: driver activates &quot;recall&quot; function on the memory control panel.
        PositionMemoryBkRBolster: required-interface=StaStorePosition  # Memory-position data from storage memory for the current profile of a certain seat axis. Use case: driver activates &quot;recall&quot; function on the memory control panel.
        PositionMemoryBkLBolster: required-interface=StaStorePosition  # Memory-position data from storage memory for the current profile of a certain seat axis. Use case: driver activates &quot;recall&quot; function on the memory control panel.
        PositionMemoryCushRBolster: required-interface=StaStorePosition  # Memory-position data from storage memory for the current profile of a certain seat axis. Use case: driver activates &quot;recall&quot; function on the memory control panel.
        PositionMemoryCushLBolster: required-interface=StaStorePosition  # Memory-position data from storage memory for the current profile of a certain seat axis. Use case: driver activates &quot;recall&quot; function on the memory control panel.
    SeatAxisActuator
      16 x provide port, all with provided-interface=StaAxisPos:
        PositionHeight  # This provides information about the current status of the seat axis actuator. There are three parts: current movement, speed and position. Position: Use case: the SeatActuatorAdapter needs the actual position to compare against the desired position (from SeatAdjustManager). Use case: the SeatAdjustManager needs the actual position so that it can be stored when necessary. Speed: Feedback due to requested speed (see af_cmd_speed) Movement: Distinction necessary between ... - Anti-pinch detected: reverse movement may be requested for protection of a person - actuator is blocked: just stop for protection of motor Uses actuator status to recalculate constraints on movement and remove the move command, if necessary.
        PositionFrHeight  # This provides information about the current status of the seat axis actuator. There are three parts: current movement, speed and position. Position: Use case: the SeatActuatorAdapter needs the actual position to compare against the desired position (from SeatAdjustManager). Use case: the SeatAdjustManager needs the actual position so that it can be stored when necessary. Speed: Feedback due to requested speed (see af_cmd_speed) Movement: Distinction necessary between ... - Anti-pinch detected: reverse movement may be requested for protection of a person - actuator is blocked: just stop for protection of motor Uses actuator status to recalculate constraints on movement and remove the move command, if necessary.
        PositionRrHeight  # This provides information about the current status of the seat axis actuator. There are three parts: current movement, speed and position. Position: Use case: the SeatActuatorAdapter needs the actual position to compare against the desired position (from SeatAdjustManager). Use case: the SeatAdjustManager needs the actual position so that it can be stored when necessary. Speed: Feedback due to requested speed (see af_cmd_speed) Movement: Distinction necessary between ... - Anti-pinch detected: reverse movement may be requested for protection of a person - actuator is blocked: just stop for protection of motor Uses actuator status to recalculate constraints on movement and remove the move command, if necessary.
        PositionSlide  # This provides information about the current status of the seat axis actuator. There are three parts: current movement, speed and position. Position: Use case: the SeatActuatorAdapter needs the actual position to compare against the desired position (from SeatAdjustManager). Use case: the SeatAdjustManager needs the actual position so that it can be stored when necessary. Speed: Feedback due to requested speed (see af_cmd_speed) Movement: Distinction necessary between ... - Anti-pinch detected: reverse movement may be requested for protection of a person - actuator is blocked: just stop for protection of motor Uses actuator status to recalculate constraints on movement and remove the move command, if necessary.
        PositionIncline  # This provides information about the current status of the seat axis actuator. There are three parts: current movement, speed and position. Position: Use case: the SeatActuatorAdapter needs the actual position to compare against the desired position (from SeatAdjustManager). Use case: the SeatAdjustManager needs the actual position so that it can be stored when necessary. Speed: Feedback due to requested speed (see af_cmd_speed) Movement: Distinction necessary between ... - Anti-pinch detected: reverse movement may be requested for protection of a person - actuator is blocked: just stop for protection of motor Uses actuator status to recalculate constraints on movement and remove the move command, if necessary.
        PositionHdHeight  # This provides information about the current status of the seat axis actuator. There are three parts: current movement, speed and position. Position: Use case: the SeatActuatorAdapter needs the actual position to compare against the desired position (from SeatAdjustManager). Use case: the SeatAdjustManager needs the actual position so that it can be stored when necessary. Speed: Feedback due to requested speed (see af_cmd_speed) Movement: Distinction necessary between ... - Anti-pinch detected: reverse movement may be requested for protection of a person - actuator is blocked: just stop for protection of motor Uses actuator status to recalculate constraints on movement and remove the move command, if necessary.
        PositionLumExtend  # This provides information about the current status of the seat axis actuator. There are three parts: current movement, speed and position. Position: Use case: the SeatActuatorAdapter needs the actual position to compare against the desired position (from SeatAdjustManager). Use case: the SeatAdjustManager needs the actual position so that it can be stored when necessary. Speed: Feedback due to requested speed (see af_cmd_speed) Movement: Distinction necessary between ... - Anti-pinch detected: reverse movement may be requested for protection of a person - actuator is blocked: just stop for protection of motor Uses actuator status to recalculate constraints on movement and remove the move command, if necessary.
        PositionLumHeight  # This provides information about the current status of the seat axis actuator. There are three parts: current movement, speed and position. Position: Use case: the SeatActuatorAdapter needs the actual position to compare against the desired position (from SeatAdjustManager). Use case: the SeatAdjustManager needs the actual position so that it can be stored when necessary. Speed: Feedback due to requested speed (see af_cmd_speed) Movement: Distinction necessary between ... - Anti-pinch detected: reverse movement may be requested for protection of a person - actuator is blocked: just stop for protection of motor Uses actuator status to recalculate constraints on movement and remove the move command, if necessary.
        PositionCushExtend  # This provides information about the current status of the seat axis actuator. There are three parts: current movement, speed and position. Position: Use case: the SeatActuatorAdapter needs the actual position to compare against the desired position (from SeatAdjustManager). Use case: the SeatAdjustManager needs the actual position so that it can be stored when necessary. Speed: Feedback due to requested speed (see af_cmd_speed) Movement: Distinction necessary between ... - Anti-pinch detected: reverse movement may be requested for protection of a person - actuator is blocked: just stop for protection of motor Uses actuator status to recalculate constraints on movement and remove the move command, if necessary.
        PositionTopIncline  # This provides information about the current status of the seat axis actuator. There are three parts: current movement, speed and position. Position: Use case: the SeatActuatorAdapter needs the actual position to compare against the desired position (from SeatAdjustManager). Use case: the SeatAdjustManager needs the actual position so that it can be stored when necessary. Speed: Feedback due to requested speed (see af_cmd_speed) Movement: Distinction necessary between ... - Anti-pinch detected: reverse movement may be requested for protection of a person - actuator is blocked: just stop for protection of motor Uses actuator status to recalculate constraints on movement and remove the move command, if necessary.
        PositionHdFold  # This provides information about the current status of the seat axis actuator. There are three parts: current movement, speed and position. Position: Use case: the SeatActuatorAdapter needs the actual position to compare against the desired position (from SeatAdjustManager). Use case: the SeatAdjustManager needs the actual position so that it can be stored when necessary. Speed: Feedback due to requested speed (see af_cmd_speed) Movement: Distinction necessary between ... - Anti-pinch detected: reverse movement may be requested for protection of a person - actuator is blocked: just stop for protection of motor Uses actuator status to recalculate constraints on movement and remove the move command, if necessary.
        PositionHdTilt  # This provides information about the current status of the seat axis actuator. There are three parts: current movement, speed and position. Position: Use case: the SeatActuatorAdapter needs the actual position to compare against the desired position (from SeatAdjustManager). Use case: the SeatAdjustManager needs the actual position so that it can be stored when necessary. Speed: Feedback due to requested speed (see af_cmd_speed) Movement: Distinction necessary between ... - Anti-pinch detected: reverse movement may be requested for protection of a person - actuator is blocked: just stop for protection of motor Uses actuator status to recalculate constraints on movement and remove the move command, if necessary.
        PositionBkRBolster  # This provides information about the current status of the seat axis actuator. There are three parts: current movement, speed and position. Position: Use case: the SeatActuatorAdapter needs the actual position to compare against the desired position (from SeatAdjustManager). Use case: the SeatAdjustManager needs the actual position so that it can be stored when necessary. Speed: Feedback due to requested speed (see af_cmd_speed) Movement: Distinction necessary between ... - Anti-pinch detected: reverse movement may be requested for protection of a person - actuator is blocked: just stop for protection of motor Uses actuator status to recalculate constraints on movement and remove the move command, if necessary.
        PositionBkLBolster  # This provides information about the current status of the seat axis actuator. There are three parts: current movement, speed and position. Position: Use case: the SeatActuatorAdapter needs the actual position to compare against the desired position (from SeatAdjustManager). Use case: the SeatAdjustManager needs the actual position so that it can be stored when necessary. Speed: Feedback due to requested speed (see af_cmd_speed) Movement: Distinction necessary between ... - Anti-pinch detected: reverse movement may be requested for protection of a person - actuator is blocked: just stop for protection of motor Uses actuator status to recalculate constraints on movement and remove the move command, if necessary.
        PositionCushRBolster  # This provides information about the current status of the seat axis actuator. There are three parts: current movement, speed and position. Position: Use case: the SeatActuatorAdapter needs the actual position to compare against the desired position (from SeatAdjustManager). Use case: the SeatAdjustManager needs the actual position so that it can be stored when necessary. Speed: Feedback due to requested speed (see af_cmd_speed) Movement: Distinction necessary between ... - Anti-pinch detected: reverse movement may be requested for protection of a person - actuator is blocked: just stop for protection of motor Uses actuator status to recalculate constraints on movement and remove the move command, if necessary.
        PositionCushLBolster  # This provides information about the current status of the seat axis actuator. There are three parts: current movement, speed and position. Position: Use case: the SeatActuatorAdapter needs the actual position to compare against the desired position (from SeatAdjustManager). Use case: the SeatAdjustManager needs the actual position so that it can be stored when necessary. Speed: Feedback due to requested speed (see af_cmd_speed) Movement: Distinction necessary between ... - Anti-pinch detected: reverse movement may be requested for protection of a person - actuator is blocked: just stop for protection of motor Uses actuator status to recalculate constraints on movement and remove the move command, if necessary.
      require port Voltage: required-interface=BatteryVoltage  # Use case: compensation of actuator control for voltage fluctuations
      require port Actuation: required-interface=CmdMove  # Command to move the axis in a certain direction, with a certain speed (e.g. high-speed / low-speed, soft-stop, ...)
    SeatMemoryAdapter
      16 x provide port, all with provided-interface=StaStorePosition:
        PositionMemoryHeight  # Memory-position data from storage memory for the current profile of a certain seat axis. Use case: driver activates &quot;recall&quot; function on the memory control panel.
        PositionMemoryFrHeight  # Memory-position data from storage memory for the current profile of a certain seat axis. Use case: driver activates &quot;recall&quot; function on the memory control panel.
        PositionMemoryRrheight  # Memory-position data from storage memory for the current profile of a certain seat axis. Use case: driver activates &quot;recall&quot; function on the memory control panel.
        PositionMemorySlide  # Memory-position data from storage memory for the current profile of a certain seat axis. Use case: driver activates &quot;recall&quot; function on the memory control panel.
        PositionMemoryIncline  # Memory-position data from storage memory for the current profile of a certain seat axis. Use case: driver activates &quot;recall&quot; function on the memory control panel.
        PositionMemoryHdHeight  # Memory-position data from storage memory for the current profile of a certain seat axis. Use case: driver activates &quot;recall&quot; function on the memory control panel.
        PositionMemoryLumExtend  # Memory-position data from storage memory for the current profile of a certain seat axis. Use case: driver activates &quot;recall&quot; function on the memory control panel.
        PositionMemoryLumHeight  # Memory-position data from storage memory for the current profile of a certain seat axis. Use case: driver activates &quot;recall&quot; function on the memory control panel.
        PositionMemoryCushExtend  # Memory-position data from storage memory for the current profile of a certain seat axis. Use case: driver activates &quot;recall&quot; function on the memory control panel.
        PositionMemoryTopIncline  # Memory-position data from storage memory for the current profile of a certain seat axis. Use case: driver activates &quot;recall&quot; function on the memory control panel.
        PositionMemoryHdFold  # Memory-position data from storage memory for the current profile of a certain seat axis. Use case: driver activates &quot;recall&quot; function on the memory control panel.
        PositionMemoryHdTilt  # Memory-position data from storage memory for the current profile of a certain seat axis. Use case: driver activates &quot;recall&quot; function on the memory control panel.
        PositionMemoryBkRBolster  # Memory-position data from storage memory for the current profile of a certain seat axis. Use case: driver activates &quot;recall&quot; function on the memory control panel.
        PositionMemoryBkLBolster  # Memory-position data from storage memory for the current profile of a certain seat axis. Use case: driver activates &quot;recall&quot; function on the memory control panel.
        PositionMemoryCushRBolster  # Memory-position data from storage memory for the current profile of a certain seat axis. Use case: driver activates &quot;recall&quot; function on the memory control panel.
        PositionMemoryCushLBolster  # Memory-position data from storage memory for the current profile of a certain seat axis. Use case: driver activates &quot;recall&quot; function on the memory control panel.
      16 x require port, all with required-interface=CmdStorePosition:
        StorePositionHeight  # Request to store the position of a certain seat axis to the memory position 'profile'. Use case: driver activates &quot;store&quot; function on the memory control panel.
        StorePositionFrHeight  # Request to store the position of a certain seat axis to the memory position 'profile'. Use case: driver activates &quot;store&quot; function on the memory control panel.
        StorePositionRrHeight  # Request to store the position of a certain seat axis to the memory position 'profile'. Use case: driver activates &quot;store&quot; function on the memory control panel.
        StorePositionSlide  # Request to store the position of a certain seat axis to the memory position 'profile'. Use case: driver activates &quot;store&quot; function on the memory control panel.
        StorePositionIncline  # Request to store the position of a certain seat axis to the memory position 'profile'. Use case: driver activates &quot;store&quot; function on the memory control panel.
        StorePositionHdHeight  # Request to store the position of a certain seat axis to the memory position 'profile'. Use case: driver activates &quot;store&quot; function on the memory control panel.
        StorePositionLumExtend  # Request to store the position of a certain seat axis to the memory position 'profile'. Use case: driver activates &quot;store&quot; function on the memory control panel.
        StorePositionLumHeight  # Request to store the position of a certain seat axis to the memory position 'profile'. Use case: driver activates &quot;store&quot; function on the memory control panel.
        StorePositionCushExtend  # Request to store the position of a certain seat axis to the memory position 'profile'. Use case: driver activates &quot;store&quot; function on the memory control panel.
        StorePositionTopIncline  # Request to store the position of a certain seat axis to the memory position 'profile'. Use case: driver activates &quot;store&quot; function on the memory control panel.
        StorePositionHdFold  # Request to store the position of a certain seat axis to the memory position 'profile'. Use case: driver activates &quot;store&quot; function on the memory control panel.
        StorePositionHdTilt  # Request to store the position of a certain seat axis to the memory position 'profile'. Use case: driver activates &quot;store&quot; function on the memory control panel.
        StorePositionBkRBolster  # Request to store the position of a certain seat axis to the memory position 'profile'. Use case: driver activates &quot;store&quot; function on the memory control panel.
        StorePositionBkLBolster  # Request to store the position of a certain seat axis to the memory position 'profile'. Use case: driver activates &quot;store&quot; function on the memory control panel.
        StorePositionCushRBolster  # Request to store the position of a certain seat axis to the memory position 'profile'. Use case: driver activates &quot;store&quot; function on the memory control panel.
        StorePositionCushLBolster  # Request to store the position of a certain seat axis to the memory position 'profile'. Use case: driver activates &quot;store&quot; function on the memory control panel.
    SeatActuatorAdapter
      provide port Actuation: provided-interface=CmdMove  # Command to move the axis in a certain direction, with a certain speed (e.g. high-speed / low-speed, soft-stop, ...)
      32 x require port:
        MoveHeight: required-interface=ReqMove  # Request to move the specified axis of the seat to the indicated position (resolution 0.1%). In case of manually adjustment there would appear 0% or 100%. One value is reserved for &quot;Stop moving&quot;
        MoveFrHeight: required-interface=ReqMove  # Request to move the specified axis of the seat to the indicated position (resolution 0.1%). In case of manually adjustment there would appear 0% or 100%. One value is reserved for &quot;Stop moving&quot;
        MoveRrHeight: required-interface=ReqMove  # Request to move the specified axis of the seat to the indicated position (resolution 0.1%). In case of manually adjustment there would appear 0% or 100%. One value is reserved for &quot;Stop moving&quot;
        MoveSlide: required-interface=ReqMove  # Request to move the specified axis of the seat to the indicated position (resolution 0.1%). In case of manually adjustment there would appear 0% or 100%. One value is reserved for &quot;Stop moving&quot;
        MoveIncline: required-interface=ReqMove  # Request to move the specified axis of the seat to the indicated position (resolution 0.1%). In case of manually adjustment there would appear 0% or 100%. One value is reserved for &quot;Stop moving&quot;
        MoveHdHeight: required-interface=ReqMove  # Request to move the specified axis of the seat to the indicated position (resolution 0.1%). In case of manually adjustment there would appear 0% or 100%. One value is reserved for &quot;Stop moving&quot;
        MoveLumExtend: required-interface=ReqMove  # Request to move the specified axis of the seat to the indicated position (resolution 0.1%). In case of manually adjustment there would appear 0% or 100%. One value is reserved for &quot;Stop moving&quot;
        MoveLumHeight: required-interface=ReqMove  # Request to move the specified axis of the seat to the indicated position (resolution 0.1%). In case of manually adjustment there would appear 0% or 100%. One value is reserved for &quot;Stop moving&quot;
        MoveCushExtend: required-interface=ReqMove  # Request to move the specified axis of the seat to the indicated position (resolution 0.1%). In case of manually adjustment there would appear 0% or 100%. One value is reserved for &quot;Stop moving&quot;
        MoveTopIncline: required-interface=ReqMove  # Request to move the specified axis of the seat to the indicated position (resolution 0.1%). In case of manually adjustment there would appear 0% or 100%. One value is reserved for &quot;Stop moving&quot;
        MoveHdFold: required-interface=ReqMove  # Request to move the specified axis of the seat to the indicated position (resolution 0.1%). In case of manually adjustment there would appear 0% or 100%. One value is reserved for &quot;Stop moving&quot;
        MoveHdTilt: required-interface=ReqMove  # Request to move the specified axis of the seat to the indicated position (resolution 0.1%). In case of manually adjustment there would appear 0% or 100%. One value is reserved for &quot;Stop moving&quot;
        MoveBkRBolster: required-interface=ReqMove  # Request to move the specified axis of the seat to the indicated position (resolution 0.1%). In case of manually adjustment there would appear 0% or 100%. One value is reserved for &quot;Stop moving&quot;
        MoveBkLBolster: required-interface=ReqMove  # Request to move the specified axis of the seat to the indicated position (resolution 0.1%). In case of manually adjustment there would appear 0% or 100%. One value is reserved for &quot;Stop moving&quot;
        MoveCushRBolster: required-interface=ReqMove  # Request to move the specified axis of the seat to the indicated position (resolution 0.1%). In case of manually adjustment there would appear 0% or 100%. One value is reserved for &quot;Stop moving&quot;
        MoveCushLBolster: required-interface=ReqMove  # Request to move the specified axis of the seat to the indicated position (resolution 0.1%). In case of manually adjustment there would appear 0% or 100%. One value is reserved for &quot;Stop moving&quot;
        PositionHeight: required-interface=StaAxisPos  # This provides information about the current status of the seat axis actuator. There are three parts: current movement, speed and position. Position: Use case: the SeatActuatorAdapter needs the actual position to compare against the desired position (from SeatAdjustManager). Use case: the SeatAdjustManager needs the actual position so that it can be stored when necessary. Speed: Feedback due to requested speed (see af_cmd_speed) Movement: Distinction necessary between ... - Anti-pinch detected: reverse movement may be requested for protection of a person - actuator is blocked: just stop for protection of motor Uses actuator status to recalculate constraints on movement and remove the move command, if necessary.
        PositionFrHeight: required-interface=StaAxisPos  # This provides information about the current status of the seat axis actuator. There are three parts: current movement, speed and position. Position: Use case: the SeatActuatorAdapter needs the actual position to compare against the desired position (from SeatAdjustManager). Use case: the SeatAdjustManager needs the actual position so that it can be stored when necessary. Speed: Feedback due to requested speed (see af_cmd_speed) Movement: Distinction necessary between ... - Anti-pinch detected: reverse movement may be requested for protection of a person - actuator is blocked: just stop for protection of motor Uses actuator status to recalculate constraints on movement and remove the move command, if necessary.
        PositionRrHeight: required-interface=StaAxisPos  # This provides information about the current status of the seat axis actuator. There are three parts: current movement, speed and position. Position: Use case: the SeatActuatorAdapter needs the actual position to compare against the desired position (from SeatAdjustManager). Use case: the SeatAdjustManager needs the actual position so that it can be stored when necessary. Speed: Feedback due to requested speed (see af_cmd_speed) Movement: Distinction necessary between ... - Anti-pinch detected: reverse movement may be requested for protection of a person - actuator is blocked: just stop for protection of motor Uses actuator status to recalculate constraints on movement and remove the move command, if necessary.
        PositionSlide: required-interface=StaAxisPos  # This provides information about the current status of the seat axis actuator. There are three parts: current movement, speed and position. Position: Use case: the SeatActuatorAdapter needs the actual position to compare against the desired position (from SeatAdjustManager). Use case: the SeatAdjustManager needs the actual position so that it can be stored when necessary. Speed: Feedback due to requested speed (see af_cmd_speed) Movement: Distinction necessary between ... - Anti-pinch detected: reverse movement may be requested for protection of a person - actuator is blocked: just stop for protection of motor Uses actuator status to recalculate constraints on movement and remove the move command, if necessary.
        PositionIncline: required-interface=StaAxisPos  # This provides information about the current status of the seat axis actuator. There are three parts: current movement, speed and position. Position: Use case: the SeatActuatorAdapter needs the actual position to compare against the desired position (from SeatAdjustManager). Use case: the SeatAdjustManager needs the actual position so that it can be stored when necessary. Speed: Feedback due to requested speed (see af_cmd_speed) Movement: Distinction necessary between ... - Anti-pinch detected: reverse movement may be requested for protection of a person - actuator is blocked: just stop for protection of motor Uses actuator status to recalculate constraints on movement and remove the move command, if necessary.
        PositionHdHeight: required-interface=StaAxisPos  # This provides information about the current status of the seat axis actuator. There are three parts: current movement, speed and position. Position: Use case: the SeatActuatorAdapter needs the actual position to compare against the desired position (from SeatAdjustManager). Use case: the SeatAdjustManager needs the actual position so that it can be stored when necessary. Speed: Feedback due to requested speed (see af_cmd_speed) Movement: Distinction necessary between ... - Anti-pinch detected: reverse movement may be requested for protection of a person - actuator is blocked: just stop for protection of motor Uses actuator status to recalculate constraints on movement and remove the move command, if necessary.
        PositionLumExtend: required-interface=StaAxisPos  # This provides information about the current status of the seat axis actuator. There are three parts: current movement, speed and position. Position: Use case: the SeatActuatorAdapter needs the actual position to compare against the desired position (from SeatAdjustManager). Use case: the SeatAdjustManager needs the actual position so that it can be stored when necessary. Speed: Feedback due to requested speed (see af_cmd_speed) Movement: Distinction necessary between ... - Anti-pinch detected: reverse movement may be requested for protection of a person - actuator is blocked: just stop for protection of motor Uses actuator status to recalculate constraints on movement and remove the move command, if necessary.
        PositionLumHeight: required-interface=StaAxisPos  # This provides information about the current status of the seat axis actuator. There are three parts: current movement, speed and position. Position: Use case: the SeatActuatorAdapter needs the actual position to compare against the desired position (from SeatAdjustManager). Use case: the SeatAdjustManager needs the actual position so that it can be stored when necessary. Speed: Feedback due to requested speed (see af_cmd_speed) Movement: Distinction necessary between ... - Anti-pinch detected: reverse movement may be requested for protection of a person - actuator is blocked: just stop for protection of motor Uses actuator status to recalculate constraints on movement and remove the move command, if necessary.
        PositionCushExtend: required-interface=StaAxisPos  # This provides information about the current status of the seat axis actuator. There are three parts: current movement, speed and position. Position: Use case: the SeatActuatorAdapter needs the actual position to compare against the desired position (from SeatAdjustManager). Use case: the SeatAdjustManager needs the actual position so that it can be stored when necessary. Speed: Feedback due to requested speed (see af_cmd_speed) Movement: Distinction necessary between ... - Anti-pinch detected: reverse movement may be requested for protection of a person - actuator is blocked: just stop for protection of motor Uses actuator status to recalculate constraints on movement and remove the move command, if necessary.
        PositionTopIncline: required-interface=StaAxisPos  # This provides information about the current status of the seat axis actuator. There are three parts: current movement, speed and position. Position: Use case: the SeatActuatorAdapter needs the actual position to compare against the desired position (from SeatAdjustManager). Use case: the SeatAdjustManager needs the actual position so that it can be stored when necessary. Speed: Feedback due to requested speed (see af_cmd_speed) Movement: Distinction necessary between ... - Anti-pinch detected: reverse movement may be requested for protection of a person - actuator is blocked: just stop for protection of motor Uses actuator status to recalculate constraints on movement and remove the move command, if necessary.
        PositionHdFold: required-interface=StaAxisPos  # This provides information about the current status of the seat axis actuator. There are three parts: current movement, speed and position. Position: Use case: the SeatActuatorAdapter needs the actual position to compare against the desired position (from SeatAdjustManager). Use case: the SeatAdjustManager needs the actual position so that it can be stored when necessary. Speed: Feedback due to requested speed (see af_cmd_speed) Movement: Distinction necessary between ... - Anti-pinch detected: reverse movement may be requested for protection of a person - actuator is blocked: just stop for protection of motor Uses actuator status to recalculate constraints on movement and remove the move command, if necessary.
        PositionHdTilt: required-interface=StaAxisPos  # This provides information about the current status of the seat axis actuator. There are three parts: current movement, speed and position. Position: Use case: the SeatActuatorAdapter needs the actual position to compare against the desired position (from SeatAdjustManager). Use case: the SeatAdjustManager needs the actual position so that it can be stored when necessary. Speed: Feedback due to requested speed (see af_cmd_speed) Movement: Distinction necessary between ... - Anti-pinch detected: reverse movement may be requested for protection of a person - actuator is blocked: just stop for protection of motor Uses actuator status to recalculate constraints on movement and remove the move command, if necessary.
        PositionBkRBolster: required-interface=StaAxisPos  # This provides information about the current status of the seat axis actuator. There are three parts: current movement, speed and position. Position: Use case: the SeatActuatorAdapter needs the actual position to compare against the desired position (from SeatAdjustManager). Use case: the SeatAdjustManager needs the actual position so that it can be stored when necessary. Speed: Feedback due to requested speed (see af_cmd_speed) Movement: Distinction necessary between ... - Anti-pinch detected: reverse movement may be requested for protection of a person - actuator is blocked: just stop for protection of motor Uses actuator status to recalculate constraints on movement and remove the move command, if necessary.
        PositionBkLBolster: required-interface=StaAxisPos  # This provides information about the current status of the seat axis actuator. There are three parts: current movement, speed and position. Position: Use case: the SeatActuatorAdapter needs the actual position to compare against the desired position (from SeatAdjustManager). Use case: the SeatAdjustManager needs the actual position so that it can be stored when necessary. Speed: Feedback due to requested speed (see af_cmd_speed) Movement: Distinction necessary between ... - Anti-pinch detected: reverse movement may be requested for protection of a person - actuator is blocked: just stop for protection of motor Uses actuator status to recalculate constraints on movement and remove the move command, if necessary.
        PositionCushRBolster: required-interface=StaAxisPos  # This provides information about the current status of the seat axis actuator. There are three parts: current movement, speed and position. Position: Use case: the SeatActuatorAdapter needs the actual position to compare against the desired position (from SeatAdjustManager). Use case: the SeatAdjustManager needs the actual position so that it can be stored when necessary. Speed: Feedback due to requested speed (see af_cmd_speed) Movement: Distinction necessary between ... - Anti-pinch detected: reverse movement may be requested for protection of a person - actuator is blocked: just stop for protection of motor Uses actuator status to recalculate constraints on movement and remove the move command, if necessary.
        PositionCushLBolster: required-interface=StaAxisPos  # This provides information about the current status of the seat axis actuator. There are three parts: current movement, speed and position. Position: Use case: the SeatActuatorAdapter needs the actual position to compare against the desired position (from SeatAdjustManager). Use case: the SeatAdjustManager needs the actual position so that it can be stored when necessary. Speed: Feedback due to requested speed (see af_cmd_speed) Movement: Distinction necessary between ... - Anti-pinch detected: reverse movement may be requested for protection of a person - actuator is blocked: just stop for protection of motor Uses actuator status to recalculate constraints on movement and remove the move command, if necessary.
    ExteriorLight
      5 x provide port:
        OutsideBrightness: provided-interface=StaOutsideBrightness
        GlobalDimLight: provided-interface=CmdGlobalDimLight
        LowBeamInd: provided-interface=DisExtLight
        DisplayParkingLights: provided-interface=DisParkingLights
        CHLHome: provided-interface=ReqComingHomeLeavingHome
      5 x require port:
        LockingFeedback: required-interface=ReqLockingFeedback
        BrakeLightsIntensity: required-interface=BrakeLightsIntensity
        BrakeLightsOnRequestFromChassis: required-interface=BrakeLightsOnRequest
        BrakeLightsOnRequestFromKeyless: required-interface=BrakeLightsOnRequest
        StaFrontWiper: required-interface=StaWiper  # Used to switch on the exterior light in case of bad weather conditions
      7 x component:
        ExteriorLightManager: type=LightMaster
        BlinkMaster: type=BlinkMaster
        InputAdapter: type=InputAdapter
        ExteriorLightActuator: type=ExteriorLightActuator
        ELActuatorControlFront: type=ELActuatorControlFront
        ELActuatorControlRear: type=ELActuatorControlRear
        LightSensor: type=LightSensor
      delegate LightSensor.OutsideBrightness <-> outer port ExteriorLight/OutsideBrightness
      delegate ExteriorLightManager.GlobalDimLight <-> outer port ExteriorLight/GlobalDimLight
      delegate ExteriorLightManager.LowBeamInd <-> outer port ExteriorLight/LowBeamInd
      delegate ExteriorLightManager.DisplayParkingLights <-> outer port ExteriorLight/DisplayParkingLights
      delegate ExteriorLightManager.CHLHome <-> outer port ExteriorLight/CHLHome
      delegate ExteriorLightManager.LockingFeedback <-> outer port ExteriorLight/LockingFeedback
      delegate ExteriorLightManager.BrakeLightsIntensity <-> outer port ExteriorLight/BrakeLightsIntensity
      delegate ExteriorLightManager.BrakeLightsOnRequestFromChassis <-> outer port ExteriorLight/BrakeLightsOnRequestFromChassis
      delegate ExteriorLightManager.BrakeLightsOnRequestFromKeyless <-> outer port ExteriorLight/BrakeLightsOnRequestFromKeyless
      delegate ExteriorLightManager.StaFrontWiper <-> outer port ExteriorLight/StaFrontWiper
    LightMaster
      4 x provide port:
        GlobalDimLight: provided-interface=CmdGlobalDimLight
        LowBeamInd: provided-interface=DisExtLight
        DisplayParkingLights: provided-interface=DisParkingLights
        CHLHome: provided-interface=ReqComingHomeLeavingHome
      5 x require port:
        LockingFeedback: required-interface=ReqLockingFeedback
        BrakeLightsIntensity: required-interface=BrakeLightsIntensity
        BrakeLightsOnRequestFromChassis: required-interface=BrakeLightsOnRequest
        BrakeLightsOnRequestFromKeyless: required-interface=BrakeLightsOnRequest
        StaFrontWiper: required-interface=StaWiper  # Used to switch on the exterior light in case of bad weather conditions
    BlinkMaster
    InputAdapter
    ExteriorLightActuator
    ELActuatorControlFront
    ELActuatorControlRear
    LightSensor
      provide port OutsideBrightness: provided-interface=StaOutsideBrightness
    WindowControl
      require port ComfortOpenClose: required-interface=ReqCentralLocking
      component WindowControlMaster: type=WindowControlMaster
      delegate WindowControlMaster.ComfortOpenClose <-> outer port WindowControl/ComfortOpenClose
    WindowControlMaster
      require port ComfortOpenClose: required-interface=ReqCentralLocking
    WiperWasher
      provide port StaFrontWiper: provided-interface=StaWiper
      provide port DispRainSensActive: provided-interface=DispRainSens
      22 x require port:
        OutsideBrightness: required-interface=StaOutsideBrightness
        VehicleLongitudinalSpeed: required-interface=VehicleLongitudinalSpeed
        BackliteWindowState: required-interface=StaDoor
        ConvertibleRoof: required-interface=StaConvertibleRoof
        DriverDoorState: required-interface=StaDoor
        EngineHoodState: required-interface=StaEngineHood
        ActualGear: required-interface=ActualGear
        PassengerDoorState: required-interface=StaDoor
        RearLidState: required-interface=StaDoor
        SlidingRoofState: required-interface=StaSlidingRoof
        CountryCodeParameters: required-interface=CountryCode
        DateTime: required-interface=DateTimeStamp
        DisplayParkingLights: required-interface=DisParkingLights
        HMIActivateAutoWiping: required-interface=ReqActivateAutoWiping
        HMIFrontWashing: required-interface=ReqWashing
        HMIFrontWiping: required-interface=ReqWiping
        HMIHeadLampWashing: required-interface=ReqWashing
        HMIIntervalWipingSpeed: required-interface=ReqIntervalWipingSpeed
        HMIRearWashing: required-interface=ReqWashing
        HMIRearWiping: required-interface=ReqWiping
        HMIWiperPosRequest: required-interface=CmdWiperPos
        Voltage: required-interface=BatteryVoltage
      13 x component:
        WiperWasherManager: type=WWManager
        FrontNozzleHeater: type=NozzleHeater
        RearNozzleHeater: type=NozzleHeater
        HeadLampNozzleHeater: type=NozzleHeater
        EnableDisableWiperWasher: type=EnableDisableWW
        FrontWiper: type=Wiper
        RearWiper: type=Wiper
        FrontWasher: type=Washer
        RearWasher: type=Washer
        HeadLampWasher: type=Washer
        RainSensing: type=RainSensing
        FrontWasherFluidTank: type=WasherFluidTank
        RearWasherFluidTank: type=WasherFluidTank
      connect WiperWasherManager.ReqRainSensing -> RainSensing.ReqRainSensing
      connect WiperWasherManager.ReqRainSensingSensitivity -> RainSensing.ReqRainSensingSensitivity
      connect RainSensing.ErrRainSensing -> WiperWasherManager.ErrRainSensing
      connect RainSensing.ReqFrontAutoWiping -> WiperWasherManager.ReqFrontAutoWiping
      connect EnableDisableWiperWasher.DisableFrontWashing -> WiperWasherManager.DisableFrontWashing
      connect EnableDisableWiperWasher.DisableFrontWiping -> WiperWasherManager.DisableFrontWiping
      connect EnableDisableWiperWasher.DisableRearWashing -> WiperWasherManager.DisableRearWashing
      connect EnableDisableWiperWasher.DisableRearWiping -> WiperWasherManager.DisableRearWiping
      connect WiperWasherManager.StaFrontWiper -> RainSensing.StaFrontWiper
      connect WiperWasherManager.FrontNozzleHeaterActivation -> FrontNozzleHeater.Activation
      connect WiperWasherManager.RearNozzleHeaterActivation -> RearNozzleHeater.Activation
      connect WiperWasherManager.HeadLampNozzleHeaterActivation -> HeadLampNozzleHeater.Activation
      connect FrontNozzleHeater.Status -> WiperWasherManager.FrontNozzleHeaterStatus
      connect RearNozzleHeater.Status -> WiperWasherManager.RearNozzleHeaterStatus
      connect HeadLampNozzleHeater.Status -> WiperWasherManager.HeadLampNozzleHeaterStatus
      connect WiperWasherManager.FrontWasherActivation -> FrontWasher.Activation
      connect WiperWasherManager.RearWasherActivation -> RearWasher.Activation
      connect WiperWasherManager.HeadLampWasherActivation -> HeadLampWasher.Activation
      connect FrontWasher.Status -> WiperWasherManager.FrontWasherStatus
      connect RearWasher.Status -> WiperWasherManager.RearWasherStatus
      connect HeadLampWasher.Status -> WiperWasherManager.HeadLampWasherStatus
      connect WiperWasherManager.FrontWiperCommand -> FrontWiper.Command
      connect WiperWasherManager.RearWiperCommand -> RearWiper.Command
      connect WiperWasherManager.FrontWiperPositioning -> FrontWiper.Positioning
      connect WiperWasherManager.RearWiperPositioning -> RearWiper.Positioning
      connect FrontWiper.Status -> WiperWasherManager.FrontWiperStatus
      connect RearWiper.Status -> WiperWasherManager.RearWiperStatus
      connect WiperWasherManager.StaFrontWasher -> RainSensing.StaFrontWasher
      connect FrontWasherFluidTank.Status -> WiperWasherManager.FrontWasherFluidTankStatus
      connect RearWasherFluidTank.Status -> WiperWasherManager.RearWasherFluidTankStatus
      delegate RainSensing.OutsideBrightness <-> outer port WiperWasher/OutsideBrightness
      delegate WiperWasherManager.VehicleLongitudinalSpeed <-> outer port WiperWasher/VehicleLongitudinalSpeed
      delegate RainSensing.VehicleLongitudinalSpeed <-> outer port WiperWasher/VehicleLongitudinalSpeed
      delegate EnableDisableWiperWasher.BackliteWindowState <-> outer port WiperWasher/BackliteWindowState
      delegate EnableDisableWiperWasher.ConvertibleRoof <-> outer port WiperWasher/ConvertibleRoof
      delegate EnableDisableWiperWasher.DriverDoorState <-> outer port WiperWasher/DriverDoorState
      delegate EnableDisableWiperWasher.EngineHoodState <-> outer port WiperWasher/EngineHoodState
      delegate WiperWasherManager.ActualGear <-> outer port WiperWasher/ActualGear
      delegate EnableDisableWiperWasher.ActualGear <-> outer port WiperWasher/ActualGear
      delegate EnableDisableWiperWasher.PassengerDoorState <-> outer port WiperWasher/PassengerDoorState
      delegate EnableDisableWiperWasher.RearLidState <-> outer port WiperWasher/RearLidState
      delegate EnableDisableWiperWasher.SlidingRoofState <-> outer port WiperWasher/SlidingRoofState
      delegate WiperWasherManager.CountryCodeParameters <-> outer port WiperWasher/CountryCodeParameters
      delegate WiperWasherManager.DateTime <-> outer port WiperWasher/DateTime
      delegate WiperWasherManager.DisplayParkingLights <-> outer port WiperWasher/DisplayParkingLights
      delegate WiperWasherManager.HMIActivateAutoWiping <-> outer port WiperWasher/HMIActivateAutoWiping
      delegate WiperWasherManager.HMIFrontWashing <-> outer port WiperWasher/HMIFrontWashing
      delegate WiperWasherManager.HMIFrontWiping <-> outer port WiperWasher/HMIFrontWiping
      delegate WiperWasherManager.HMIHeadLampWashing <-> outer port WiperWasher/HMIHeadLampWashing
      delegate WiperWasherManager.HMIIntervalWipingSpeed <-> outer port WiperWasher/HMIIntervalWipingSpeed
      delegate WiperWasherManager.HMIRearWashing <-> outer port WiperWasher/HMIRearWashing
      delegate WiperWasherManager.HMIRearWiping <-> outer port WiperWasher/HMIRearWiping
      delegate WiperWasherManager.HMIWiperPosRequest <-> outer port WiperWasher/HMIWiperPosRequest
      delegate WiperWasherManager.Voltage <-> outer port WiperWasher/Voltage
      delegate WiperWasherManager.StaFrontWiper <-> outer port WiperWasher/StaFrontWiper
      delegate RainSensing.DispRainSensActive <-> outer port WiperWasher/DispRainSensActive
    WWManager
      14 x provide port:
        ReqRainSensing: provided-interface=ReqRainSensing  # Indicates the need for rain sensing, may be used for power-down of the rain sensor.
        ReqRainSensingSensitivity: provided-interface=ReqRainSensingSensitivity  # Indicates the requried sensitivity of the rain sensor.
        StaFrontWiper: provided-interface=StaWiper
        FrontNozzleHeaterActivation: provided-interface=CmdNozzleHeater
        RearNozzleHeaterActivation: provided-interface=CmdNozzleHeater
        HeadLampNozzleHeaterActivation: provided-interface=CmdNozzleHeater
        FrontWasherActivation: provided-interface=CmdWashing  # Front: Users demand for front window washing on/off Headlamp: Commands the actuator to activate or deactivate the headlamp washing. Rear: Users demand for rear window washing on/off
        RearWasherActivation: provided-interface=CmdWashing  # Front: Users demand for front window washing on/off Headlamp: Commands the actuator to activate or deactivate the headlamp washing. Rear: Users demand for rear window washing on/off
        HeadLampWasherActivation: provided-interface=CmdWashing  # Front: Users demand for front window washing on/off Headlamp: Commands the actuator to activate or deactivate the headlamp washing. Rear: Users demand for rear window washing on/off
        FrontWiperCommand: provided-interface=CmdWindowWiping  # Rear: Activates rear wiping. Also used to move wiper to park position out-side the window area for opening rear lid windows. Front: Sets speed and interval of front wiper. Sets several positions (e.g. service, park, winter).
        RearWiperCommand: provided-interface=CmdWindowWiping  # Rear: Activates rear wiping. Also used to move wiper to park position out-side the window area for opening rear lid windows. Front: Sets speed and interval of front wiper. Sets several positions (e.g. service, park, winter).
        FrontWiperPositioning: provided-interface=CmdWiperPos  # Rear: To open rear window move wiper to park position outside of the window area. Front: Sets several wiper positions, e.g. service, park, winter.
        RearWiperPositioning: provided-interface=CmdWiperPos  # Rear: To open rear window move wiper to park position outside of the window area. Front: Sets several wiper positions, e.g. service, park, winter.
        StaFrontWasher: provided-interface=StaWasher
      30 x require port:
        VehicleLongitudinalSpeed: required-interface=VehicleLongitudinalSpeed  # Speed dependent wiping.
        ErrRainSensing: required-interface=ErrRainsensing  # Input from rain sensor component, indicates a failure of the rain sensing system.
        ReqFrontAutoWiping: required-interface=ReqAutoWiping  # Result of the rain sensor component with information about wiping demand and requested wiping speed and/or interval speed. Immedi-ate change front wipe included here: indicates the demand for im-mediate reaction of front wipers, e.g. to react to a water &quot;splash&quot;.
        ActualGear: required-interface=ActualGear  # Automatic rear wiping on switching to reverse gear. Indicates also driver's intention (resume wiping).
        DisableFrontWashing: required-interface=ReqDisableWiperWasher  # Abstraction of vehicle specific circumstances that don't allow front washing.
        DisableFrontWiping: required-interface=ReqDisableWiperWasher  # Abstraction of vehicle specific circumstances that don't allow front wiping.
        DisableRearWashing: required-interface=ReqDisableWiperWasher  # Abstraction of vehicle specific circumstances that don't allow rear washing.
        DisableRearWiping: required-interface=ReqDisableWiperWasher  # Abstraction of vehicle specific circumstances that don't allow rear wiping.
        CountryCodeParameters: required-interface=CountryCode  # Activation of certain functionalities depending on country coding.
        DateTime: required-interface=DateTimeStamp  # Rationale: Allow altering wiping positions (to reduce wear of the wiper) based on certain amount of time passed.
        DisplayParkingLights: required-interface=DisParkingLights  # Information needed for headlamp cleaning.
        HMIActivateAutoWiping: required-interface=ReqActivateAutoWiping  # Activate automatic front wiping by user request.
        HMIFrontWashing: required-interface=ReqWashing  # Users request for washing front window.
        HMIFrontWiping: required-interface=ReqWiping  # User request for front wiper: no, one strike, interval, low speed and high speed.
        HMIHeadLampWashing: required-interface=ReqWashing  # Users request for washing headlamps
        HMIIntervalWipingSpeed: required-interface=ReqIntervalWipingSpeed  # Provides users wished interval speed.
        HMIRearWashing: required-interface=ReqWashing  # Users request for washing rear window.
        HMIRearWiping: required-interface=ReqWiping  # User request for rear wiping. Low speed and High speed are not dif-ferentiated, they are considered to be identical for the rear wiper.
        HMIWiperPosRequest: required-interface=CmdWiperPos  # User demand to place the front wiper to the service position, e.g. to inspect or control wiper blades.
        Voltage: required-interface=BatteryVoltage  # Voltage dependent activation or de-activation of certain functionalit-ites.
        FrontNozzleHeaterStatus: required-interface=StaNozzleHeater
        RearNozzleHeaterStatus: required-interface=StaNozzleHeater
        HeadLampNozzleHeaterStatus: required-interface=StaNozzleHeater
        FrontWasherStatus: required-interface=StaWasher  # Front: Status feedback. Failure feedback. In some implementations, a user wash request results also in a fixed number of wipe-cycles. If washer is defective, these wipe cylces should be suppressed. Headlamp: Status feedback. Failure feedback. Rear: Status feedback. Failure feedback.
        RearWasherStatus: required-interface=StaWasher  # Front: Status feedback. Failure feedback. In some implementations, a user wash request results also in a fixed number of wipe-cycles. If washer is defective, these wipe cylces should be suppressed. Headlamp: Status feedback. Failure feedback. Rear: Status feedback. Failure feedback.
        HeadLampWasherStatus: required-interface=StaWasher  # Front: Status feedback. Failure feedback. In some implementations, a user wash request results also in a fixed number of wipe-cycles. If washer is defective, these wipe cylces should be suppressed. Headlamp: Status feedback. Failure feedback. Rear: Status feedback. Failure feedback.
        FrontWiperStatus: required-interface=StaWiper
        RearWiperStatus: required-interface=StaWiper
        FrontWasherFluidTankStatus: required-interface=StaWasherFluid
        RearWasherFluidTankStatus: required-interface=StaWasherFluid
    EnableDisableWW
      4 x provide port, all with provided-interface=ReqDisableWiperWasher:
        DisableFrontWashing
        DisableFrontWiping
        DisableRearWashing
        DisableRearWiping
      8 x require port:
        BackliteWindowState: required-interface=StaDoor  # Do not switch on rear wiper if rear window is open or do not open up the rear window as longs as the wiper is not in park position.
        ConvertibleRoof: required-interface=StaConvertibleRoof  # Do not switch on front cleaning if convertible roof is open
        DriverDoorState: required-interface=StaDoor  # Do not switch on front cleaning if driver door is open.
        EngineHoodState: required-interface=StaEngineHood  # No activation of front wiper while engine hood is open
        ActualGear: required-interface=ActualGear
        PassengerDoorState: required-interface=StaDoor  # Do not switch on front cleaning if passenger door is open.
        RearLidState: required-interface=StaDoor  # Do not switch on rear cleaning if rear lid is open.
        SlidingRoofState: required-interface=StaSlidingRoof  # Do not switch on front cleaning if sliding roof is open
    NozzleHeater
      provide port Status: provided-interface=StaNozzleHeater  # Feedback on nozzle heater status and failure.
      require port Activation: required-interface=CmdNozzleHeater  # Activate nozzle and/or tube heating.
    Wiper
      provide port Status: provided-interface=StaWiper
      require port Command: required-interface=CmdWindowWiping
      require port Positioning: required-interface=CmdWiperPos
    Washer
      provide port Status: provided-interface=StaWasher
      require port Activation: required-interface=CmdWashing  # Receive port for getting the command for washing
    WasherFluidTank
      provide port Status: provided-interface=StaWasherFluid  # Provides the current fluid level contained within this washer tank.
    RainSensing
      provide port ErrRainSensing: provided-interface=ErrRainsensing
      provide port ReqFrontAutoWiping: provided-interface=ReqAutoWiping
      provide port DispRainSensActive: provided-interface=DispRainSens  # Informs driver, if rain sensor is currently active.
      6 x require port:
        OutsideBrightness: required-interface=StaOutsideBrightness
        ReqRainSensing: required-interface=ReqRainSensing
        ReqRainSensingSensitivity: required-interface=ReqRainSensingSensitivity
        StaFrontWasher: required-interface=StaWasher
        StaFrontWiper: required-interface=StaWiper
        VehicleLongitudinalSpeed: required-interface=VehicleLongitudinalSpeed
      component AutoWipingEvaluator: type=AutoWipingEvaluator
      component RainSensor: type=RainSensor
      connect RainSensor.StaRainAmount -> AutoWipingEvaluator.StaRainAmount
      delegate AutoWipingEvaluator.OutsideBrightness <-> outer port RainSensing/OutsideBrightness
      delegate AutoWipingEvaluator.ReqRainSensing <-> outer port RainSensing/ReqRainSensing
      delegate AutoWipingEvaluator.ReqRainSensingSensitivity <-> outer port RainSensing/ReqRainSensingSensitivity
      delegate AutoWipingEvaluator.StaFrontWasher <-> outer port RainSensing/StaFrontWasher
      delegate AutoWipingEvaluator.StaFrontWiper <-> outer port RainSensing/StaFrontWiper
      delegate AutoWipingEvaluator.VehicleLongitudinalSpeed <-> outer port RainSensing/VehicleLongitudinalSpeed
      delegate AutoWipingEvaluator.ErrRainSensing <-> outer port RainSensing/ErrRainSensing
      delegate AutoWipingEvaluator.ReqFrontAutoWiping <-> outer port RainSensing/ReqFrontAutoWiping
      delegate RainSensor.DispRainSensActive <-> outer port RainSensing/DispRainSensActive
    AutoWipingEvaluator
      provide port ErrRainSensing: provided-interface=ErrRainsensing
      provide port ReqFrontAutoWiping: provided-interface=ReqAutoWiping
      7 x require port:
        OutsideBrightness: required-interface=StaOutsideBrightness  # Outside brightness impacts the calculation of automatic wiping re-quests.
        ReqRainSensing: required-interface=ReqRainSensing
        ReqRainSensingSensitivity: required-interface=ReqRainSensingSensitivity  # The sensitivity impacts the calculation of the automatic front wiping request.
        StaFrontWasher: required-interface=StaWasher  # Front washing impacts the calculation of the automatic front wiping request
        StaFrontWiper: required-interface=StaWiper
        StaRainAmount: required-interface=StaRainAmount
        VehicleLongitudinalSpeed: required-interface=VehicleLongitudinalSpeed  # The vehicle speed impacts the calculation of the automatic wiping request.
    RainSensor
      provide port StaRainAmount: provided-interface=StaRainAmount
      provide port DispRainSensActive: provided-interface=DispRainSens  # Informs driver, if rain sensor is currently active.
    Powertrain
      15 x provide port:
        AcceleratorPedalRatio: provided-interface=AcceleratorPedalRatio
        ActualGear: provided-interface=ActualGear
        GearboxCountershaftActive: provided-interface=GearboxCountershaftActive
        EngineSpeed: provided-interface=EngineSpeed
        TargetGear: provided-interface=TargetGear
        MaximumAvailableTotalPowertrainTorqueAtWheels: provided-interface=MaximumAvailableTotalPowertrainTorqueAtWheels
        MinimumAvailableTotalPowertrainTorqueAtWheels: provided-interface=MinimumAvailableTotalPowertrainTorqueAtWheels
        DriverRequestOverridesVLCrequest: provided-interface=DriverRequestOverridesVLCrequest
        ActualPowertrainTorqueAtWheels4: provided-interface=ActualPowertrainTorqueAtWheels4
        ActualTotalPowertrainTorqueAtWheels: provided-interface=ActualTotalPowertrainTorqueAtWheels
        RequestedTotalPowertrainTorqueAtWheelsForLongitudinalControl: provided-interface=RequestedTotalPowertrainTorqueAtWheelsForLongitudinalControl
        AcceleratorPedalGradient: provided-interface=AcceleratorPedalGradient
        DriveTrainOpen: provided-interface=DriveTrainOpen
        EngineSpeedGradient: provided-interface=EngineSpeedGradient
        ShiftInProgress: provided-interface=ShiftInProgress
      19 x require port:
        Voltage: required-interface=BatteryVoltage
        Crash: required-interface=StaCrash
        MinimumTotalPowertrainTorqueAtWheelsRequestedByStabilityControlSlow: required-interface=MinimumTotalPowertrainTorqueAtWheelsRequestedByStabilityControlSlow
        MinimumTotalPowertrainTorqueAtWheelsRequestedByStabilityControlFast: required-interface=MinimumTotalPowertrainTorqueAtWheelsRequestedByStabilityControlFast
        MinimumTotalPowertrainTorqueAtWheelsRequestedByVehicleLongitudinalControl: required-interface=MinimumTotalPowertrainTorqueAtWheelsRequestedByVehicleLongitudinalControl
        MaximumTotalPowertrainTorqueAtWheelsRequestedByStabilityControlSlow: required-interface=MaximumTotalPowertrainTorqueAtWheelsRequestedByStabilityControlSlow
        MaximumTotalPowertrainTorqueAtWheelsRequestedByStabilityControlFast: required-interface=MaximumTotalPowertrainTorqueAtWheelsRequestedByStabilityControlFast
        MaximumTotalPowertrainTorqueAtWheelsRequestedByVehicleLongitudinalControl: required-interface=MaximumTotalPowertrainTorqueAtWheelsRequestedByVehicleLongitudinalControl
        ActualPowerSteeringLoad: required-interface=ActualPowerSteeringLoad
        WheelCircumSpeedsStandard: required-interface=WheelCircumSpeedsStandard
        GearshiftPreventionComfortbyVLC: required-interface=GearshiftPreventionComfortbyVLC
        RequestedPowerSteeringLoad: required-interface=RequestedPowerSteeringLoad
        ABSControlActive: required-interface=ABSControlActive
        GearShiftPreventionStability: required-interface=GearShiftPreventionStability
        VehicleLongitudinalSpeed: required-interface=VehicleLongitudinalSpeed
        BrakePedalPressed: required-interface=BrakePedalPressed
        BrakePedalValue: required-interface=BrakePedalValue
        MaxVehicleSpeedBrakeActuator: required-interface=MaxVehicleSpeedBrakeActuator
        PGearRequest: required-interface=PGearRequest
      5 x component:
        PTC: type=PTC
        TransmissionSystem: type=TransmissionSystem
        CombustionEngine: type=CombustionEngine
        ElectricMachine: type=ElectricMachine
        VehicleMotionPT: type=VehicleMotionPT
      connect VehicleMotionPT.AcceleratorPedalRatio -> PTC.AcceleratorPedalRatio
      connect TransmissionSystem.ActualGear -> PTC.ActualGear
      connect TransmissionSystem.ActualGear -> VehicleMotionPT.ActualGear
      connect TransmissionSystem.GearboxCountershaftActive -> PTC.GearboxCountershaftActive
      connect TransmissionSystem.GearboxCountershaftActive -> VehicleMotionPT.GearboxCountershaftActive
      connect CombustionEngine.EngineSpeed -> PTC.EngineSpeed
      connect CombustionEngine.EngineSpeed -> TransmissionSystem.EngineSpeed
      connect CombustionEngine.EngineSpeed -> VehicleMotionPT.EngineSpeed
      connect TransmissionSystem.GearLeverPosition -> PTC.GearLeverPosition
      connect TransmissionSystem.GearLeverPosition -> VehicleMotionPT.GearLeverPosition
      connect TransmissionSystem.TransmissionType -> PTC.TransmissionType
      connect TransmissionSystem.TransmissionType -> VehicleMotionPT.TransmissionType
      connect CombustionEngine.ActualEngineTorqueAtCrankshaft -> PTC.ActualEngineTorqueAtCrankshaft
      connect CombustionEngine.InternalEngineTorqueLosses -> PTC.InternalEngineTorqueLosses
      connect CombustionEngine.MaximumTorqueImmediatelyAvailableForPTCatCrankshaft -> PTC.MaximumTorqueImmediatelyAvailableForPTCatCrankshaft
      connect CombustionEngine.MinimumTorqueImmediatelyAvailableForPTCatCrankshaft -> PTC.MinimumTorqueImmediatelyAvailableForPTCatCrankshaft
      connect CombustionEngine.MaximumAvailableTorqueAtCrankshaftForPTC -> PTC.MaximumAvailableTorqueAtCrankshaftForPTC
      connect CombustionEngine.MaximumTorqueAtCrankshaftForPTCatOptimumConditions -> PTC.MaximumTorqueAtCrankshaftForPTCatOptimumConditions
      connect CombustionEngine.MinimumTorqueAtCrankshaftForPTCrealizedBySlowPath -> PTC.MinimumTorqueAtCrankshaftForPTCrealizedBySlowPath
      connect CombustionEngine.MinimumTorqueAtCrankshaftForPTCRealizedBySlowAndFastPath -> PTC.MinimumTorqueAtCrankshaftForPTCRealizedBySlowAndFastPath
      connect CombustionEngine.EngineTemperature -> PTC.EngineTemperature
      connect CombustionEngine.MaxEngineSpeed -> PTC.MaxEngineSpeed
      connect CombustionEngine.MaximumAllowedTorqueAtCrankshaftForEngineProtection -> PTC.MaximumAllowedTorqueAtCrankshaftForEngineProtection
      connect CombustionEngine.TorqueReserveRequestFromEngineToPTC -> PTC.TorqueReserveRequestFromEngineToPTC
      connect CombustionEngine.MinimumEngineSpeedSetpoint -> PTC.MinimumEngineSpeedSetpoint
      connect VehicleMotionPT.VirtualAcceleratorPedalRatio -> PTC.VirtualAcceleratorPedalRatio
      connect TransmissionSystem.ActualClutchState -> PTC.ActualClutchState
      connect TransmissionSystem.TargetClutchState -> PTC.TargetClutchState
      connect TransmissionSystem.TransmissionInputSpeed -> PTC.TransmissionInputSpeed
      connect TransmissionSystem.ActualTorqueRatio -> PTC.ActualTorqueRatio
      connect TransmissionSystem.ActualTorqueRatio -> VehicleMotionPT.ActualTorqueRatio
      connect TransmissionSystem.TransmissionOilTemperature -> PTC.TransmissionOilTemperature
      connect TransmissionSystem.MaximumAllowedTorqueAtClutchForTransmissionProtection -> PTC.MaximumAllowedTorqueAtClutchForTransmissionProtection
      connect TransmissionSystem.MaximumTorqueAtClutchRequestedByTransmissionFast -> PTC.MaximumTorqueAtClutchRequestedByTransmissionFast
      connect TransmissionSystem.MaximumTorqueAtClutchRequestedByTransmissionSlow -> PTC.MaximumTorqueAtClutchRequestedByTransmissionSlow
      connect TransmissionSystem.MinimumTorqueAtClutchRequestedByTransmissionFast -> PTC.MinimumTorqueAtClutchRequestedByTransmissionFast
      connect TransmissionSystem.MinimumTorqueAtClutchRequestedByTransmisssionSlow -> PTC.MinimumTorqueAtClutchRequestedByTransmisssionSlow
      connect TransmissionSystem.TargetGear -> PTC.TargetGear
      connect VehicleMotionPT.KickdownDetected -> PTC.KickdownDetected
      connect TransmissionSystem.ActualTransmissionOilPumpLoad -> PTC.ActualTransmissionOilPumpLoad
      connect TransmissionSystem.RequestedTransmissionOilPumpLoad -> PTC.RequestedTransmissionOilPumpLoad
      connect VehicleMotionPT.MaximumTotalPowertrainTorqueAtWheelsForSafetyVehicleSpeedLimitation -> PTC.MaximumTotalPowertrainTorqueAtWheelsForSafetyVehicleSpeedLimitation
      connect VehicleMotionPT.TotalPowertrainTorqueAtWheelsRequestedByDriverSlow -> PTC.TotalPowertrainTorqueAtWheelsRequestedByDriverSlow
      connect VehicleMotionPT.TotalPowertrainTorqueAtWheelsRequestedByDriverFast -> PTC.TotalPowertrainTorqueAtWheelsRequestedByDriverFast
      connect VehicleMotionPT.TorqueAtClutchRequestedByDriverSlow -> PTC.TorqueAtClutchRequestedByDriverSlow
      connect VehicleMotionPT.TorqueAtClutchRequestedByDriverFast -> PTC.TorqueAtClutchRequestedByDriverFast
      connect TransmissionSystem.ActualPowertrainTorqueAtWheelsFromTransmissionSystem4 -> PTC.ActualPowertrainTorqueAtWheelsFromTransmissionSystem4
      connect CombustionEngine.DynamicEngineTorqueCorrection -> PTC.DynamicEngineTorqueCorrection
      connect PTC.EngineSpeedSetpoint -> CombustionEngine.EngineSpeedSetpoint
      connect PTC.EngineTorqueAtCrankshaftRequestedByPTCslow -> CombustionEngine.EngineTorqueAtCrankshaftRequestedByPTCslow
      connect PTC.EngineTorqueAtCrankshaftRequestedByPTCfast -> CombustionEngine.EngineTorqueAtCrankshaftRequestedByPTCfast
      connect PTC.AllowedTransmissionOilPumpLoad -> TransmissionSystem.AllowedTransmissionOilPumpLoad
      connect PTC.MaximumAvailableTotalPowertrainTorqueAtWheelsForDriver -> VehicleMotionPT.MaximumAvailableTotalPowertrainTorqueAtWheelsForDriver
      connect PTC.MinimumAvailableTotalPowertrainTorqueAtWheelsForDriver -> VehicleMotionPT.MinimumAvailableTotalPowertrainTorqueAtWheelsForDriver
      connect PTC.TorqueReserveRequestFromPTCtoEngine -> CombustionEngine.TorqueReserveRequestFromPTCtoEngine
      connect PTC.ActualTorqueAtClutch -> TransmissionSystem.ActualTorqueAtClutch
      connect PTC.TheoreticalActualTorqueAtClutchWithoutShiftEnergyManagement -> TransmissionSystem.TheoreticalActualTorqueAtClutchWithoutShiftEnergyManagement
      connect PTC.TheoreticalRequestedTorqueAtClutchWithoutShiftEnergyManagement -> TransmissionSystem.TheoreticalRequestedTorqueAtClutchWithoutShiftEnergyManagement
      connect PTC.DynamicActualTorqueAtClutch -> TransmissionSystem.DynamicActualTorqueAtClutch
      connect PTC.PowertrainTorqueDistributionToWheelsRequestedByPTC4 -> TransmissionSystem.PowertrainTorqueDistributionToWheelsRequestedByPTC4
      connect PTC.MaximumAvailableTorqueAtClutchForDriver -> VehicleMotionPT.MaximumAvailableTorqueAtClutchForDriver
      connect PTC.MinimumAvailableTorqueAtClutchForDriver -> VehicleMotionPT.MinimumAvailableTorqueAtClutchForDriver
      connect PTC.SpeedAtClutch -> TransmissionSystem.SpeedAtClutch
      connect PTC.SpeedAtClutch -> VehicleMotionPT.SpeedAtClutch
      delegate CombustionEngine.Voltage <-> outer port Powertrain/Voltage
      delegate CombustionEngine.Crash <-> outer port Powertrain/Crash
      delegate VehicleMotionPT.AcceleratorPedalRatio <-> outer port Powertrain/AcceleratorPedalRatio
      delegate TransmissionSystem.ActualGear <-> outer port Powertrain/ActualGear
      delegate TransmissionSystem.GearboxCountershaftActive <-> outer port Powertrain/GearboxCountershaftActive
      delegate CombustionEngine.EngineSpeed <-> outer port Powertrain/EngineSpeed
      delegate PTC.MinimumTotalPowertrainTorqueAtWheelsRequestedByStabilityControlSlow <-> outer port Powertrain/MinimumTotalPowertrainTorqueAtWheelsRequestedByStabilityControlSlow
      delegate PTC.MinimumTotalPowertrainTorqueAtWheelsRequestedByStabilityControlFast <-> outer port Powertrain/MinimumTotalPowertrainTorqueAtWheelsRequestedByStabilityControlFast
      delegate PTC.MinimumTotalPowertrainTorqueAtWheelsRequestedByVehicleLongitudinalControl <-> outer port Powertrain/MinimumTotalPowertrainTorqueAtWheelsRequestedByVehicleLongitudinalControl
      delegate PTC.MaximumTotalPowertrainTorqueAtWheelsRequestedByStabilityControlSlow <-> outer port Powertrain/MaximumTotalPowertrainTorqueAtWheelsRequestedByStabilityControlSlow
      delegate PTC.MaximumTotalPowertrainTorqueAtWheelsRequestedByStabilityControlFast <-> outer port Powertrain/MaximumTotalPowertrainTorqueAtWheelsRequestedByStabilityControlFast
      delegate PTC.MaximumTotalPowertrainTorqueAtWheelsRequestedByVehicleLongitudinalControl <-> outer port Powertrain/MaximumTotalPowertrainTorqueAtWheelsRequestedByVehicleLongitudinalControl
      delegate PTC.ActualPowerSteeringLoad <-> outer port Powertrain/ActualPowerSteeringLoad
      delegate TransmissionSystem.TargetGear <-> outer port Powertrain/TargetGear
      delegate PTC.WheelCircumSpeedsStandard <-> outer port Powertrain/WheelCircumSpeedsStandard
      delegate PTC.GearshiftPreventionComfortbyVLC <-> outer port Powertrain/GearshiftPreventionComfortbyVLC
      delegate PTC.RequestedPowerSteeringLoad <-> outer port Powertrain/RequestedPowerSteeringLoad
      delegate PTC.MaximumAvailableTotalPowertrainTorqueAtWheels <-> outer port Powertrain/MaximumAvailableTotalPowertrainTorqueAtWheels
      delegate PTC.MinimumAvailableTotalPowertrainTorqueAtWheels <-> outer port Powertrain/MinimumAvailableTotalPowertrainTorqueAtWheels
      delegate PTC.DriverRequestOverridesVLCrequest <-> outer port Powertrain/DriverRequestOverridesVLCrequest
      delegate PTC.ActualPowertrainTorqueAtWheels4 <-> outer port Powertrain/ActualPowertrainTorqueAtWheels4
      delegate PTC.ActualTotalPowertrainTorqueAtWheels <-> outer port Powertrain/ActualTotalPowertrainTorqueAtWheels
      delegate PTC.RequestedTotalPowertrainTorqueAtWheelsForLongitudinalControl <-> outer port Powertrain/RequestedTotalPowertrainTorqueAtWheelsForLongitudinalControl
      delegate PTC.ABSControlActive <-> outer port Powertrain/ABSControlActive
      delegate VehicleMotionPT.AcceleratorPedalGradient <-> outer port Powertrain/AcceleratorPedalGradient
      delegate TransmissionSystem.DriveTrainOpen <-> outer port Powertrain/DriveTrainOpen
      delegate CombustionEngine.EngineSpeedGradient <-> outer port Powertrain/EngineSpeedGradient
      delegate PTC.GearShiftPreventionStability <-> outer port Powertrain/GearShiftPreventionStability
      delegate TransmissionSystem.ShiftInProgress <-> outer port Powertrain/ShiftInProgress
      delegate PTC.VehicleLongitudinalSpeed <-> outer port Powertrain/VehicleLongitudinalSpeed
      delegate VehicleMotionPT.VehicleLongitudinalSpeed <-> outer port Powertrain/VehicleLongitudinalSpeed
      delegate VehicleMotionPT.BrakePedalPressed <-> outer port Powertrain/BrakePedalPressed
      delegate VehicleMotionPT.BrakePedalValue <-> outer port Powertrain/BrakePedalValue
      delegate VehicleMotionPT.MaxVehicleSpeedBrakeActuator <-> outer port Powertrain/MaxVehicleSpeedBrakeActuator
