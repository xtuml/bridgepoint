[part 4 of 4: package /AUTOSAR/ComponentTypes]
AUTOSAR XML (schema 3.0.2)
package /AUTOSAR/ComponentTypes  (continued)
  83 x composition type:  (continued)
    PTC
      21 x provide port:
        EngineSpeedSetpoint: provided-interface=EngineSpeedSetpoint  # N/A
        EngineTorqueAtCrankshaftRequestedByPTCslow: provided-interface=EngineTorqueAtCrankshaftRequestedByPTCslow  # N/A
        EngineTorqueAtCrankshaftRequestedByPTCfast: provided-interface=EngineTorqueAtCrankshaftRequestedByPTCfast  # N/A
        AllowedTransmissionOilPumpLoad: provided-interface=AllowedTransmissionOilPumpLoad  # N/A
        MaximumAvailableTotalPowertrainTorqueAtWheels: provided-interface=MaximumAvailableTotalPowertrainTorqueAtWheels  # N/A
        MaximumAvailableTotalPowertrainTorqueAtWheelsForDriver: provided-interface=MaximumAvailableTotalPowertrainTorqueAtWheelsForDriver  # N/A
        MinimumAvailableTotalPowertrainTorqueAtWheels: provided-interface=MinimumAvailableTotalPowertrainTorqueAtWheels  # N/A
        MinimumAvailableTotalPowertrainTorqueAtWheelsForDriver: provided-interface=MinimumAvailableTotalPowertrainTorqueAtWheelsForDriver  # N/A
        DriverRequestOverridesVLCrequest: provided-interface=DriverRequestOverridesVLCrequest  # N/A
        TorqueReserveRequestFromPTCtoEngine: provided-interface=TorqueReserveRequestFromPTCtoEngine  # N/A
        ActualTorqueAtClutch: provided-interface=ActualTorqueAtClutch  # N/A
        TheoreticalActualTorqueAtClutchWithoutShiftEnergyManagement: provided-interface=TheoreticalActualTorqueAtClutchWithoutShiftEnergyManagement  # N/A
        TheoreticalRequestedTorqueAtClutchWithoutShiftEnergyManagement: provided-interface=TheoreticalRequestedTorqueAtClutchWithoutShiftEnergyManagement  # N/A
        DynamicActualTorqueAtClutch: provided-interface=DynamicActualTorqueAtClutch  # N/A
        PowertrainTorqueDistributionToWheelsRequestedByPTC4: provided-interface=PowertrainTorqueDistributionToWheelsRequestedByPTC4  # N/A
        ActualPowertrainTorqueAtWheels4: provided-interface=ActualPowertrainTorqueAtWheels4  # N/A
        ActualTotalPowertrainTorqueAtWheels: provided-interface=ActualTotalPowertrainTorqueAtWheels  # N/A
        RequestedTotalPowertrainTorqueAtWheelsForLongitudinalControl: provided-interface=RequestedTotalPowertrainTorqueAtWheelsForLongitudinalControl  # N/A
        MaximumAvailableTorqueAtClutchForDriver: provided-interface=MaximumAvailableTorqueAtClutchForDriver  # N/A
        MinimumAvailableTorqueAtClutchForDriver: provided-interface=MinimumAvailableTorqueAtClutchForDriver  # N/A
        SpeedAtClutch: provided-interface=SpeedAtClutch  # N/A
      54 x require port:
        AcceleratorPedalRatio: required-interface=AcceleratorPedalRatio
        ActualGear: required-interface=ActualGear  # N/A
        GearboxCountershaftActive: required-interface=GearboxCountershaftActive  # N/A
        EngineSpeed: required-interface=EngineSpeed  # N/A
        GearLeverPosition: required-interface=GearLeverPosition  # N/A
        TransmissionType: required-interface=TransmissionType  # N/A
        ActualEngineTorqueAtCrankshaft: required-interface=ActualEngineTorqueAtCrankshaft  # N/A
        InternalEngineTorqueLosses: required-interface=InternalEngineTorqueLosses  # N/A
        MaximumTorqueImmediatelyAvailableForPTCatCrankshaft: required-interface=MaximumTorqueImmediatelyAvailableForPTCatCrankshaft  # N/A
        MinimumTorqueImmediatelyAvailableForPTCatCrankshaft: required-interface=MinimumTorqueImmediatelyAvailableForPTCatCrankshaft  # N/A
        MaximumAvailableTorqueAtCrankshaftForPTC: required-interface=MaximumAvailableTorqueAtCrankshaftForPTC  # N/A
        MaximumTorqueAtCrankshaftForPTCatOptimumConditions: required-interface=MaximumTorqueAtCrankshaftForPTCatOptimumConditions  # N/A
        MinimumTorqueAtCrankshaftForPTCrealizedBySlowPath: required-interface=MinimumTorqueAtCrankshaftForPTCrealizedBySlowPath  # N/A
        MinimumTorqueAtCrankshaftForPTCRealizedBySlowAndFastPath: required-interface=MinimumTorqueAtCrankshaftForPTCRealizedBySlowAndFastPath  # N/A
        EngineTemperature: required-interface=EngineTemperature  # N/A
        MaxEngineSpeed: required-interface=MaxEngineSpeed  # N/A
        MaximumAllowedTorqueAtCrankshaftForEngineProtection: required-interface=MaximumAllowedTorqueAtCrankshaftForEngineProtection  # N/A
        TorqueReserveRequestFromEngineToPTC: required-interface=TorqueReserveRequestFromEngineToPTC  # N/A
        MinimumEngineSpeedSetpoint: required-interface=MinimumEngineSpeedSetpoint  # N/A
        MinimumTotalPowertrainTorqueAtWheelsRequestedByStabilityControlSlow: required-interface=MinimumTotalPowertrainTorqueAtWheelsRequestedByStabilityControlSlow  # N/A
        MinimumTotalPowertrainTorqueAtWheelsRequestedByStabilityControlFast: required-interface=MinimumTotalPowertrainTorqueAtWheelsRequestedByStabilityControlFast  # N/A
        MinimumTotalPowertrainTorqueAtWheelsRequestedByVehicleLongitudinalControl: required-interface=MinimumTotalPowertrainTorqueAtWheelsRequestedByVehicleLongitudinalControl  # N/A
        MaximumTotalPowertrainTorqueAtWheelsRequestedByStabilityControlSlow: required-interface=MaximumTotalPowertrainTorqueAtWheelsRequestedByStabilityControlSlow  # N/A
        MaximumTotalPowertrainTorqueAtWheelsRequestedByStabilityControlFast: required-interface=MaximumTotalPowertrainTorqueAtWheelsRequestedByStabilityControlFast  # N/A
        MaximumTotalPowertrainTorqueAtWheelsRequestedByVehicleLongitudinalControl: required-interface=MaximumTotalPowertrainTorqueAtWheelsRequestedByVehicleLongitudinalControl  # N/A
        VirtualAcceleratorPedalRatio: required-interface=VirtualAcceleratorPedalRatio  # N/A
        ActualClutchState: required-interface=ActualClutchState  # N/A
        TargetClutchState: required-interface=TargetClutchState  # N/A
        TransmissionInputSpeed: required-interface=TransmissionInputSpeed  # N/A
        ActualTorqueRatio: required-interface=ActualTorqueRatio  # N/A
        TransmissionOilTemperature: required-interface=TransmissionOilTemperature  # N/A
        MaximumAllowedTorqueAtClutchForTransmissionProtection: required-interface=MaximumAllowedTorqueAtClutchForTransmissionProtection  # N/A
        MaximumTorqueAtClutchRequestedByTransmissionFast: required-interface=MaximumTorqueAtClutchRequestedByTransmissionFast  # N/A
        MaximumTorqueAtClutchRequestedByTransmissionSlow: required-interface=MaximumTorqueAtClutchRequestedByTransmissionSlow  # N/A
        MinimumTorqueAtClutchRequestedByTransmissionFast: required-interface=MinimumTorqueAtClutchRequestedByTransmissionFast  # N/A
        MinimumTorqueAtClutchRequestedByTransmisssionSlow: required-interface=MinimumTorqueAtClutchRequestedByTransmisssionSlow  # N/A
        ActualPowerSteeringLoad: required-interface=ActualPowerSteeringLoad  # N/A
        TargetGear: required-interface=TargetGear  # N/A
        KickdownDetected: required-interface=KickdownDetected  # N/A
        WheelCircumSpeedsStandard: required-interface=WheelCircumSpeedsStandard  # N/A
        GearshiftPreventionComfortbyVLC: required-interface=GearshiftPreventionComfortbyVLC  # N/A
        RequestedPowerSteeringLoad: required-interface=RequestedPowerSteeringLoad  # N/A
        ActualTransmissionOilPumpLoad: required-interface=ActualTransmissionOilPumpLoad  # N/A
        RequestedTransmissionOilPumpLoad: required-interface=RequestedTransmissionOilPumpLoad  # N/A
        MaximumTotalPowertrainTorqueAtWheelsForSafetyVehicleSpeedLimitation: required-interface=MaximumTotalPowertrainTorqueAtWheelsForSafetyVehicleSpeedLimitation  # N/A
        TotalPowertrainTorqueAtWheelsRequestedByDriverSlow: required-interface=TotalPowertrainTorqueAtWheelsRequestedByDriverSlow  # N/A
        TotalPowertrainTorqueAtWheelsRequestedByDriverFast: required-interface=TotalPowertrainTorqueAtWheelsRequestedByDriverFast  # N/A
        TorqueAtClutchRequestedByDriverSlow: required-interface=TorqueAtClutchRequestedByDriverSlow  # N/A
        TorqueAtClutchRequestedByDriverFast: required-interface=TorqueAtClutchRequestedByDriverFast  # N/A
        ActualPowertrainTorqueAtWheelsFromTransmissionSystem4: required-interface=ActualPowertrainTorqueAtWheelsFromTransmissionSystem4  # N/A
        DynamicEngineTorqueCorrection: required-interface=DynamicEngineTorqueCorrection  # N/A
        ABSControlActive: required-interface=ABSControlActive  # N/A
        GearShiftPreventionStability: required-interface=GearShiftPreventionStability  # N/A
        VehicleLongitudinalSpeed: required-interface=VehicleLongitudinalSpeed
    TransmissionSystem
      20 x provide port:
        ActualGear: provided-interface=ActualGear
        GearboxCountershaftActive: provided-interface=GearboxCountershaftActive
        GearLeverPosition: provided-interface=GearLeverPosition  # N/A
        TransmissionType: provided-interface=TransmissionType  # N/A
        ActualClutchState: provided-interface=ActualClutchState  # N/A
        TargetClutchState: provided-interface=TargetClutchState  # N/A
        TransmissionInputSpeed: provided-interface=TransmissionInputSpeed  # N/A
        ActualTorqueRatio: provided-interface=ActualTorqueRatio  # N/A
        TransmissionOilTemperature: provided-interface=TransmissionOilTemperature  # N/A
        MaximumAllowedTorqueAtClutchForTransmissionProtection: provided-interface=MaximumAllowedTorqueAtClutchForTransmissionProtection  # N/A
        MaximumTorqueAtClutchRequestedByTransmissionFast: provided-interface=MaximumTorqueAtClutchRequestedByTransmissionFast  # N/A
        MaximumTorqueAtClutchRequestedByTransmissionSlow: provided-interface=MaximumTorqueAtClutchRequestedByTransmissionSlow  # N/A
        MinimumTorqueAtClutchRequestedByTransmissionFast: provided-interface=MinimumTorqueAtClutchRequestedByTransmissionFast  # N/A
        MinimumTorqueAtClutchRequestedByTransmisssionSlow: provided-interface=MinimumTorqueAtClutchRequestedByTransmisssionSlow  # N/A
        TargetGear: provided-interface=TargetGear  # N/A
        ActualTransmissionOilPumpLoad: provided-interface=ActualTransmissionOilPumpLoad  # N/A
        RequestedTransmissionOilPumpLoad: provided-interface=RequestedTransmissionOilPumpLoad  # N/A
        ActualPowertrainTorqueAtWheelsFromTransmissionSystem4: provided-interface=ActualPowertrainTorqueAtWheelsFromTransmissionSystem4  # N/A
        DriveTrainOpen: provided-interface=DriveTrainOpen
        ShiftInProgress: provided-interface=ShiftInProgress
      8 x require port:
        EngineSpeed: required-interface=EngineSpeed  # N/A
        AllowedTransmissionOilPumpLoad: required-interface=AllowedTransmissionOilPumpLoad  # N/A
        ActualTorqueAtClutch: required-interface=ActualTorqueAtClutch  # N/A
        TheoreticalActualTorqueAtClutchWithoutShiftEnergyManagement: required-interface=TheoreticalActualTorqueAtClutchWithoutShiftEnergyManagement  # N/A
        TheoreticalRequestedTorqueAtClutchWithoutShiftEnergyManagement: required-interface=TheoreticalRequestedTorqueAtClutchWithoutShiftEnergyManagement  # N/A
        DynamicActualTorqueAtClutch: required-interface=DynamicActualTorqueAtClutch  # N/A
        PowertrainTorqueDistributionToWheelsRequestedByPTC4: required-interface=PowertrainTorqueDistributionToWheelsRequestedByPTC4  # N/A
        SpeedAtClutch: required-interface=SpeedAtClutch  # N/A
    ElectricMachine
    CombustionEngine
      16 x provide port:
        EngineSpeed: provided-interface=EngineSpeed
        ActualEngineTorqueAtCrankshaft: provided-interface=ActualEngineTorqueAtCrankshaft
        InternalEngineTorqueLosses: provided-interface=InternalEngineTorqueLosses
        MaximumTorqueImmediatelyAvailableForPTCatCrankshaft: provided-interface=MaximumTorqueImmediatelyAvailableForPTCatCrankshaft
        MinimumTorqueImmediatelyAvailableForPTCatCrankshaft: provided-interface=MinimumTorqueImmediatelyAvailableForPTCatCrankshaft
        MaximumAvailableTorqueAtCrankshaftForPTC: provided-interface=MaximumAvailableTorqueAtCrankshaftForPTC
        MaximumTorqueAtCrankshaftForPTCatOptimumConditions: provided-interface=MaximumTorqueAtCrankshaftForPTCatOptimumConditions
        MinimumTorqueAtCrankshaftForPTCrealizedBySlowPath: provided-interface=MinimumTorqueAtCrankshaftForPTCrealizedBySlowPath
        MinimumTorqueAtCrankshaftForPTCRealizedBySlowAndFastPath: provided-interface=MinimumTorqueAtCrankshaftForPTCRealizedBySlowAndFastPath
        EngineTemperature: provided-interface=EngineTemperature
        MaxEngineSpeed: provided-interface=MaxEngineSpeed
        MaximumAllowedTorqueAtCrankshaftForEngineProtection: provided-interface=MaximumAllowedTorqueAtCrankshaftForEngineProtection
        TorqueReserveRequestFromEngineToPTC: provided-interface=TorqueReserveRequestFromEngineToPTC
        MinimumEngineSpeedSetpoint: provided-interface=MinimumEngineSpeedSetpoint
        DynamicEngineTorqueCorrection: provided-interface=DynamicEngineTorqueCorrection
        EngineSpeedGradient: provided-interface=EngineSpeedGradient
      6 x require port:
        Voltage: required-interface=BatteryVoltage
        Crash: required-interface=StaCrash
        EngineSpeedSetpoint: required-interface=EngineSpeedSetpoint
        EngineTorqueAtCrankshaftRequestedByPTCslow: required-interface=EngineTorqueAtCrankshaftRequestedByPTCslow
        EngineTorqueAtCrankshaftRequestedByPTCfast: required-interface=EngineTorqueAtCrankshaftRequestedByPTCfast
        TorqueReserveRequestFromPTCtoEngine: required-interface=TorqueReserveRequestFromPTCtoEngine
      component EngineSpeedAndPosition: type=EngineSpeedAndPosition
      component EngineTorqueModeManagement: type=EngineTorqueModeManagement
      component CombustionEngineMisc: type=CombustionEngineMisc
      delegate CombustionEngineMisc.Voltage <-> outer port CombustionEngine/Voltage
      delegate CombustionEngineMisc.Crash <-> outer port CombustionEngine/Crash
      delegate EngineSpeedAndPosition.EngineSpeed <-> outer port CombustionEngine/EngineSpeed
      delegate EngineTorqueModeManagement.ActualEngineTorqueAtCrankshaft <-> outer port CombustionEngine/ActualEngineTorqueAtCrankshaft
      delegate EngineTorqueModeManagement.InternalEngineTorqueLosses <-> outer port CombustionEngine/InternalEngineTorqueLosses
      delegate EngineTorqueModeManagement.MaximumTorqueImmediatelyAvailableForPTCatCrankshaft <-> outer port CombustionEngine/MaximumTorqueImmediatelyAvailableForPTCatCrankshaft
      delegate EngineTorqueModeManagement.MinimumTorqueImmediatelyAvailableForPTCatCrankshaft <-> outer port CombustionEngine/MinimumTorqueImmediatelyAvailableForPTCatCrankshaft
      delegate EngineTorqueModeManagement.MaximumAvailableTorqueAtCrankshaftForPTC <-> outer port CombustionEngine/MaximumAvailableTorqueAtCrankshaftForPTC
      delegate EngineTorqueModeManagement.MaximumTorqueAtCrankshaftForPTCatOptimumConditions <-> outer port CombustionEngine/MaximumTorqueAtCrankshaftForPTCatOptimumConditions
      delegate EngineTorqueModeManagement.MinimumTorqueAtCrankshaftForPTCrealizedBySlowPath <-> outer port CombustionEngine/MinimumTorqueAtCrankshaftForPTCrealizedBySlowPath
      delegate EngineTorqueModeManagement.MinimumTorqueAtCrankshaftForPTCRealizedBySlowAndFastPath <-> outer port CombustionEngine/MinimumTorqueAtCrankshaftForPTCRealizedBySlowAndFastPath
      delegate CombustionEngineMisc.EngineTemperature <-> outer port CombustionEngine/EngineTemperature
      delegate EngineTorqueModeManagement.MaxEngineSpeed <-> outer port CombustionEngine/MaxEngineSpeed
      delegate EngineTorqueModeManagement.MaximumAllowedTorqueAtCrankshaftForEngineProtection <-> outer port CombustionEngine/MaximumAllowedTorqueAtCrankshaftForEngineProtection
      delegate EngineTorqueModeManagement.TorqueReserveRequestFromEngineToPTC <-> outer port CombustionEngine/TorqueReserveRequestFromEngineToPTC
      delegate EngineTorqueModeManagement.MinimumEngineSpeedSetpoint <-> outer port CombustionEngine/MinimumEngineSpeedSetpoint
      delegate EngineTorqueModeManagement.DynamicEngineTorqueCorrection <-> outer port CombustionEngine/DynamicEngineTorqueCorrection
      delegate EngineTorqueModeManagement.EngineSpeedSetpoint <-> outer port CombustionEngine/EngineSpeedSetpoint
      delegate EngineTorqueModeManagement.EngineTorqueAtCrankshaftRequestedByPTCslow <-> outer port CombustionEngine/EngineTorqueAtCrankshaftRequestedByPTCslow
      delegate EngineTorqueModeManagement.EngineTorqueAtCrankshaftRequestedByPTCfast <-> outer port CombustionEngine/EngineTorqueAtCrankshaftRequestedByPTCfast
      delegate EngineTorqueModeManagement.TorqueReserveRequestFromPTCtoEngine <-> outer port CombustionEngine/TorqueReserveRequestFromPTCtoEngine
      delegate EngineSpeedAndPosition.EngineSpeedGradient <-> outer port CombustionEngine/EngineSpeedGradient
    EngineSpeedAndPosition
      provide port EngineSpeed: provided-interface=EngineSpeed
      provide port EngineSpeedGradient: provided-interface=EngineSpeedGradient  # N/A
    EngineTorqueModeManagement
      13 x provide port:
        ActualEngineTorqueAtCrankshaft: provided-interface=ActualEngineTorqueAtCrankshaft
        InternalEngineTorqueLosses: provided-interface=InternalEngineTorqueLosses
        MaximumTorqueImmediatelyAvailableForPTCatCrankshaft: provided-interface=MaximumTorqueImmediatelyAvailableForPTCatCrankshaft
        MinimumTorqueImmediatelyAvailableForPTCatCrankshaft: provided-interface=MinimumTorqueImmediatelyAvailableForPTCatCrankshaft
        MaximumAvailableTorqueAtCrankshaftForPTC: provided-interface=MaximumAvailableTorqueAtCrankshaftForPTC
        MaximumTorqueAtCrankshaftForPTCatOptimumConditions: provided-interface=MaximumTorqueAtCrankshaftForPTCatOptimumConditions
        MinimumTorqueAtCrankshaftForPTCrealizedBySlowPath: provided-interface=MinimumTorqueAtCrankshaftForPTCrealizedBySlowPath
        MinimumTorqueAtCrankshaftForPTCRealizedBySlowAndFastPath: provided-interface=MinimumTorqueAtCrankshaftForPTCRealizedBySlowAndFastPath
        MaxEngineSpeed: provided-interface=MaxEngineSpeed
        MaximumAllowedTorqueAtCrankshaftForEngineProtection: provided-interface=MaximumAllowedTorqueAtCrankshaftForEngineProtection
        TorqueReserveRequestFromEngineToPTC: provided-interface=TorqueReserveRequestFromEngineToPTC
        MinimumEngineSpeedSetpoint: provided-interface=MinimumEngineSpeedSetpoint
        DynamicEngineTorqueCorrection: provided-interface=DynamicEngineTorqueCorrection
      4 x require port:
        EngineSpeedSetpoint: required-interface=EngineSpeedSetpoint
        EngineTorqueAtCrankshaftRequestedByPTCslow: required-interface=EngineTorqueAtCrankshaftRequestedByPTCslow
        EngineTorqueAtCrankshaftRequestedByPTCfast: required-interface=EngineTorqueAtCrankshaftRequestedByPTCfast
        TorqueReserveRequestFromPTCtoEngine: required-interface=TorqueReserveRequestFromPTCtoEngine
    CombustionEngineMisc
      provide port EngineTemperature: provided-interface=EngineTemperature
      require port Voltage: required-interface=BatteryVoltage
      require port Crash: required-interface=StaCrash
    VehicleMotionPT
      9 x provide port:
        AcceleratorPedalRatio: provided-interface=AcceleratorPedalRatio
        VirtualAcceleratorPedalRatio: provided-interface=VirtualAcceleratorPedalRatio
        KickdownDetected: provided-interface=KickdownDetected
        MaximumTotalPowertrainTorqueAtWheelsForSafetyVehicleSpeedLimitation: provided-interface=MaximumTotalPowertrainTorqueAtWheelsForSafetyVehicleSpeedLimitation
        TotalPowertrainTorqueAtWheelsRequestedByDriverSlow: provided-interface=TotalPowertrainTorqueAtWheelsRequestedByDriverSlow
        TotalPowertrainTorqueAtWheelsRequestedByDriverFast: provided-interface=TotalPowertrainTorqueAtWheelsRequestedByDriverFast
        TorqueAtClutchRequestedByDriverSlow: provided-interface=TorqueAtClutchRequestedByDriverSlow
        TorqueAtClutchRequestedByDriverFast: provided-interface=TorqueAtClutchRequestedByDriverFast
        AcceleratorPedalGradient: provided-interface=AcceleratorPedalGradient
      15 x require port:
        ActualGear: required-interface=ActualGear
        GearboxCountershaftActive: required-interface=GearboxCountershaftActive
        EngineSpeed: required-interface=EngineSpeed
        GearLeverPosition: required-interface=GearLeverPosition
        ActualTorqueRatio: required-interface=ActualTorqueRatio
        TransmissionType: required-interface=TransmissionType
        MaximumAvailableTotalPowertrainTorqueAtWheelsForDriver: required-interface=MaximumAvailableTotalPowertrainTorqueAtWheelsForDriver
        MinimumAvailableTotalPowertrainTorqueAtWheelsForDriver: required-interface=MinimumAvailableTotalPowertrainTorqueAtWheelsForDriver
        MaximumAvailableTorqueAtClutchForDriver: required-interface=MaximumAvailableTorqueAtClutchForDriver
        MinimumAvailableTorqueAtClutchForDriver: required-interface=MinimumAvailableTorqueAtClutchForDriver
        SpeedAtClutch: required-interface=SpeedAtClutch
        VehicleLongitudinalSpeed: required-interface=VehicleLongitudinalSpeed
        BrakePedalPressed: required-interface=BrakePedalPressed
        BrakePedalValue: required-interface=BrakePedalValue
        MaxVehicleSpeedBrakeActuator: required-interface=MaxVehicleSpeedBrakeActuator
      component DriverReq: type=DriverReq
      component AcceleratorPedalPosition: type=AcceleratorPedalPosition
      component SafetyVehicleSpeedLimitation: type=SafetyVehicleSpeedLimitation
      connect AcceleratorPedalPosition.AcceleratorPedalRatio -> DriverReq.AcceleratorPedalRatio
      connect AcceleratorPedalPosition.AcceleratorPedalRatioFiltered -> DriverReq.AcceleratorPedalRatioFiltered
      delegate AcceleratorPedalPosition.AcceleratorPedalRatio <-> outer port VehicleMotionPT/AcceleratorPedalRatio
      delegate DriverReq.ActualGear <-> outer port VehicleMotionPT/ActualGear
      delegate DriverReq.GearboxCountershaftActive <-> outer port VehicleMotionPT/GearboxCountershaftActive
      delegate DriverReq.EngineSpeed <-> outer port VehicleMotionPT/EngineSpeed
      delegate DriverReq.GearLeverPosition <-> outer port VehicleMotionPT/GearLeverPosition
      delegate DriverReq.ActualTorqueRatio <-> outer port VehicleMotionPT/ActualTorqueRatio
      delegate DriverReq.TransmissionType <-> outer port VehicleMotionPT/TransmissionType
      delegate DriverReq.VirtualAcceleratorPedalRatio <-> outer port VehicleMotionPT/VirtualAcceleratorPedalRatio
      delegate AcceleratorPedalPosition.KickdownDetected <-> outer port VehicleMotionPT/KickdownDetected
      delegate SafetyVehicleSpeedLimitation.MaximumTotalPowertrainTorqueAtWheelsForSafetyVehicleSpeedLimitation <-> outer port VehicleMotionPT/MaximumTotalPowertrainTorqueAtWheelsForSafetyVehicleSpeedLimitation
      delegate DriverReq.TotalPowertrainTorqueAtWheelsRequestedByDriverSlow <-> outer port VehicleMotionPT/TotalPowertrainTorqueAtWheelsRequestedByDriverSlow
      delegate DriverReq.TotalPowertrainTorqueAtWheelsRequestedByDriverFast <-> outer port VehicleMotionPT/TotalPowertrainTorqueAtWheelsRequestedByDriverFast
      delegate DriverReq.TorqueAtClutchRequestedByDriverSlow <-> outer port VehicleMotionPT/TorqueAtClutchRequestedByDriverSlow
      delegate DriverReq.TorqueAtClutchRequestedByDriverFast <-> outer port VehicleMotionPT/TorqueAtClutchRequestedByDriverFast
      delegate DriverReq.MaximumAvailableTotalPowertrainTorqueAtWheelsForDriver <-> outer port VehicleMotionPT/MaximumAvailableTotalPowertrainTorqueAtWheelsForDriver
      delegate DriverReq.MinimumAvailableTotalPowertrainTorqueAtWheelsForDriver <-> outer port VehicleMotionPT/MinimumAvailableTotalPowertrainTorqueAtWheelsForDriver
      delegate DriverReq.MaximumAvailableTorqueAtClutchForDriver <-> outer port VehicleMotionPT/MaximumAvailableTorqueAtClutchForDriver
      delegate DriverReq.MinimumAvailableTorqueAtClutchForDriver <-> outer port VehicleMotionPT/MinimumAvailableTorqueAtClutchForDriver
      delegate DriverReq.SpeedAtClutch <-> outer port VehicleMotionPT/SpeedAtClutch
      delegate AcceleratorPedalPosition.AcceleratorPedalGradient <-> outer port VehicleMotionPT/AcceleratorPedalGradient
      delegate DriverReq.VehicleLongitudinalSpeed <-> outer port VehicleMotionPT/VehicleLongitudinalSpeed
      delegate DriverReq.BrakePedalPressed <-> outer port VehicleMotionPT/BrakePedalPressed
      delegate DriverReq.BrakePedalValue <-> outer port VehicleMotionPT/BrakePedalValue
      delegate SafetyVehicleSpeedLimitation.MaxVehicleSpeedBrakeActuator <-> outer port VehicleMotionPT/MaxVehicleSpeedBrakeActuator
    DriverReq
      5 x provide port:
        VirtualAcceleratorPedalRatio: provided-interface=VirtualAcceleratorPedalRatio  # N/A
        TotalPowertrainTorqueAtWheelsRequestedByDriverSlow: provided-interface=TotalPowertrainTorqueAtWheelsRequestedByDriverSlow  # N/A
        TotalPowertrainTorqueAtWheelsRequestedByDriverFast: provided-interface=TotalPowertrainTorqueAtWheelsRequestedByDriverFast  # N/A
        TorqueAtClutchRequestedByDriverSlow: provided-interface=TorqueAtClutchRequestedByDriverSlow  # N/A
        TorqueAtClutchRequestedByDriverFast: provided-interface=TorqueAtClutchRequestedByDriverFast  # N/A
      16 x require port:
        AcceleratorPedalRatio: required-interface=AcceleratorPedalRatio
        AcceleratorPedalRatioFiltered: required-interface=AcceleratorPedalRatioFiltered
        ActualGear: required-interface=ActualGear  # N/A
        GearboxCountershaftActive: required-interface=GearboxCountershaftActive  # N/A
        EngineSpeed: required-interface=EngineSpeed  # N/A
        GearLeverPosition: required-interface=GearLeverPosition  # N/A
        ActualTorqueRatio: required-interface=ActualTorqueRatio  # N/A
        TransmissionType: required-interface=TransmissionType  # N/A
        MaximumAvailableTotalPowertrainTorqueAtWheelsForDriver: required-interface=MaximumAvailableTotalPowertrainTorqueAtWheelsForDriver  # N/A
        MinimumAvailableTotalPowertrainTorqueAtWheelsForDriver: required-interface=MinimumAvailableTotalPowertrainTorqueAtWheelsForDriver  # N/A
        MaximumAvailableTorqueAtClutchForDriver: required-interface=MaximumAvailableTorqueAtClutchForDriver  # N/A
        MinimumAvailableTorqueAtClutchForDriver: required-interface=MinimumAvailableTorqueAtClutchForDriver  # N/A
        SpeedAtClutch: required-interface=SpeedAtClutch  # N/A
        VehicleLongitudinalSpeed: required-interface=VehicleLongitudinalSpeed  # N/A
        BrakePedalPressed: required-interface=BrakePedalPressed  # N/A
        BrakePedalValue: required-interface=BrakePedalValue  # N/A
    AcceleratorPedalPosition
      4 x provide port:
        AcceleratorPedalRatio: provided-interface=AcceleratorPedalRatio
        AcceleratorPedalRatioFiltered: provided-interface=AcceleratorPedalRatioFiltered
        KickdownDetected: provided-interface=KickdownDetected
        AcceleratorPedalGradient: provided-interface=AcceleratorPedalGradient
    SafetyVehicleSpeedLimitation
      provide port MaximumTotalPowertrainTorqueAtWheelsForSafetyVehicleSpeedLimitation: provided-interface=MaximumTotalPowertrainTorqueAtWheelsForSafetyVehicleSpeedLimitation
      require port MaxVehicleSpeedBrakeActuator: required-interface=MaxVehicleSpeedBrakeActuator
    Chassis
      29 x provide port:
        ABSControlActive: provided-interface=ABSControlActive
        ActiveDamperStatus: provided-interface=ActiveDamperStatus
        ActiveStabilizerStatus: provided-interface=ActiveStabilizerStatus
        ActualBodyLevelMode: provided-interface=ActualBodyLevelMode
        BodyLevelActuatorStatus: provided-interface=BodyLevelActuatorStatus
        BodyLevelControl: provided-interface=BodyLevelControl
        BrakeLightsIntensity: provided-interface=BrakeLightsIntensity
        BrakeLightsOnRequestFromChassis: provided-interface=BrakeLightsOnRequest
        BrakePedalPressed: provided-interface=BrakePedalPressed
        BrakePedalValue: provided-interface=BrakePedalValue
        ErrorStatusSteeringBSTS: provided-interface=ErrorStatusSteeringBSTS
        ErrorStatusSteeringBSAS: provided-interface=ErrorStatusSteeringBSAS
        ErrorStatusSteeringBRWS: provided-interface=ErrorStatusSteeringBRWS
        FullActiveSuspensionStatus: provided-interface=FullActiveSuspensionStatus
        MaxVehicleSpeedBrakeActuator: provided-interface=MaxVehicleSpeedBrakeActuator
        PGearRequest: provided-interface=PGearRequest
        SwitchableSpringStatus: provided-interface=SwitchableSpringStatus
        VehicleLongitudinalSpeed: provided-interface=VehicleLongitudinalSpeed
        WheelCircumSpeedsStandard: provided-interface=WheelCircumSpeedsStandard
        ActualPowerSteeringLoad: provided-interface=ActualPowerSteeringLoad
        RequestedPowerSteeringLoad: provided-interface=RequestedPowerSteeringLoad
        GearshiftPreventionComfortbyVLC: provided-interface=GearshiftPreventionComfortbyVLC
        GearShiftPreventionStability: provided-interface=GearShiftPreventionStability
        MinimumTotalPowertrainTorqueAtWheelsRequestedByStabilityControlSlow: provided-interface=MinimumTotalPowertrainTorqueAtWheelsRequestedByStabilityControlSlow
        MinimumTotalPowertrainTorqueAtWheelsRequestedByStabilityControlFast: provided-interface=MinimumTotalPowertrainTorqueAtWheelsRequestedByStabilityControlFast
        MaximumTotalPowertrainTorqueAtWheelsRequestedByStabilityControlSlow: provided-interface=MaximumTotalPowertrainTorqueAtWheelsRequestedByStabilityControlSlow
        MaximumTotalPowertrainTorqueAtWheelsRequestedByStabilityControlFast: provided-interface=MaximumTotalPowertrainTorqueAtWheelsRequestedByStabilityControlFast
        MinimumTotalPowertrainTorqueAtWheelsRequestedByVehicleLongitudinalControl: provided-interface=MinimumTotalPowertrainTorqueAtWheelsRequestedByVehicleLongitudinalControl
        MaximumTotalPowertrainTorqueAtWheelsRequestedByVehicleLongitudinalControl: provided-interface=MaximumTotalPowertrainTorqueAtWheelsRequestedByVehicleLongitudinalControl
      23 x require port:
        Voltage: required-interface=BatteryVoltage
        AcceleratorPedalRatio: required-interface=AcceleratorPedalRatio
        ActualGear: required-interface=ActualGear
        EngineSpeed: required-interface=EngineSpeed
        TargetGear: required-interface=TargetGear
        MaximumAvailableTotalPowertrainTorqueAtWheels: required-interface=MaximumAvailableTotalPowertrainTorqueAtWheels
        MinimumAvailableTotalPowertrainTorqueAtWheels: required-interface=MinimumAvailableTotalPowertrainTorqueAtWheels
        DriverRequestOverridesVLCrequest: required-interface=DriverRequestOverridesVLCrequest
        ActualPowertrainTorqueAtWheels4: required-interface=ActualPowertrainTorqueAtWheels4
        ActualTotalPowertrainTorqueAtWheels: required-interface=ActualTotalPowertrainTorqueAtWheels
        RequestedTotalPowertrainTorqueAtWheelsForLongitudinalControl: required-interface=RequestedTotalPowertrainTorqueAtWheelsForLongitudinalControl
        AcceleratorPedalGradient: required-interface=AcceleratorPedalGradient
        DriverPresenceFlag: required-interface=DriverPresenceFlag
        DriveTrainOpen: required-interface=DriveTrainOpen
        EngineSpeedGradient: required-interface=EngineSpeedGradient
        GearboxCountershaftActive: required-interface=GearboxCountershaftActive
        DriverDoorState: required-interface=StaDoor
        PassengerDoorState: required-interface=StaDoor
        RearLeftDoorState: required-interface=StaDoor
        RearRightDoorState: required-interface=StaDoor
        RearLidState: required-interface=StaDoor
        BackliteWindowState: required-interface=StaDoor
        ShiftInProgress: required-interface=ShiftInProgress
      11 x component:
        ACC: type=ACC
        ESC: type=ESC
        SSM: type=SSM
        EPB: type=EPB
        VLC: type=VLC
        RSC: type=RSC
        Steering: type=Steering
        HighLevelSteeringVSS: type=HighLevelSteeringVSS
        HighLevelSteeringDAS: type=HighLevelSteeringDAS
        Suspension: type=Suspension
        ChassisSensorComponents: type=ChassisSensorComponents
      connect ESC.ABSControlActive -> ACC.ABSControlActive
      connect ESC.ABSControlActive -> SSM.ABSControlActive
      connect ESC.ABSControlActive -> VLC.ABSControlActive
      connect ESC.ABSControlActive -> RSC.ABSControlActive
      connect ESC.ABSControlActive -> Steering.ABSControlActive
      connect ESC.ABSControlActiveWheel -> RSC.ABSControlActiveWheel
      connect Suspension.AbsoluteEstimatedBodyPitchAngle -> ACC.AbsoluteEstimatedBodyPitchAngle
      connect Suspension.AbsoluteEstimatedBodyPitchAngle -> ESC.AbsoluteEstimatedBodyPitchAngle
      connect Suspension.AbsoluteEstimatedBodyPitchAngle -> SSM.AbsoluteEstimatedBodyPitchAngle
      connect Suspension.AbsoluteEstimatedBodyPitchAngle -> EPB.AbsoluteEstimatedBodyPitchAngle
      connect Suspension.AbsoluteEstimatedBodyPitchAngle -> RSC.AbsoluteEstimatedBodyPitchAngle
      connect Suspension.AbsoluteEstimatedBodyPitchAngle -> Steering.AbsoluteEstimatedBodyPitchAngle
      connect Suspension.AbsoluteEstimatedBodyRollAngle -> ESC.AbsoluteEstimatedBodyRollAngle
      connect Suspension.AbsoluteEstimatedBodyRollAngle -> RSC.AbsoluteEstimatedBodyRollAngle
      connect Suspension.AbsoluteEstimatedBodyRollAngle -> Steering.AbsoluteEstimatedBodyRollAngle
      connect Suspension.AbsoluteMeasuredBodyRollAngleStandard -> ESC.AbsoluteMeasuredBodyRollAngleStandard
      connect Suspension.AbsoluteMeasuredBodyRollAngleStandard -> RSC.AbsoluteMeasuredBodyRollAngleStandard
      connect Suspension.AbsoluteMeasuredBodyRollAngleStandard -> Steering.AbsoluteMeasuredBodyRollAngleStandard
      connect Suspension.ActiveDamperStatus -> ESC.ActiveDamperStatus
      connect Suspension.ActiveDamperStatus -> RSC.ActiveDamperStatus
      connect Suspension.ActiveStabilizerStatus -> ESC.ActiveStabilizerStatus
      connect Suspension.ActiveStabilizerStatus -> RSC.ActiveStabilizerStatus
      connect Suspension.ActiveStabilizerStatus -> HighLevelSteeringVSS.ActiveStabilizerStatus
      connect ChassisSensorComponents.ActiveSteerMotorAngleFrontBase -> Steering.ActiveSteerMotorAngleFrontBase
      connect Suspension.ActualBodyLevelMode -> RSC.ActualBodyLevelMode
      connect Suspension.ActualBodyLevelMode -> Steering.ActualBodyLevelMode
      connect ESC.ActualBrakeYawTorque -> Suspension.ActualBrakeYawTorque
      connect Suspension.ActualDamperControlTuning -> ESC.ActualDamperControlTuning
      connect Suspension.ActualDamperControlTuning -> RSC.ActualDamperControlTuning
      connect Suspension.ActualDamperControlTuning -> Steering.ActualDamperControlTuning
      connect Steering.ActualEstimatedRoadWheelAngleFront -> ACC.ActualEstimatedRoadWheelAngleFront
      connect Steering.ActualEstimatedRoadWheelAngleFront -> ESC.ActualEstimatedRoadWheelAngleFront
      connect Steering.ActualEstimatedRoadWheelAngleFront -> RSC.ActualEstimatedRoadWheelAngleFront
      connect Steering.ActualEstimatedRoadWheelAngleFront -> HighLevelSteeringVSS.ActualEstimatedRoadWheelAngleFront
      connect Steering.ActualEstimatedRoadWheelAngleFront -> HighLevelSteeringDAS.ActualEstimatedRoadWheelAngleFront
      connect Steering.ActualEstimatedRoadWheelAngleFront -> Suspension.ActualEstimatedRoadWheelAngleFront
      connect Steering.ActualEstimatedRoadWheelAngleFrontSpeed -> ACC.ActualEstimatedRoadWheelAngleFrontSpeed
      connect Steering.ActualEstimatedRoadWheelAngleFrontSpeed -> ESC.ActualEstimatedRoadWheelAngleFrontSpeed
      connect Steering.ActualEstimatedRoadWheelAngleFrontSpeed -> RSC.ActualEstimatedRoadWheelAngleFrontSpeed
      connect Steering.ActualEstimatedRoadWheelAngleFrontSpeed -> HighLevelSteeringVSS.ActualEstimatedRoadWheelAngleFrontSpeed
      connect Steering.ActualEstimatedRoadWheelAngleFrontSpeed -> HighLevelSteeringDAS.ActualEstimatedRoadWheelAngleFrontSpeed
      connect Steering.ActualEstimatedRoadWheelAngleFrontSpeed -> Suspension.ActualEstimatedRoadWheelAngleFrontSpeed
      connect Steering.ActualEstimatedRoadWheelAngleRear -> ACC.ActualEstimatedRoadWheelAngleRear
      connect Steering.ActualEstimatedRoadWheelAngleRear -> ESC.ActualEstimatedRoadWheelAngleRear
      connect Steering.ActualEstimatedRoadWheelAngleRear -> RSC.ActualEstimatedRoadWheelAngleRear
      connect Steering.ActualEstimatedRoadWheelAngleRear -> HighLevelSteeringVSS.ActualEstimatedRoadWheelAngleRear
      connect Steering.ActualEstimatedRoadWheelAngleRear -> HighLevelSteeringDAS.ActualEstimatedRoadWheelAngleRear
      connect Steering.ActualEstimatedRoadWheelAngleRear -> Suspension.ActualEstimatedRoadWheelAngleRear
      connect ESC.BrakeActuatorMode -> SSM.BrakeActuatorMode
      connect ESC.BrakeActuatorOverheated -> SSM.BrakeActuatorOverheated
      connect ESC.BrakeActuatorOverheated -> EPB.BrakeActuatorOverheated
      connect ESC.BrakeActuatorOverheated -> VLC.BrakeActuatorOverheated
      connect ESC.BrakeActuatorOverheated -> RSC.BrakeActuatorOverheated
      connect ESC.BrakeActuatorSaturation -> VLC.BrakeActuatorSaturation
      connect ESC.BrakeActuatorSaturation -> RSC.BrakeActuatorSaturation
      connect ESC.BrakeActuatorSaturationWheel -> VLC.BrakeActuatorSaturationWheel
      connect ESC.BrakeActuatorSaturationWheel -> RSC.BrakeActuatorSaturationWheel
      connect ESC.BrakeActuatorStatus_BOD_RSC -> RSC.BrakeActuatorStatus_BOD_RSC
      connect ESC.BrakeActuatorStatus_BOD_SSM -> SSM.BrakeActuatorStatus_BOD_SSM
      connect ESC.BrakeActuatorStatus_BOD_VLC -> VLC.BrakeActuatorStatus_BOD_VLC
      connect VLC.BrakeAssistRequest -> ESC.BrakeAssistRequest
      connect ESC.BrakePedalOverride -> ACC.BrakePedalOverride
      connect ESC.BrakePedalOverride -> VLC.BrakePedalOverride
      connect ESC.BrakePedalPressed -> ACC.BrakePedalPressed
      connect ESC.BrakePedalPressed -> SSM.BrakePedalPressed
      connect ESC.BrakePedalPressed -> EPB.BrakePedalPressed
      connect ESC.BrakePedalPressed -> VLC.BrakePedalPressed
      connect ESC.BrakePedalPressed -> RSC.BrakePedalPressed
      connect ESC.BrakePedalPressed -> Suspension.BrakePedalPressed
      connect ESC.BrakePedalValue -> VLC.BrakePedalValue
      connect ESC.BrakePedalValue -> Suspension.BrakePedalValue
      connect VLC.BrakeReadyRequest -> ESC.BrakeReadyRequest
      connect VLC.BrakeRequestMode -> ESC.BrakeRequestMode
      connect RSC.ByPassSlipControlRequestByRSC -> ESC.ByPassSlipControlRequestByRSC
      connect ACC.ComfortAccelerationCommandInterface -> VLC.ComfortAccelerationCommandInterface
      connect VLC.ComfortAccelerationFeedbackInterface -> ACC.ComfortAccelerationFeedbackInterface
      connect ChassisSensorComponents.DriverSteerTorqueBase -> Steering.DriverSteerTorqueBase
      connect Steering.DriverSteerTorqueStandard -> HighLevelSteeringVSS.DriverSteerTorqueStandard
      connect Steering.DriverSteerTorqueStandard -> HighLevelSteeringDAS.DriverSteerTorqueStandard
      connect EPB.EPBActuatorMode -> ESC.EPBActuatorMode
      connect EPB.EPBActuatorMode -> SSM.EPBActuatorMode
      connect EPB.EPBActuatorStatus -> ESC.EPBActuatorStatus
      connect EPB.EPBActuatorStatus -> SSM.EPBActuatorStatus
      connect EPB.EPBActuatorTorque -> ESC.EPBActuatorTorque
      connect EPB.EPBActuatorTorque -> SSM.EPBActuatorTorque
      connect EPB.EPBControlButtonState -> ESC.EPBControlButtonState
      connect EPB.EPBControlButtonState -> SSM.EPBControlButtonState
      connect EPB.EPBControlButtonState -> VLC.EPBControlButtonState
      connect Steering.ErrorStatusSteeringBSTS -> ESC.ErrorStatusSteeringBSTS
      connect Steering.ErrorStatusSteeringBSTS -> RSC.ErrorStatusSteeringBSTS
      connect Steering.ErrorStatusSteeringBSTS -> HighLevelSteeringVSS.ErrorStatusSteeringBSTS
      connect Steering.ErrorStatusSteeringBSTS -> HighLevelSteeringDAS.ErrorStatusSteeringBSTS
      connect Steering.ErrorStatusSteeringBSAS -> ESC.ErrorStatusSteeringBSAS
      connect Steering.ErrorStatusSteeringBSAS -> RSC.ErrorStatusSteeringBSAS
      connect Steering.ErrorStatusSteeringBSAS -> HighLevelSteeringVSS.ErrorStatusSteeringBSAS
      connect Steering.ErrorStatusSteeringBSAS -> HighLevelSteeringDAS.ErrorStatusSteeringBSAS
      connect Steering.ErrorStatusSteeringBRWS -> ESC.ErrorStatusSteeringBRWS
      connect Steering.ErrorStatusSteeringBRWS -> RSC.ErrorStatusSteeringBRWS
      connect Steering.ErrorStatusSteeringBRWS -> HighLevelSteeringVSS.ErrorStatusSteeringBRWS
      connect Steering.ErrorStatusSteeringBRWS -> HighLevelSteeringDAS.ErrorStatusSteeringBRWS
      connect Suspension.EstimatedDamperForces -> ESC.EstimatedDamperForces
      connect Suspension.EstimatedDamperForces -> RSC.EstimatedDamperForces
      connect Suspension.EstimatedDamperForces -> Steering.EstimatedDamperForces
      connect Steering.EstimatedDriverRoadWheelAngleFrontSpeedWish -> ACC.EstimatedDriverRoadWheelAngleFrontSpeedWish
      connect Steering.EstimatedDriverRoadWheelAngleFrontSpeedWish -> ESC.EstimatedDriverRoadWheelAngleFrontSpeedWish
      connect Steering.EstimatedDriverRoadWheelAngleFrontSpeedWish -> RSC.EstimatedDriverRoadWheelAngleFrontSpeedWish
      connect Steering.EstimatedDriverRoadWheelAngleFrontSpeedWish -> HighLevelSteeringVSS.EstimatedDriverRoadWheelAngleFrontSpeedWish
      connect Steering.EstimatedDriverRoadWheelAngleFrontSpeedWish -> HighLevelSteeringDAS.EstimatedDriverRoadWheelAngleFrontSpeedWish
      connect Steering.EstimatedDriverRoadWheelAngleFrontSpeedWish -> Suspension.EstimatedDriverRoadWheelAngleFrontSpeedWish
      connect Steering.EstimatedDriverRoadWheelAngleFrontWish -> ACC.EstimatedDriverRoadWheelAngleFrontWish
      connect Steering.EstimatedDriverRoadWheelAngleFrontWish -> ESC.EstimatedDriverRoadWheelAngleFrontWish
      connect Steering.EstimatedDriverRoadWheelAngleFrontWish -> RSC.EstimatedDriverRoadWheelAngleFrontWish
      connect Steering.EstimatedDriverRoadWheelAngleFrontWish -> HighLevelSteeringVSS.EstimatedDriverRoadWheelAngleFrontWish
      connect Steering.EstimatedDriverRoadWheelAngleFrontWish -> HighLevelSteeringDAS.EstimatedDriverRoadWheelAngleFrontWish
      connect Steering.EstimatedDriverRoadWheelAngleFrontWish -> Suspension.EstimatedDriverRoadWheelAngleFrontWish
      connect Suspension.EstimatedRideHeightLevelFront -> ESC.EstimatedRideHeightLevelFront
      connect Suspension.EstimatedRideHeightLevelFront -> VLC.EstimatedRideHeightLevelFront
      connect Suspension.EstimatedRideHeightLevelFront -> RSC.EstimatedRideHeightLevelFront
      connect Suspension.EstimatedRideHeightLevelFront -> Steering.EstimatedRideHeightLevelFront
      connect Suspension.EstimatedRideHeightLevelRear -> ESC.EstimatedRideHeightLevelRear
      connect Suspension.EstimatedRideHeightLevelRear -> VLC.EstimatedRideHeightLevelRear
      connect Suspension.EstimatedRideHeightLevelRear -> RSC.EstimatedRideHeightLevelRear
      connect Suspension.EstimatedRideHeightLevelRear -> Steering.EstimatedRideHeightLevelRear
      connect Suspension.EstimatedSpringForces -> ESC.EstimatedSpringForces
      connect Suspension.EstimatedSpringForces -> RSC.EstimatedSpringForces
      connect Suspension.EstimatedSpringForces -> Steering.EstimatedSpringForces
      connect Suspension.EstimatedVehicleBodyVerticalAccel -> ESC.EstimatedVehicleBodyVerticalAccel
      connect Suspension.EstimatedVehicleBodyVerticalAccel -> RSC.EstimatedVehicleBodyVerticalAccel
      connect Suspension.EstimatedVehicleBodyVerticalAccel -> Steering.EstimatedVehicleBodyVerticalAccel
      connect Suspension.EstimatedVehicleMass -> ESC.EstimatedVehicleMass
      connect Suspension.EstimatedVehicleMass -> RSC.EstimatedVehicleMass
      connect Suspension.EstimatedVehicleMass -> Steering.EstimatedVehicleMass
      connect VLC.EstimatedVehicleMassFromVLC -> ESC.EstimatedVehicleMassFromVLC
      connect VLC.EstimatedVehicleMassFromVLC -> SSM.EstimatedVehicleMassFromVLC
      connect VLC.EstimatedVehicleMassFromVLC -> RSC.EstimatedVehicleMassFromVLC
      connect VLC.EstimatedVehicleMassFromVLC -> Suspension.EstimatedVehicleMassFromVLC
      connect Suspension.EstimatedVerticalWheelForces -> ESC.EstimatedVerticalWheelForces
      connect Suspension.EstimatedVerticalWheelForces -> RSC.EstimatedVerticalWheelForces
      connect Suspension.EstimatedVerticalWheelForces -> Steering.EstimatedVerticalWheelForces
      connect Suspension.EstimatedWheelLoadDifferenceFront -> ESC.EstimatedWheelLoadDifferenceFront
      connect Suspension.EstimatedWheelLoadDifferenceFront -> RSC.EstimatedWheelLoadDifferenceFront
      connect Suspension.EstimatedWheelLoadDifferenceFront -> Steering.EstimatedWheelLoadDifferenceFront
      connect Suspension.EstimatedWheelLoadDifferenceRear -> ESC.EstimatedWheelLoadDifferenceRear
      connect Suspension.EstimatedWheelLoadDifferenceRear -> RSC.EstimatedWheelLoadDifferenceRear
      connect Suspension.EstimatedWheelLoadDifferenceRear -> Steering.EstimatedWheelLoadDifferenceRear
      connect Suspension.EstimatedWheelVerticalAcceleration -> ESC.EstimatedWheelVerticalAcceleration
      connect Suspension.EstimatedWheelVerticalAcceleration -> RSC.EstimatedWheelVerticalAcceleration
      connect Suspension.EstimatedWheelVerticalAcceleration -> Steering.EstimatedWheelVerticalAcceleration
      connect Suspension.FullActiveSuspensionControlTuning -> ESC.FullActiveSuspensionControlTuning
      connect Suspension.FullActiveSuspensionControlTuning -> RSC.FullActiveSuspensionControlTuning
      connect Suspension.FullActiveSuspensionControlTuning -> HighLevelSteeringVSS.FullActiveSuspensionControlTuning
      connect Suspension.FullActiveSuspensionControlTuning -> HighLevelSteeringDAS.FullActiveSuspensionControlTuning
      connect Suspension.FullActiveSuspensionStatus -> ESC.FullActiveSuspensionStatus
      connect Suspension.FullActiveSuspensionStatus -> RSC.FullActiveSuspensionStatus
      connect Suspension.FullActiveSuspensionStatus -> HighLevelSteeringVSS.FullActiveSuspensionStatus
      connect Suspension.FullActiveSuspensionStatus -> HighLevelSteeringDAS.FullActiveSuspensionStatus
      connect SSM.HOD_State -> VLC.HOD_State
      connect ESC.IntendedVehicleBrakeTorque -> SSM.IntendedVehicleBrakeTorque
      connect ESC.IntendedVehicleBrakeTorque -> VLC.IntendedVehicleBrakeTorque
      connect ESC.IntendedVehicleBrakeTorque -> RSC.IntendedVehicleBrakeTorque
      connect ESC.IntendedVehicleBrakeTorque -> Suspension.IntendedVehicleBrakeTorque
      connect ChassisSensorComponents.LatAccBase -> ESC.LatAccBase
      connect ChassisSensorComponents.LatAccBase -> RSC.LatAccBase
      connect ESC.LatAccRollCompStandardByESC -> ACC.LatAccRollCompStandardByESC
      connect ESC.LatAccRollCompStandardByESC -> RSC.LatAccRollCompStandardByESC
      connect ESC.LatAccRollCompStandardByESC -> HighLevelSteeringVSS.LatAccRollCompStandardByESC
      connect ESC.LatAccRollCompStandardByESC -> HighLevelSteeringDAS.LatAccRollCompStandardByESC
      connect ESC.LatAccRollCompStandardByESC -> Suspension.LatAccRollCompStandardByESC
      connect ESC.LatAccStandardByESC -> ACC.LatAccStandardByESC
      connect ESC.LatAccStandardByESC -> RSC.LatAccStandardByESC
      connect ESC.LatAccStandardByESC -> HighLevelSteeringVSS.LatAccStandardByESC
      connect ESC.LatAccStandardByESC -> Suspension.LatAccStandardByESC
      connect ESC.EstimatedLateralSpeedByESC -> Suspension.EstimatedLateralSpeedByESC
      connect ChassisSensorComponents.LongAccBase -> ESC.LongAccBase
      connect ChassisSensorComponents.LongAccBase -> RSC.LongAccBase
      connect ChassisSensorComponents.LongAccBase -> Suspension.LongAccBase
      connect ESC.LongAccFromWheelSpeedsStandard -> ACC.LongAccFromWheelSpeedsStandard
      connect ESC.LongAccFromWheelSpeedsStandard -> SSM.LongAccFromWheelSpeedsStandard
      connect ESC.LongAccFromWheelSpeedsStandard -> VLC.LongAccFromWheelSpeedsStandard
      connect ESC.LongAccFromWheelSpeedsStandard -> RSC.LongAccFromWheelSpeedsStandard
      connect ESC.LongAccFromWheelSpeedsStandard -> Suspension.LongAccFromWheelSpeedsStandard
      connect ESC.LongAccPitchCompStandard -> RSC.LongAccPitchCompStandard
      connect ESC.LongAccPitchCompStandard -> Suspension.LongAccPitchCompStandard
      connect ESC.LongAccStandard -> RSC.LongAccStandard
      connect ESC.LongAccStandard -> Suspension.LongAccStandard
      connect ESC.LowerBrakeActuatorDeadband -> VLC.LowerBrakeActuatorDeadband
      connect ChassisSensorComponents.MeasuredRideHeightLevelFrontBase -> Suspension.MeasuredRideHeightLevelFrontBase
      connect Suspension.MeasuredRideHeightLevelFrontStandard -> ESC.MeasuredRideHeightLevelFrontStandard
      connect Suspension.MeasuredRideHeightLevelFrontStandard -> RSC.MeasuredRideHeightLevelFrontStandard
      connect Suspension.MeasuredRideHeightLevelFrontStandard -> Steering.MeasuredRideHeightLevelFrontStandard
      connect ChassisSensorComponents.MeasuredRideHeightLevelRearBase -> Suspension.MeasuredRideHeightLevelRearBase
      connect Suspension.MeasuredRideHeightLevelRearStandard -> ESC.MeasuredRideHeightLevelRearStandard
      connect Suspension.MeasuredRideHeightLevelRearStandard -> RSC.MeasuredRideHeightLevelRearStandard
      connect Suspension.MeasuredRideHeightLevelRearStandard -> Steering.MeasuredRideHeightLevelRearStandard
      connect Suspension.MeasuredVehicleBodyVerticalAccel -> ESC.MeasuredVehicleBodyVerticalAccel
      connect Suspension.MeasuredVehicleBodyVerticalAccel -> RSC.MeasuredVehicleBodyVerticalAccel
      connect Suspension.MeasuredVehicleBodyVerticalAccel -> Steering.MeasuredVehicleBodyVerticalAccel
      connect ChassisSensorComponents.MeasuredVehicleBodyVerticalAccelBase -> Suspension.MeasuredVehicleBodyVerticalAccelBase
      connect RSC.OverRideABSControlbyRSC -> ESC.OverRideABSControlbyRSC
      connect RSC.OverRideTractionControlByRSC -> ESC.OverRideTractionControlByRSC
      connect RSC.OverRideYawControlByRSC -> ESC.OverRideYawControlByRSC
      connect SSM.ParkingBrakeActive -> ACC.ParkingBrakeActive
      connect SSM.ParkingBrakeActive -> ESC.ParkingBrakeActive
      connect Suspension.ActualSwitchableSpringControlTuning -> ESC.ActualSwitchableSpringControlTuning
      connect Suspension.ActualSwitchableSpringControlTuning -> RSC.ActualSwitchableSpringControlTuning
      connect Suspension.ActualSwitchableSpringControlTuning -> Steering.ActualSwitchableSpringControlTuning
      connect ChassisSensorComponents.PinionSteerAngleFrontBase -> Steering.PinionSteerAngleFrontBase
      connect Steering.PinionSteerAngleFrontStandard -> ESC.PinionSteerAngleFrontStandard
      connect Steering.PinionSteerAngleFrontStandard -> HighLevelSteeringVSS.PinionSteerAngleFrontStandard
      connect Steering.PinionSteerAngleFrontStandard -> HighLevelSteeringDAS.PinionSteerAngleFrontStandard
      connect Steering.PinionSteerAngleFrontSpeedStandard -> ESC.PinionSteerAngleFrontSpeedStandard
      connect Steering.PinionSteerAngleFrontSpeedStandard -> HighLevelSteeringVSS.PinionSteerAngleFrontSpeedStandard
      connect Steering.PinionSteerAngleFrontSpeedStandard -> HighLevelSteeringDAS.PinionSteerAngleFrontSpeedStandard
      connect ChassisSensorComponents.PinionSteerAngleRearBase -> Steering.PinionSteerAngleRearBase
      connect Steering.PinionSteerAngleRearSpeedStandard -> ESC.PinionSteerAngleRearSpeedStandard
      connect Steering.PinionSteerAngleRearSpeedStandard -> HighLevelSteeringVSS.PinionSteerAngleRearSpeedStandard
      connect Steering.PinionSteerAngleRearSpeedStandard -> HighLevelSteeringDAS.PinionSteerAngleRearSpeedStandard
      connect Steering.PinionSteerAngleRearStandard -> ESC.PinionSteerAngleRearStandard
      connect Steering.PinionSteerAngleRearStandard -> HighLevelSteeringVSS.PinionSteerAngleRearStandard
      connect Steering.PinionSteerAngleRearStandard -> HighLevelSteeringDAS.PinionSteerAngleRearStandard
      connect HighLevelSteeringDAS.PulseGeneratorMode -> Steering.PulseGeneratorMode
      connect Suspension.RelativeEstimatedBodyPitchAngle -> ACC.RelativeEstimatedBodyPitchAngle
      connect Suspension.RelativeEstimatedBodyPitchAngle -> Steering.RelativeEstimatedBodyPitchAngle
      connect Suspension.RelativeEstimatedBodyRollAngle -> ESC.RelativeEstimatedBodyRollAngle
      connect Suspension.RelativeEstimatedBodyRollAngle -> RSC.RelativeEstimatedBodyRollAngle
      connect Suspension.RelativeEstimatedBodyRollAngle -> Steering.RelativeEstimatedBodyRollAngle
      connect HighLevelSteeringDAS.RequestedAbsoluteDriverTorqueFrontDAS -> Steering.RequestedAbsoluteDriverTorqueFrontDAS
      connect HighLevelSteeringVSS.RequestedAbsoluteDriverTorqueFrontSTABILITY -> Steering.RequestedAbsoluteDriverTorqueFrontSTABILITY
      connect HighLevelSteeringDAS.RequestedAbsoluteRoadWheelAngleFrontDAS -> Steering.RequestedAbsoluteRoadWheelAngleFrontDAS
      connect HighLevelSteeringVSS.RequestedAbsoluteRoadWheelAngleFrontSTABILITY -> Steering.RequestedAbsoluteRoadWheelAngleFrontSTABILITY
      connect HighLevelSteeringDAS.RequestedAbsoluteRoadWheelAngleRearDAS -> Steering.RequestedAbsoluteRoadWheelAngleRearDAS
      connect HighLevelSteeringVSS.RequestedAbsoluteRoadWheelAngleRearSTABILITY -> Steering.RequestedAbsoluteRoadWheelAngleRearSTABILITY
      connect HighLevelSteeringDAS.RequestedDeltaDriverTorqueFrontDAS -> Steering.RequestedDeltaDriverTorqueFrontDAS
      connect HighLevelSteeringVSS.RequestedDeltaDriverTorqueFrontSTABILITY -> Steering.RequestedDeltaDriverTorqueFrontSTABILITY
      connect HighLevelSteeringDAS.RequestedDeltaRoadWheelAngleFrontDAS -> RSC.RequestedDeltaRoadWheelAngleFrontDAS
      connect HighLevelSteeringDAS.RequestedDeltaRoadWheelAngleFrontDAS -> Steering.RequestedDeltaRoadWheelAngleFrontDAS
      connect HighLevelSteeringDAS.RequestedDeltaRoadWheelAngleFrontDAS -> Suspension.RequestedDeltaRoadWheelAngleFrontDAS
      connect HighLevelSteeringVSS.RequestedDeltaRoadWheelAngleFrontSTABILITY -> ESC.RequestedDeltaRoadWheelAngleFrontSTABILITY
      connect HighLevelSteeringVSS.RequestedDeltaRoadWheelAngleFrontSTABILITY -> Steering.RequestedDeltaRoadWheelAngleFrontSTABILITY
      connect HighLevelSteeringDAS.RequestedDeltaRoadWheelAngleRearDAS -> Steering.RequestedDeltaRoadWheelAngleRearDAS
      connect HighLevelSteeringVSS.RequestedDeltaRoadWheelAngleRearSTABILITY -> Steering.RequestedDeltaRoadWheelAngleRearSTABILITY
      connect Suspension.RollMomentDistribution -> ESC.RollMomentDistribution
      connect Suspension.RollMomentDistribution -> Steering.RollMomentDistribution
      connect ChassisSensorComponents.SteeringWheelAngleBase -> Steering.SteeringWheelAngleBase
      connect Steering.SteeringWheelAngleStandard -> ESC.SteeringWheelAngleStandard
      connect Steering.SteeringWheelAngleStandard -> RSC.SteeringWheelAngleStandard
      connect Steering.SteeringWheelAngleStandard -> HighLevelSteeringVSS.SteeringWheelAngleStandard
      connect Steering.SteeringWheelAngleStandard -> HighLevelSteeringDAS.SteeringWheelAngleStandard
      connect Suspension.SuspensionYawStabilityControlActive -> ESC.SuspensionYawStabilityControlActive
      connect Suspension.SuspensionYawStabilityControlActive -> RSC.SuspensionYawStabilityControlActive
      connect Suspension.SuspensionYawStabilityControlActive -> Steering.SuspensionYawStabilityControlActive
      connect Suspension.WheelVerticalAccelerationStandard -> ESC.WheelVerticalAccelerationStandard
      connect Suspension.WheelVerticalAccelerationStandard -> RSC.WheelVerticalAccelerationStandard
      connect Suspension.WheelVerticalAccelerationStandard -> Steering.WheelVerticalAccelerationStandard
      connect ChassisSensorComponents.YawRateBase -> ACC.YawRateBase
      connect ChassisSensorComponents.YawRateBase -> ESC.YawRateBase
      connect ChassisSensorComponents.YawRateBase -> RSC.YawRateBase
      connect ESC.YawRateOffsetStandardByESC -> ACC.YawRateOffsetStandardByESC
      connect ESC.YawRateOffsetStandardByESC -> VLC.YawRateOffsetStandardByESC
      connect ESC.YawRateOffsetStandardByESC -> RSC.YawRateOffsetStandardByESC
      connect ESC.YawRateOffsetStandardByESC -> Steering.YawRateOffsetStandardByESC
      connect ESC.YawRateOffsetStandardByESC -> Suspension.YawRateOffsetStandardByESC
      connect SSM.SSM2EPBRequestStatus -> EPB.SSM2EPBRequestStatus
      connect SSM.SSM2EPBRequestType -> EPB.SSM2EPBRequestType
      connect SSM.SSM2ESCRequestedVehicleBrakeTorque -> ESC.SSM2ESCRequestedVehicleBrakeTorque
      connect SSM.SSM2ESCRequestedVehicleBrakeTorqueGradient -> ESC.SSM2ESCRequestedVehicleBrakeTorqueGradient
      connect SSM.SSM2ESCRequestStatus -> ESC.SSM2ESCRequestStatus
      connect SSM.SSM2ESCVehicleBrakeTorqueRequestType -> ESC.SSM2ESCVehicleBrakeTorqueRequestType
      connect Suspension.SwitchableSpringStatus -> ESC.SwitchableSpringStatus
      connect Suspension.SwitchableSpringStatus -> RSC.SwitchableSpringStatus
      connect Suspension.SwitchableSpringStatus -> Steering.SwitchableSpringStatus
      connect ESC.TractionControlActive -> ACC.TractionControlActive
      connect ESC.TractionControlActive -> SSM.TractionControlActive
      connect ESC.TractionControlActive -> RSC.TractionControlActive
      connect ESC.TractionControlActive -> Steering.TractionControlActive
      connect ESC.TractionControlActive -> Suspension.TractionControlActive
      connect ESC.TractionControlBrakeActive -> RSC.TractionControlBrakeActive
      connect ESC.TractionControlBrakeActive -> Suspension.TractionControlBrakeActive
      connect ESC.UpperBrakeActuatorDeadband -> VLC.UpperBrakeActuatorDeadband
      connect Suspension.SpringTravel -> ESC.SpringTravel
      connect Suspension.SpringTravel -> VLC.SpringTravel
      connect Suspension.SpringTravel -> RSC.SpringTravel
      connect Suspension.SpringTravel -> Steering.SpringTravel
      connect VLC.VehicleBrakeTorqueRequestStatus -> ESC.VehicleBrakeTorqueRequestStatus
      connect ESC.VehicleLongitudinalSpeed -> ACC.VehicleLongitudinalSpeed
      connect ESC.VehicleLongitudinalSpeed -> SSM.VehicleLongitudinalSpeed
      connect ESC.VehicleLongitudinalSpeed -> EPB.VehicleLongitudinalSpeed
      connect ESC.VehicleLongitudinalSpeed -> VLC.VehicleLongitudinalSpeed
      connect ESC.VehicleLongitudinalSpeed -> RSC.VehicleLongitudinalSpeed
      connect ESC.VehicleLongitudinalSpeed -> Steering.VehicleLongitudinalSpeed
      connect ESC.VehicleLongitudinalSpeed -> Suspension.VehicleLongitudinalSpeed
      connect ESC.VehicleMotionState -> ACC.VehicleMotionState
      connect ESC.VehicleMotionState -> SSM.VehicleMotionState
      connect ESC.VehicleMotionState -> EPB.VehicleMotionState
      connect ESC.VehicleMotionState -> VLC.VehicleMotionState
      connect ESC.VehicleMotionState -> RSC.VehicleMotionState
      connect VLC.VLC2SSMRequestStatus -> SSM.VLC2SSMRequestStatus
      connect VLC.VLC2SSMVehicleHoldRequest -> SSM.VLC2SSMVehicleHoldRequest
      connect ESC.WheelAngularAccelerationStandard -> RSC.WheelAngularAccelerationStandard
      connect ESC.WheelAngularAccelerationStandard -> Suspension.WheelAngularAccelerationStandard
      connect ESC.WheelAngularVelocityStandard -> SSM.WheelAngularVelocityStandard
      connect ESC.WheelAngularVelocityStandard -> EPB.WheelAngularVelocityStandard
      connect ESC.WheelAngularVelocityStandard -> Suspension.WheelAngularVelocityStandard
      connect ESC.WheelBrakeOverheated -> ACC.WheelBrakeOverheated
      connect ESC.WheelBrakeOverheated -> SSM.WheelBrakeOverheated
      connect ESC.WheelBrakeOverheated -> EPB.WheelBrakeOverheated
      connect ESC.WheelBrakeOverheated -> RSC.WheelBrakeOverheated
      connect ESC.WheelBrakeTorque -> SSM.WheelBrakeTorque
      connect ESC.WheelBrakeTorque -> VLC.WheelBrakeTorque
      connect ESC.WheelBrakeTorque -> RSC.WheelBrakeTorque
      connect RSC.WheelBrakeTorqueRequestStatusbyRSC -> ESC.WheelBrakeTorqueRequestStatusbyRSC
      connect ESC.WheelCircumSpeedsStandard -> ACC.WheelCircumSpeedsStandard
      connect ESC.WheelCircumSpeedsStandard -> SSM.WheelCircumSpeedsStandard
      connect ESC.WheelCircumSpeedsStandard -> EPB.WheelCircumSpeedsStandard
      connect ESC.WheelCircumSpeedsStandard -> RSC.WheelCircumSpeedsStandard
      connect ESC.WheelCircumSpeedsStandard -> Steering.WheelCircumSpeedsStandard
      connect ESC.WheelCircumSpeedsStandard -> Suspension.WheelCircumSpeedsStandard
      connect ESC.WheelRadiusToleranceCoefficient -> ACC.WheelRadiusToleranceCoefficient
      connect ESC.WheelRadiusToleranceCoefficient -> RSC.WheelRadiusToleranceCoefficient
      connect ESC.WheelRotationalDirectionStandard -> ACC.WheelRotationalDirectionStandard
      connect ESC.WheelRotationalDirectionStandard -> SSM.WheelRotationalDirectionStandard
      connect ESC.WheelRotationalDirectionStandard -> EPB.WheelRotationalDirectionStandard
      connect ESC.WheelRotationalDirectionStandard -> VLC.WheelRotationalDirectionStandard
      connect ESC.WheelRotationalDirectionStandard -> RSC.WheelRotationalDirectionStandard
      connect ESC.WheelRotationalDirectionStandard -> Steering.WheelRotationalDirectionStandard
      connect ESC.WheelRotationalDirectionStandard -> Suspension.WheelRotationalDirectionStandard
      connect ESC.WheelTravelledDistanceStandard -> ACC.WheelTravelledDistanceStandard
      connect ESC.WheelTravelledDistanceStandard -> VLC.WheelTravelledDistanceStandard
      connect ESC.WheelTravelledDistanceStandard -> RSC.WheelTravelledDistanceStandard
      connect ESC.WheelTravelledDistanceStandard -> Steering.WheelTravelledDistanceStandard
      connect ChassisSensorComponents.WheelVerticalAccelerationBase -> Suspension.WheelVerticalAccelerationBase
      connect ESC.YawControlBrakeActiveWheel -> RSC.YawControlBrakeActiveWheel
      connect ESC.YawControlBrakeActiveWheel -> Suspension.YawControlBrakeActiveWheel
      connect ESC.YawRateGradientStandardByESC -> RSC.YawRateGradientStandardByESC
      connect ESC.YawRateGradientStandardByESC -> HighLevelSteeringVSS.YawRateGradientStandardByESC
      connect ESC.YawRateGradientStandardByESC -> Suspension.YawRateGradientStandardByESC
      connect ESC.YawRateReferenceValueByESC -> RSC.YawRateReferenceValueByESC
      connect ESC.YawRateReferenceValueByESC -> Suspension.YawRateReferenceValueByESC
      connect ESC.YawRateStandardByESC -> EPB.YawRateStandardByESC
      connect ESC.YawRateStandardByESC -> RSC.YawRateStandardByESC
      connect ESC.YawRateStandardByESC -> HighLevelSteeringVSS.YawRateStandardByESC
      connect ESC.YawRateStandardByESC -> Suspension.YawRateStandardByESC
      connect ESC.YawStabilityControlActive -> ACC.YawStabilityControlActive
      connect ESC.YawStabilityControlActive -> SSM.YawStabilityControlActive
      connect ESC.YawStabilityControlActive -> RSC.YawStabilityControlActive
      connect ESC.YawStabilityControlActive -> HighLevelSteeringVSS.YawStabilityControlActive
      connect ESC.YawStabilityControlActive -> HighLevelSteeringDAS.YawStabilityControlActive
      connect ESC.YawStabilityControlActive -> Suspension.YawStabilityControlActive
      connect ESC.YawStabilityInformationByESC -> ACC.YawStabilityInformationByESC
      connect ESC.YawStabilityInformationByESC -> EPB.YawStabilityInformationByESC
      connect ESC.YawStabilityInformationByESC -> RSC.YawStabilityInformationByESC
      connect ESC.YawStabilityInformationByESC -> Steering.YawStabilityInformationByESC
      connect ESC.YawStabilityInformationByESC -> Suspension.YawStabilityInformationByESC
      connect ESC.RoadBankAccelEstimationByESC -> Steering.RoadBankAccelEstimationByESC
      connect ESC.RoadInclinationAccelEstimation -> SSM.RoadInclinationAccelEstimation
      connect ESC.RoadInclinationAccelEstimation -> VLC.RoadInclinationAccelEstimation
      connect VLC.BrakePreventionComfortbyVLC -> ESC.BrakePreventionComfortbyVLC
      connect RSC.MinimumTotalPowertrainTorqueAtWheelsRequestedByRSCSlow -> ESC.MinimumTotalPowertrainTorqueAtWheelsRequestedByRSCSlow
      connect RSC.MinimumTotalPowertrainTorqueAtWheelsRequestedByRSCFast -> ESC.MinimumTotalPowertrainTorqueAtWheelsRequestedByRSCFast
      connect RSC.MaximumTotalPowertrainTorqueAtWheelsRequestedByRSCSlow -> ESC.MaximumTotalPowertrainTorqueAtWheelsRequestedByRSCSlow
      connect RSC.MaximumTotalPowertrainTorqueAtWheelsRequestedByRSCFast -> ESC.MaximumTotalPowertrainTorqueAtWheelsRequestedByRSCFast
      connect RSC.RequestedMaxWheelBrakeSlipByRSC -> ESC.RequestedMaxWheelBrakeSlipByRSC
      connect RSC.RequestedWheelBrakeTorquebyRSC -> ESC.RequestedWheelBrakeTorquebyRSC
      connect RSC.RscControlDisable -> ESC.RscControlDisable
      connect RSC.RscInControl -> ESC.RscInControl
      connect ACC.GearshiftPreventionComfortRequestedbyACC -> VLC.GearshiftPreventionComfortRequestedbyACC
      connect ACC.BrakePreventionComfortRequestbyACC -> VLC.BrakePreventionComfortRequestbyACC
      connect VLC.RequestedVehicleBrakeTorque -> ESC.RequestedVehicleBrakeTorque
      connect SSM.SSM2EPBRequestedVehicleBrakeTorque -> EPB.SSM2EPBRequestedVehicleBrakeTorque
      connect SSM.SSM2EPBRequestedVehicleBrakeTorqueGradient -> EPB.SSM2EPBRequestedVehicleBrakeTorqueGradient
      connect ChassisSensorComponents.RollRateExtdRangeBase -> ESC.RollRateExtdRangeBase
      connect ChassisSensorComponents.RollRateExtdRangeBase -> RSC.RollRateExtdRangeBase
      connect ChassisSensorComponents.RollRateExtdRangeBase -> Suspension.RollRateExtdRangeBase
      connect ChassisSensorComponents.RollRateBase -> ESC.RollRateBase
      connect ChassisSensorComponents.RollRateBase -> RSC.RollRateBase
      connect ChassisSensorComponents.RollRateBase -> Suspension.RollRateBase
      connect Suspension.RollRateStandard -> ESC.RollRateStandard
      connect Suspension.RollRateStandard -> RSC.RollRateStandard
      connect ChassisSensorComponents.PitchRateBase -> ESC.PitchRateBase
      connect ChassisSensorComponents.PitchRateBase -> RSC.PitchRateBase
      connect ChassisSensorComponents.PitchRateBase -> Suspension.PitchRateBase
      connect ChassisSensorComponents.PitchRateStandard -> ESC.PitchRateStandard
      connect ChassisSensorComponents.PitchRateStandard -> RSC.PitchRateStandard
      connect ChassisSensorComponents.PitchRateStandard -> Suspension.PitchRateStandard
      delegate ESC.Voltage <-> outer port Chassis/Voltage
      delegate Steering.Voltage <-> outer port Chassis/Voltage
      delegate Suspension.Voltage <-> outer port Chassis/Voltage
      delegate ACC.AcceleratorPedalRatio <-> outer port Chassis/AcceleratorPedalRatio
      delegate ESC.AcceleratorPedalRatio <-> outer port Chassis/AcceleratorPedalRatio
      delegate SSM.AcceleratorPedalRatio <-> outer port Chassis/AcceleratorPedalRatio
      delegate RSC.AcceleratorPedalRatio <-> outer port Chassis/AcceleratorPedalRatio
      delegate Suspension.AcceleratorPedalRatio <-> outer port Chassis/AcceleratorPedalRatio
      delegate ACC.ActualGear <-> outer port Chassis/ActualGear
      delegate ESC.ActualGear <-> outer port Chassis/ActualGear
      delegate SSM.ActualGear <-> outer port Chassis/ActualGear
      delegate Suspension.ActualGear <-> outer port Chassis/ActualGear
      delegate ESC.EngineSpeed <-> outer port Chassis/EngineSpeed
      delegate SSM.EngineSpeed <-> outer port Chassis/EngineSpeed
      delegate ESC.TargetGear <-> outer port Chassis/TargetGear
      delegate SSM.TargetGear <-> outer port Chassis/TargetGear
      delegate RSC.TargetGear <-> outer port Chassis/TargetGear
      delegate ESC.MaximumAvailableTotalPowertrainTorqueAtWheels <-> outer port Chassis/MaximumAvailableTotalPowertrainTorqueAtWheels
      delegate VLC.MaximumAvailableTotalPowertrainTorqueAtWheels <-> outer port Chassis/MaximumAvailableTotalPowertrainTorqueAtWheels
      delegate ESC.MinimumAvailableTotalPowertrainTorqueAtWheels <-> outer port Chassis/MinimumAvailableTotalPowertrainTorqueAtWheels
      delegate VLC.MinimumAvailableTotalPowertrainTorqueAtWheels <-> outer port Chassis/MinimumAvailableTotalPowertrainTorqueAtWheels
      delegate ACC.DriverRequestOverridesVLCrequest <-> outer port Chassis/DriverRequestOverridesVLCrequest
      delegate VLC.DriverRequestOverridesVLCrequest <-> outer port Chassis/DriverRequestOverridesVLCrequest
      delegate ESC.ActualPowertrainTorqueAtWheels4 <-> outer port Chassis/ActualPowertrainTorqueAtWheels4
      delegate SSM.ActualPowertrainTorqueAtWheels4 <-> outer port Chassis/ActualPowertrainTorqueAtWheels4
      delegate VLC.ActualPowertrainTorqueAtWheels4 <-> outer port Chassis/ActualPowertrainTorqueAtWheels4
      delegate RSC.ActualPowertrainTorqueAtWheels4 <-> outer port Chassis/ActualPowertrainTorqueAtWheels4
      delegate Suspension.ActualPowertrainTorqueAtWheels4 <-> outer port Chassis/ActualPowertrainTorqueAtWheels4
      delegate ESC.ActualTotalPowertrainTorqueAtWheels <-> outer port Chassis/ActualTotalPowertrainTorqueAtWheels
      delegate SSM.ActualTotalPowertrainTorqueAtWheels <-> outer port Chassis/ActualTotalPowertrainTorqueAtWheels
      delegate VLC.ActualTotalPowertrainTorqueAtWheels <-> outer port Chassis/ActualTotalPowertrainTorqueAtWheels
      delegate RSC.ActualTotalPowertrainTorqueAtWheels <-> outer port Chassis/ActualTotalPowertrainTorqueAtWheels
      delegate Suspension.ActualTotalPowertrainTorqueAtWheels <-> outer port Chassis/ActualTotalPowertrainTorqueAtWheels
      delegate VLC.RequestedTotalPowertrainTorqueAtWheelsForLongitudinalControl <-> outer port Chassis/RequestedTotalPowertrainTorqueAtWheelsForLongitudinalControl
      delegate ESC.ABSControlActive <-> outer port Chassis/ABSControlActive
      delegate ESC.AcceleratorPedalGradient <-> outer port Chassis/AcceleratorPedalGradient
      delegate SSM.AcceleratorPedalGradient <-> outer port Chassis/AcceleratorPedalGradient
      delegate Suspension.AcceleratorPedalGradient <-> outer port Chassis/AcceleratorPedalGradient
      delegate Suspension.ActiveDamperStatus <-> outer port Chassis/ActiveDamperStatus
      delegate Suspension.ActiveStabilizerStatus <-> outer port Chassis/ActiveStabilizerStatus
      delegate Suspension.ActualBodyLevelMode <-> outer port Chassis/ActualBodyLevelMode
      delegate Suspension.BodyLevelActuatorStatus <-> outer port Chassis/BodyLevelActuatorStatus
      delegate Suspension.BodyLevelControl <-> outer port Chassis/BodyLevelControl
      delegate ESC.BrakeLightsIntensity <-> outer port Chassis/BrakeLightsIntensity
      delegate ESC.BrakeLightsOnRequestFromChassis <-> outer port Chassis/BrakeLightsOnRequestFromChassis
      delegate ESC.BrakePedalPressed <-> outer port Chassis/BrakePedalPressed
      delegate ESC.BrakePedalValue <-> outer port Chassis/BrakePedalValue
      delegate ACC.DriverPresenceFlag <-> outer port Chassis/DriverPresenceFlag
      delegate SSM.DriverPresenceFlag <-> outer port Chassis/DriverPresenceFlag
      delegate ACC.DriveTrainOpen <-> outer port Chassis/DriveTrainOpen
      delegate ESC.DriveTrainOpen <-> outer port Chassis/DriveTrainOpen
      delegate SSM.DriveTrainOpen <-> outer port Chassis/DriveTrainOpen
      delegate ESC.EngineSpeedGradient <-> outer port Chassis/EngineSpeedGradient
      delegate SSM.EngineSpeedGradient <-> outer port Chassis/EngineSpeedGradient
      delegate Steering.ErrorStatusSteeringBSTS <-> outer port Chassis/ErrorStatusSteeringBSTS
      delegate Steering.ErrorStatusSteeringBSAS <-> outer port Chassis/ErrorStatusSteeringBSAS
      delegate Steering.ErrorStatusSteeringBRWS <-> outer port Chassis/ErrorStatusSteeringBRWS
      delegate Suspension.FullActiveSuspensionStatus <-> outer port Chassis/FullActiveSuspensionStatus
      delegate ESC.GearboxCountershaftActive <-> outer port Chassis/GearboxCountershaftActive
      delegate Suspension.GearboxCountershaftActive <-> outer port Chassis/GearboxCountershaftActive
      delegate ESC.MaxVehicleSpeedBrakeActuator <-> outer port Chassis/MaxVehicleSpeedBrakeActuator
      delegate SSM.PGearRequest <-> outer port Chassis/PGearRequest
      delegate Suspension.SwitchableSpringStatus <-> outer port Chassis/SwitchableSpringStatus
      delegate ESC.VehicleLongitudinalSpeed <-> outer port Chassis/VehicleLongitudinalSpeed
      delegate ESC.WheelCircumSpeedsStandard <-> outer port Chassis/WheelCircumSpeedsStandard
      delegate Steering.ActualPowerSteeringLoad <-> outer port Chassis/ActualPowerSteeringLoad
      delegate Steering.RequestedPowerSteeringLoad <-> outer port Chassis/RequestedPowerSteeringLoad
      delegate SSM.DriverDoorState <-> outer port Chassis/DriverDoorState
      delegate Suspension.DriverDoorState <-> outer port Chassis/DriverDoorState
      delegate SSM.PassengerDoorState <-> outer port Chassis/PassengerDoorState
      delegate Suspension.PassengerDoorState <-> outer port Chassis/PassengerDoorState
      delegate SSM.RearLeftDoorState <-> outer port Chassis/RearLeftDoorState
      delegate Suspension.RearLeftDoorState <-> outer port Chassis/RearLeftDoorState
      delegate SSM.RearRightDoorState <-> outer port Chassis/RearRightDoorState
      delegate Suspension.RearRightDoorState <-> outer port Chassis/RearRightDoorState
      delegate SSM.RearLidState <-> outer port Chassis/RearLidState
      delegate Suspension.RearLidState <-> outer port Chassis/RearLidState
      delegate SSM.BackliteWindowState <-> outer port Chassis/BackliteWindowState
      delegate Suspension.BackliteWindowState <-> outer port Chassis/BackliteWindowState
      delegate VLC.GearshiftPreventionComfortbyVLC <-> outer port Chassis/GearshiftPreventionComfortbyVLC
      delegate ESC.GearShiftPreventionStability <-> outer port Chassis/GearShiftPreventionStability
      delegate ESC.MinimumTotalPowertrainTorqueAtWheelsRequestedByStabilityControlSlow <-> outer port Chassis/MinimumTotalPowertrainTorqueAtWheelsRequestedByStabilityControlSlow
      delegate ESC.MinimumTotalPowertrainTorqueAtWheelsRequestedByStabilityControlFast <-> outer port Chassis/MinimumTotalPowertrainTorqueAtWheelsRequestedByStabilityControlFast
      delegate ESC.MaximumTotalPowertrainTorqueAtWheelsRequestedByStabilityControlSlow <-> outer port Chassis/MaximumTotalPowertrainTorqueAtWheelsRequestedByStabilityControlSlow
      delegate ESC.MaximumTotalPowertrainTorqueAtWheelsRequestedByStabilityControlFast <-> outer port Chassis/MaximumTotalPowertrainTorqueAtWheelsRequestedByStabilityControlFast
      delegate ESC.ShiftInProgress <-> outer port Chassis/ShiftInProgress
      delegate VLC.ShiftInProgress <-> outer port Chassis/ShiftInProgress
      delegate VLC.MinimumTotalPowertrainTorqueAtWheelsRequestedByVehicleLongitudinalControl <-> outer port Chassis/MinimumTotalPowertrainTorqueAtWheelsRequestedByVehicleLongitudinalControl
      delegate VLC.MaximumTotalPowertrainTorqueAtWheelsRequestedByVehicleLongitudinalControl <-> outer port Chassis/MaximumTotalPowertrainTorqueAtWheelsRequestedByVehicleLongitudinalControl
    ACC
      provide port ComfortAccelerationCommandInterface: provided-interface=ComfortAccelerationCommandInterface
      provide port GearshiftPreventionComfortRequestedbyACC: provided-interface=GearshiftPreventionComfortRequestedbyACC
      provide port BrakePreventionComfortRequestbyACC: provided-interface=BrakePreventionComfortRequestbyACC
      32 x require port:
        AcceleratorPedalRatio: required-interface=AcceleratorPedalRatio
        ActualGear: required-interface=ActualGear
        DriverRequestOverridesVLCrequest: required-interface=DriverRequestOverridesVLCrequest
        ABSControlActive: required-interface=ABSControlActive
        AbsoluteEstimatedBodyPitchAngle: required-interface=AbsoluteEstimatedBodyPitchAngle
        ActualEstimatedRoadWheelAngleFront: required-interface=ActualEstimatedRoadWheelAngleFront
        ActualEstimatedRoadWheelAngleFrontSpeed: required-interface=ActualEstimatedRoadWheelAngleFrontSpeed
        ActualEstimatedRoadWheelAngleRear: required-interface=ActualEstimatedRoadWheelAngleRear  # Having BRWS
        BrakePedalOverride: required-interface=BrakePedalOverride
        BrakePedalPressed: required-interface=BrakePedalPressed
        ComfortAccelerationFeedbackInterface: required-interface=ComfortAccelerationFeedbackInterface
        DriverPresenceFlag: required-interface=DriverPresenceFlag  # conditional to ACC stop & Go
        DriveTrainOpen: required-interface=DriveTrainOpen
        EstimatedDriverRoadWheelAngleFrontSpeedWish: required-interface=EstimatedDriverRoadWheelAngleFrontSpeedWish
        EstimatedDriverRoadWheelAngleFrontWish: required-interface=EstimatedDriverRoadWheelAngleFrontWish  # having BSAS
        LatAccRollCompStandardByESC: required-interface=LatAccRollCompStandardByESC
        LatAccStandardByESC: required-interface=LatAccStandardByESC
        LongAccFromWheelSpeedsStandard: required-interface=LongAccFromWheelSpeedsStandard
        ParkingBrakeActive: required-interface=ParkingBrakeActive
        RelativeEstimatedBodyPitchAngle: required-interface=RelativeEstimatedBodyPitchAngle
        YawRateBase: required-interface=YawRateBase
        YawRateOffsetStandardByESC: required-interface=YawRateOffsetStandardByESC
        TractionControlActive: required-interface=TractionControlActive
        VehicleLongitudinalSpeed: required-interface=VehicleLongitudinalSpeed
        VehicleMotionState: required-interface=VehicleMotionState
        WheelBrakeOverheated: required-interface=WheelBrakeOverheated
        WheelCircumSpeedsStandard: required-interface=WheelCircumSpeedsStandard
        WheelRadiusToleranceCoefficient: required-interface=WheelRadiusToleranceCoefficient
        WheelRotationalDirectionStandard: required-interface=WheelRotationalDirectionStandard
        WheelTravelledDistanceStandard: required-interface=WheelTravelledDistanceStandard
        YawStabilityControlActive: required-interface=YawStabilityControlActive
        YawStabilityInformationByESC: required-interface=YawStabilityInformationByESC
    ESC
      52 x provide port:
        ABSControlActive: provided-interface=ABSControlActive
        ABSControlActiveWheel: provided-interface=ABSControlActiveWheel  # conditional to RSC
        ActualBrakeYawTorque: provided-interface=ActualBrakeYawTorque
        BrakeActuatorActive: provided-interface=BrakeActuatorActive
        BrakeActuatorMode: provided-interface=BrakeActuatorMode  # if more than EPB stand alone
        BrakeActuatorOverheated: provided-interface=BrakeActuatorOverheated
        BrakeActuatorSaturation: provided-interface=BrakeActuatorSaturation  # depends on the ACC features that use brake
        BrakeActuatorSaturationWheel: provided-interface=BrakeActuatorSaturationWheel  # conditional to RSC
        BrakeActuatorStatus_BOD_RSC: provided-interface=BrakeActuatorStatus_BOD_RSC  # conditional to RSC
        BrakeActuatorStatus_BOD_SSM: provided-interface=BrakeActuatorStatus_BOD_SSM  # if more than EPB stand alone
        BrakeActuatorStatus_BOD_VLC: provided-interface=BrakeActuatorStatus_BOD_VLC  # conditional to ACC features (+CM, see later on)
        BrakeLightsIntensity: provided-interface=BrakeLightsIntensity
        BrakeLightsOnRequestFromChassis: provided-interface=BrakeLightsOnRequest  # depends on the ACC features that use brake
        BrakePedalOverride: provided-interface=BrakePedalOverride
        BrakePedalPressed: provided-interface=BrakePedalPressed
        BrakePedalValue: provided-interface=BrakePedalValue  # depends on the sensor technology
        IntendedVehicleBrakeTorque: provided-interface=IntendedVehicleBrakeTorque  # depends on the ACC features that use brake
        LatAccRollCompStandardByESC: provided-interface=LatAccRollCompStandardByESC
        LatAccStandardByESC: provided-interface=LatAccStandardByESC
        EstimatedLateralSpeedByESC: provided-interface=EstimatedLateralSpeedByESC
        LongAccFromWheelSpeedsStandard: provided-interface=LongAccFromWheelSpeedsStandard
        LongAccPitchCompStandard: provided-interface=LongAccPitchCompStandard
        LongAccStandard: provided-interface=LongAccStandard  # conditional to RSC
        LowerBrakeActuatorDeadband: provided-interface=LowerBrakeActuatorDeadband  # depends on the ACC features that use brake
        MaxVehicleSpeedBrakeActuator: provided-interface=MaxVehicleSpeedBrakeActuator
        YawRateOffsetStandardByESC: provided-interface=YawRateOffsetStandardByESC  # conditional to 2nd YRC and/or AWD : Necessary signal for AWD basic functionality if this functionality is available within AWD SW-C
        TractionControlActive: provided-interface=TractionControlActive  # conditional to RSC
        TractionControlBrakeActive: provided-interface=TractionControlBrakeActive  # conditional to RSC
        UpperBrakeActuatorDeadband: provided-interface=UpperBrakeActuatorDeadband  # depends on the ACC features that use brake
        VehicleLongitudinalSpeed: provided-interface=VehicleLongitudinalSpeed
        VehicleMotionState: provided-interface=VehicleMotionState
        WheelAngularAccelerationStandard: provided-interface=WheelAngularAccelerationStandard
        WheelAngularVelocityStandard: provided-interface=WheelAngularVelocityStandard
        WheelBrakeOverheated: provided-interface=WheelBrakeOverheated
        WheelBrakeTorque: provided-interface=WheelBrakeTorque  # conditional to SSM and/or ACC features that use brake and/or AWD
        WheelCircumSpeedsStandard: provided-interface=WheelCircumSpeedsStandard  # conditional to RSC or ACC
        WheelRadiusToleranceCoefficient: provided-interface=WheelRadiusToleranceCoefficient
        WheelRotationalDirectionStandard: provided-interface=WheelRotationalDirectionStandard  # conditional to the sensor technology
        WheelTravelledDistanceStandard: provided-interface=WheelTravelledDistanceStandard
        YawControlBrakeActiveWheel: provided-interface=YawControlBrakeActiveWheel  # conditional to RSC
        YawRateGradientStandardByESC: provided-interface=YawRateGradientStandardByESC
        YawRateReferenceValueByESC: provided-interface=YawRateReferenceValueByESC
        YawRateStandardByESC: provided-interface=YawRateStandardByESC
        YawStabilityControlActive: provided-interface=YawStabilityControlActive
        YawStabilityInformationByESC: provided-interface=YawStabilityInformationByESC
        RoadBankAccelEstimationByESC: provided-interface=RoadBankAccelEstimationByESC
        RoadInclinationAccelEstimation: provided-interface=RoadInclinationAccelEstimation  # Having SSM or ACC stop and go
        GearShiftPreventionStability: provided-interface=GearShiftPreventionStability
        MinimumTotalPowertrainTorqueAtWheelsRequestedByStabilityControlSlow: provided-interface=MinimumTotalPowertrainTorqueAtWheelsRequestedByStabilityControlSlow
        MinimumTotalPowertrainTorqueAtWheelsRequestedByStabilityControlFast: provided-interface=MinimumTotalPowertrainTorqueAtWheelsRequestedByStabilityControlFast
        MaximumTotalPowertrainTorqueAtWheelsRequestedByStabilityControlSlow: provided-interface=MaximumTotalPowertrainTorqueAtWheelsRequestedByStabilityControlSlow
        MaximumTotalPowertrainTorqueAtWheelsRequestedByStabilityControlFast: provided-interface=MaximumTotalPowertrainTorqueAtWheelsRequestedByStabilityControlFast
      93 x require port:
        Voltage: required-interface=BatteryVoltage
        AcceleratorPedalRatio: required-interface=AcceleratorPedalRatio
        ActualGear: required-interface=ActualGear  # conditional to automatic gearbox
        EngineSpeed: required-interface=EngineSpeed  # if RatioTorqueConversionEngineToWheel not received by ESC
        TargetGear: required-interface=TargetGear  # conditional to automatic gearbox
        MaximumAvailableTotalPowertrainTorqueAtWheels: required-interface=MaximumAvailableTotalPowertrainTorqueAtWheels
        MinimumAvailableTotalPowertrainTorqueAtWheels: required-interface=MinimumAvailableTotalPowertrainTorqueAtWheels
        ActualPowertrainTorqueAtWheels4: required-interface=ActualPowertrainTorqueAtWheels4
        ActualTotalPowertrainTorqueAtWheels: required-interface=ActualTotalPowertrainTorqueAtWheels
        AbsoluteEstimatedBodyPitchAngle: required-interface=AbsoluteEstimatedBodyPitchAngle
        AbsoluteEstimatedBodyRollAngle: required-interface=AbsoluteEstimatedBodyRollAngle
        AbsoluteMeasuredBodyRollAngleStandard: required-interface=AbsoluteMeasuredBodyRollAngleStandard
        AcceleratorPedalGradient: required-interface=AcceleratorPedalGradient
        ActiveDamperStatus: required-interface=ActiveDamperStatus
        ActiveStabilizerStatus: required-interface=ActiveStabilizerStatus  # Having active stabilizer
        ActualDamperControlTuning: required-interface=ActualDamperControlTuning
        ActualEstimatedRoadWheelAngleFront: required-interface=ActualEstimatedRoadWheelAngleFront
        ActualEstimatedRoadWheelAngleFrontSpeed: required-interface=ActualEstimatedRoadWheelAngleFrontSpeed
        ActualEstimatedRoadWheelAngleRear: required-interface=ActualEstimatedRoadWheelAngleRear  # Having BRWS
        BrakeAssistRequest: required-interface=BrakeAssistRequest  # conditional to the ACC features using brake
        BrakeReadyRequest: required-interface=BrakeReadyRequest  # conditional to the ACC features using brake
        BrakeRequestMode: required-interface=BrakeRequestMode  # conditional to ACC safety features using brake
        ByPassSlipControlRequestByRSC: required-interface=ByPassSlipControlRequestByRSC  # conditional to RSC
        DriveTrainOpen: required-interface=DriveTrainOpen
        EngineSpeedGradient: required-interface=EngineSpeedGradient
        EPBActuatorMode: required-interface=EPBActuatorMode
        EPBActuatorStatus: required-interface=EPBActuatorStatus  # Having EPB
        EPBActuatorTorque: required-interface=EPBActuatorTorque
        EPBControlButtonState: required-interface=EPBControlButtonState
        ErrorStatusSteeringBSTS: required-interface=ErrorStatusSteeringBSTS  # Having BSTS and using steer torque interface
        ErrorStatusSteeringBSAS: required-interface=ErrorStatusSteeringBSAS  # Having BSAS
        ErrorStatusSteeringBRWS: required-interface=ErrorStatusSteeringBRWS  # Having BRWS
        EstimatedDamperForces: required-interface=EstimatedDamperForces
        EstimatedDriverRoadWheelAngleFrontSpeedWish: required-interface=EstimatedDriverRoadWheelAngleFrontSpeedWish
        EstimatedDriverRoadWheelAngleFrontWish: required-interface=EstimatedDriverRoadWheelAngleFrontWish  # having BSAS
        EstimatedRideHeightLevelFront: required-interface=EstimatedRideHeightLevelFront
        EstimatedRideHeightLevelRear: required-interface=EstimatedRideHeightLevelRear
        EstimatedSpringForces: required-interface=EstimatedSpringForces
        EstimatedVehicleBodyVerticalAccel: required-interface=EstimatedVehicleBodyVerticalAccel
        EstimatedVehicleMass: required-interface=EstimatedVehicleMass
        EstimatedVehicleMassFromVLC: required-interface=EstimatedVehicleMassFromVLC
        EstimatedVerticalWheelForces: required-interface=EstimatedVerticalWheelForces
        EstimatedWheelLoadDifferenceFront: required-interface=EstimatedWheelLoadDifferenceFront
        EstimatedWheelLoadDifferenceRear: required-interface=EstimatedWheelLoadDifferenceRear
        EstimatedWheelVerticalAcceleration: required-interface=EstimatedWheelVerticalAcceleration
        FullActiveSuspensionControlTuning: required-interface=FullActiveSuspensionControlTuning
        FullActiveSuspensionStatus: required-interface=FullActiveSuspensionStatus  # Having full active suspension
        GearboxCountershaftActive: required-interface=GearboxCountershaftActive  # conditional to having this box onboard the vehicle
        LatAccBase: required-interface=LatAccBase
        LongAccBase: required-interface=LongAccBase
        MeasuredRideHeightLevelFrontStandard: required-interface=MeasuredRideHeightLevelFrontStandard
        MeasuredRideHeightLevelRearStandard: required-interface=MeasuredRideHeightLevelRearStandard
        MeasuredVehicleBodyVerticalAccel: required-interface=MeasuredVehicleBodyVerticalAccelStandard
        OverRideABSControlbyRSC: required-interface=OverRideABSControlbyRSC  # conditional to RSC
        OverRideTractionControlByRSC: required-interface=OverRideTractionControlByRSC  # conditional to RSC
        OverRideYawControlByRSC: required-interface=OverRideYawControlByRSC  # conditional to RSC
        ParkingBrakeActive: required-interface=ParkingBrakeActive  # ESC is the alternative provider in case an &quot;old fashion&quot; mechanical parking brake is fitted and ESC is reading in the parking brake switch
        ActualSwitchableSpringControlTuning: required-interface=ActualSwitchableSpringControlTuning
        PinionSteerAngleFrontStandard: required-interface=PinionSteerAngleFrontStandard
        PinionSteerAngleFrontSpeedStandard: required-interface=PinionSteerAngleFrontSpeedStandard
        PinionSteerAngleRearSpeedStandard: required-interface=PinionSteerAngleRearSpeedStandard
        PinionSteerAngleRearStandard: required-interface=PinionSteerAngleRearStandard
        RelativeEstimatedBodyRollAngle: required-interface=RelativeEstimatedBodyRollAngle
        RequestedDeltaRoadWheelAngleFrontSTABILITY: required-interface=RequestedDeltaRoadWheelAngleFrontSTABILITY
        RollMomentDistribution: required-interface=RollMomentDistribution
        SteeringWheelAngleStandard: required-interface=SteeringWheelAngleStandard
        SuspensionYawStabilityControlActive: required-interface=SuspensionYawStabilityControlActive  # conditional to RSC
        WheelVerticalAccelerationStandard: required-interface=WheelVerticalAccelerationStandard
        YawRateBase: required-interface=YawRateBase
        SSM2ESCRequestedVehicleBrakeTorque: required-interface=SSM2ESCRequestedVehicleBrakeTorque  # if more functionalities than EPB stand alone
        SSM2ESCRequestedVehicleBrakeTorqueGradient: required-interface=SSM2ESCRequestedVehicleBrakeTorqueGradient
        SSM2ESCRequestStatus: required-interface=SSM2ESCRequestStatus  # if more functionalities than EPB stand alone
        SSM2ESCVehicleBrakeTorqueRequestType: required-interface=SSM2ESCVehicleBrakeTorqueRequestType  # if more functionalities than EPB stand alone
        SwitchableSpringStatus: required-interface=SwitchableSpringStatus
        SpringTravel: required-interface=SpringTravel
        VehicleBrakeTorqueRequestStatus: required-interface=VehicleBrakeTorqueRequestStatus  # depends on the ACC features that use brake
        WheelBrakeTorqueRequestStatusbyRSC: required-interface=WheelBrakeTorqueRequestStatusbyRSC  # conditional to RSC
        BrakePreventionComfortbyVLC: required-interface=BrakePreventionComfortbyVLC
        MinimumTotalPowertrainTorqueAtWheelsRequestedByRSCSlow: required-interface=MinimumTotalPowertrainTorqueAtWheelsRequestedByRSCSlow  # having RSC
        MinimumTotalPowertrainTorqueAtWheelsRequestedByRSCFast: required-interface=MinimumTotalPowertrainTorqueAtWheelsRequestedByRSCFast  # having RSC
        MaximumTotalPowertrainTorqueAtWheelsRequestedByRSCSlow: required-interface=MaximumTotalPowertrainTorqueAtWheelsRequestedByRSCSlow  # having RSC
        MaximumTotalPowertrainTorqueAtWheelsRequestedByRSCFast: required-interface=MaximumTotalPowertrainTorqueAtWheelsRequestedByRSCFast  # having RSC
        RequestedMaxWheelBrakeSlipByRSC: required-interface=RequestedMaxWheelBrakeSlipByRSC  # having RSC
        RequestedWheelBrakeTorquebyRSC: required-interface=RequestedWheelBrakeTorquebyRSC  # having RSC
        RscControlDisable: required-interface=RscControlDisable  # having RSC
        RscInControl: required-interface=RscInControl  # having RSC
        RequestedVehicleBrakeTorque: required-interface=RequestedVehicleBrakeTorque  # depends on ACC features that use brake
        ShiftInProgress: required-interface=ShiftInProgress  # conditional to automatic gearbox
        RollRateExtdRangeBase: required-interface=RollRateExtdRangeBase
        RollRateBase: required-interface=RollRateBase
        RollRateStandard: required-interface=RollRateStandard
        PitchRateBase: required-interface=PitchRateBase
        PitchRateStandard: required-interface=PitchRateStandard
    SSM
      11 x provide port:
        HOD_State: provided-interface=HoldOnDemand_state  # conditional to ACC stop & go, CM, parking aid
        ParkingBrakeActive: provided-interface=ParkingBrakeActive
        PGearRequest: provided-interface=PGearRequest
        SSM2EPBRequestStatus: provided-interface=SSM2EPBRequestStatus
        SSM2EPBRequestType: provided-interface=SSM2EPBRequestType
        SSM2ESCRequestedVehicleBrakeTorque: provided-interface=SSM2ESCRequestedVehicleBrakeTorque  # if more functionalities than EPB stand alone
        SSM2ESCRequestedVehicleBrakeTorqueGradient: provided-interface=SSM2ESCRequestedVehicleBrakeTorqueGradient
        SSM2ESCRequestStatus: provided-interface=SSM2ESCRequestStatus  # if more functionalities than EPB stand alone
        SSM2ESCVehicleBrakeTorqueRequestType: provided-interface=SSM2ESCVehicleBrakeTorqueRequestType  # if more functionalities than EPB stand alone
        SSM2EPBRequestedVehicleBrakeTorque: provided-interface=SSM2EPBRequestedVehicleBrakeTorque
        SSM2EPBRequestedVehicleBrakeTorqueGradient: provided-interface=SSM2EPBRequestedVehicleBrakeTorqueGradient
      41 x require port:
        AcceleratorPedalRatio: required-interface=AcceleratorPedalRatio
        ActualGear: required-interface=ActualGear  # conditional to automatic gearbox
        EngineSpeed: required-interface=EngineSpeed
        TargetGear: required-interface=TargetGear  # conditional to automatic gearbox
        ActualPowertrainTorqueAtWheels4: required-interface=ActualPowertrainTorqueAtWheels4
        ActualTotalPowertrainTorqueAtWheels: required-interface=ActualTotalPowertrainTorqueAtWheels
        ABSControlActive: required-interface=ABSControlActive
        AbsoluteEstimatedBodyPitchAngle: required-interface=AbsoluteEstimatedBodyPitchAngle
        AcceleratorPedalGradient: required-interface=AcceleratorPedalGradient
        BrakeActuatorMode: required-interface=BrakeActuatorMode  # if more than EPB stand alone
        BrakeActuatorOverheated: required-interface=BrakeActuatorOverheated
        BrakeActuatorStatus_BOD_SSM: required-interface=BrakeActuatorStatus_BOD_SSM  # if more than EPB stand alone
        BrakePedalPressed: required-interface=BrakePedalPressed
        DriverPresenceFlag: required-interface=DriverPresenceFlag
        DriveTrainOpen: required-interface=DriveTrainOpen
        EngineSpeedGradient: required-interface=EngineSpeedGradient
        EPBActuatorMode: required-interface=EPBActuatorMode
        EPBActuatorStatus: required-interface=EPBActuatorStatus
        EPBActuatorTorque: required-interface=EPBActuatorTorque
        EPBControlButtonState: required-interface=EPBControlButtonState
        EstimatedVehicleMassFromVLC: required-interface=EstimatedVehicleMassFromVLC
        IntendedVehicleBrakeTorque: required-interface=IntendedVehicleBrakeTorque
        LongAccFromWheelSpeedsStandard: required-interface=LongAccFromWheelSpeedsStandard
        TractionControlActive: required-interface=TractionControlActive
        VehicleLongitudinalSpeed: required-interface=VehicleLongitudinalSpeed
        VehicleMotionState: required-interface=VehicleMotionState
        VLC2SSMRequestStatus: required-interface=VLC2SSMRequestStatus  # conditional to ACC stop & go, CM, parking aid
        VLC2SSMVehicleHoldRequest: required-interface=VLC2SSMVehicleHoldRequest  # conditional to ACC stop & go, CM, parking aid
        WheelAngularVelocityStandard: required-interface=WheelAngularVelocityStandard
        WheelBrakeOverheated: required-interface=WheelBrakeOverheated
        WheelBrakeTorque: required-interface=WheelBrakeTorque
        WheelCircumSpeedsStandard: required-interface=WheelCircumSpeedsStandard
        WheelRotationalDirectionStandard: required-interface=WheelRotationalDirectionStandard  # conditional to the sensor technology
        YawStabilityControlActive: required-interface=YawStabilityControlActive
        DriverDoorState: required-interface=StaDoor
        PassengerDoorState: required-interface=StaDoor
        RearLeftDoorState: required-interface=StaDoor
        RearRightDoorState: required-interface=StaDoor
        RearLidState: required-interface=StaDoor
        BackliteWindowState: required-interface=StaDoor
        RoadInclinationAccelEstimation: required-interface=RoadInclinationAccelEstimation
    EPB
      4 x provide port:
        EPBActuatorMode: provided-interface=EPBActuatorMode
        EPBActuatorStatus: provided-interface=EPBActuatorStatus
        EPBActuatorTorque: provided-interface=EPBActuatorTorque
        EPBControlButtonState: provided-interface=EPBControlButtonState
      15 x require port:
        AbsoluteEstimatedBodyPitchAngle: required-interface=AbsoluteEstimatedBodyPitchAngle
        BrakeActuatorOverheated: required-interface=BrakeActuatorOverheated
        BrakePedalPressed: required-interface=BrakePedalPressed
        SSM2EPBRequestStatus: required-interface=SSM2EPBRequestStatus
        SSM2EPBRequestType: required-interface=SSM2EPBRequestType
        VehicleLongitudinalSpeed: required-interface=VehicleLongitudinalSpeed
        VehicleMotionState: required-interface=VehicleMotionState
        WheelAngularVelocityStandard: required-interface=WheelAngularVelocityStandard
        WheelBrakeOverheated: required-interface=WheelBrakeOverheated
        WheelCircumSpeedsStandard: required-interface=WheelCircumSpeedsStandard
        WheelRotationalDirectionStandard: required-interface=WheelRotationalDirectionStandard  # conditional to the sensor technology
        YawRateStandardByESC: required-interface=YawRateStandardByESC
        YawStabilityInformationByESC: required-interface=YawStabilityInformationByESC
        SSM2EPBRequestedVehicleBrakeTorque: required-interface=SSM2EPBRequestedVehicleBrakeTorque
        SSM2EPBRequestedVehicleBrakeTorqueGradient: required-interface=SSM2EPBRequestedVehicleBrakeTorqueGradient
    VLC
      13 x provide port:
        BrakeAssistRequest: provided-interface=BrakeAssistRequest  # conditional to the ACC features using brake & future components specific description related to Collision Mitigation SW-C
        BrakeReadyRequest: provided-interface=BrakeReadyRequest  # conditional to the ACC features using brake & future components specific description related to Collision Mitigation SW-C
        BrakeRequestMode: provided-interface=BrakeRequestMode  # conditional to ACC safety features using brake
        ComfortAccelerationFeedbackInterface: provided-interface=ComfortAccelerationFeedbackInterface
        EstimatedVehicleMassFromVLC: provided-interface=EstimatedVehicleMassFromVLC
        VehicleBrakeTorqueRequestStatus: provided-interface=VehicleBrakeTorqueRequestStatus  # ACC features that use brake
        VLC2SSMRequestStatus: provided-interface=VLC2SSMRequestStatus  # conditional to ACC stop & go, CM, parking aid
        VLC2SSMVehicleHoldRequest: provided-interface=VLC2SSMVehicleHoldRequest  # conditional to ACC stop & go, CM, parking aid
        GearshiftPreventionComfortbyVLC: provided-interface=GearshiftPreventionComfortbyVLC
        BrakePreventionComfortbyVLC: provided-interface=BrakePreventionComfortbyVLC
        RequestedVehicleBrakeTorque: provided-interface=RequestedVehicleBrakeTorque  # depends on ACC features that use brake
        MinimumTotalPowertrainTorqueAtWheelsRequestedByVehicleLongitudinalControl: provided-interface=MinimumTotalPowertrainTorqueAtWheelsRequestedByVehicleLongitudinalControl
        MaximumTotalPowertrainTorqueAtWheelsRequestedByVehicleLongitudinalControl: provided-interface=MaximumTotalPowertrainTorqueAtWheelsRequestedByVehicleLongitudinalControl
      34 x require port:
        MaximumAvailableTotalPowertrainTorqueAtWheels: required-interface=MaximumAvailableTotalPowertrainTorqueAtWheels
        MinimumAvailableTotalPowertrainTorqueAtWheels: required-interface=MinimumAvailableTotalPowertrainTorqueAtWheels
        DriverRequestOverridesVLCrequest: required-interface=DriverRequestOverridesVLCrequest
        ActualPowertrainTorqueAtWheels4: required-interface=ActualPowertrainTorqueAtWheels4
        ActualTotalPowertrainTorqueAtWheels: required-interface=ActualTotalPowertrainTorqueAtWheels
        RequestedTotalPowertrainTorqueAtWheelsForLongitudinalControl: required-interface=RequestedTotalPowertrainTorqueAtWheelsForLongitudinalControl
        ABSControlActive: required-interface=ABSControlActive
        BrakeActuatorOverheated: required-interface=BrakeActuatorOverheated
        BrakeActuatorSaturation: required-interface=BrakeActuatorSaturation  # depends on the ACC features that use brake
        BrakeActuatorSaturationWheel: required-interface=BrakeActuatorSaturationWheel
        BrakeActuatorStatus_BOD_VLC: required-interface=BrakeActuatorStatus_BOD_VLC  # conditional to ACC features that use brake
        BrakePedalOverride: required-interface=BrakePedalOverride
        BrakePedalPressed: required-interface=BrakePedalPressed
        BrakePedalValue: required-interface=BrakePedalValue
        ComfortAccelerationCommandInterface: required-interface=ComfortAccelerationCommandInterface
        EPBControlButtonState: required-interface=EPBControlButtonState
        EstimatedRideHeightLevelFront: required-interface=EstimatedRideHeightLevelFront
        EstimatedRideHeightLevelRear: required-interface=EstimatedRideHeightLevelRear
        HOD_State: required-interface=HoldOnDemand_state  # conditional to ACC stop & go, CM, parking aid
        IntendedVehicleBrakeTorque: required-interface=IntendedVehicleBrakeTorque  # depends on the ACC features that use brake
        LongAccFromWheelSpeedsStandard: required-interface=LongAccFromWheelSpeedsStandard
        LowerBrakeActuatorDeadband: required-interface=LowerBrakeActuatorDeadband  # depends on the ACC features that use brake
        YawRateOffsetStandardByESC: required-interface=YawRateOffsetStandardByESC
        UpperBrakeActuatorDeadband: required-interface=UpperBrakeActuatorDeadband  # depends on the ACC features that use brake
        SpringTravel: required-interface=SpringTravel
        VehicleLongitudinalSpeed: required-interface=VehicleLongitudinalSpeed
        VehicleMotionState: required-interface=VehicleMotionState
        WheelBrakeTorque: required-interface=WheelBrakeTorque  # conditional to ACC features that use brake
        WheelRotationalDirectionStandard: required-interface=WheelRotationalDirectionStandard
        WheelTravelledDistanceStandard: required-interface=WheelTravelledDistanceStandard
        RoadInclinationAccelEstimation: required-interface=RoadInclinationAccelEstimation
        GearshiftPreventionComfortRequestedbyACC: required-interface=GearshiftPreventionComfortRequestedbyACC
        BrakePreventionComfortRequestbyACC: required-interface=BrakePreventionComfortRequestbyACC
        ShiftInProgress: required-interface=ShiftInProgress
    RSC
      13 x provide port:
        ByPassSlipControlRequestByRSC: provided-interface=ByPassSlipControlRequestByRSC
        OverRideABSControlbyRSC: provided-interface=OverRideABSControlbyRSC
        OverRideTractionControlByRSC: provided-interface=OverRideTractionControlByRSC
        OverRideYawControlByRSC: provided-interface=OverRideYawControlByRSC
        WheelBrakeTorqueRequestStatusbyRSC: provided-interface=WheelBrakeTorqueRequestStatusbyRSC
        MinimumTotalPowertrainTorqueAtWheelsRequestedByRSCSlow: provided-interface=MinimumTotalPowertrainTorqueAtWheelsRequestedByRSCSlow
        MinimumTotalPowertrainTorqueAtWheelsRequestedByRSCFast: provided-interface=MinimumTotalPowertrainTorqueAtWheelsRequestedByRSCFast
        MaximumTotalPowertrainTorqueAtWheelsRequestedByRSCSlow: provided-interface=MaximumTotalPowertrainTorqueAtWheelsRequestedByRSCSlow
        MaximumTotalPowertrainTorqueAtWheelsRequestedByRSCFast: provided-interface=MaximumTotalPowertrainTorqueAtWheelsRequestedByRSCFast
        RequestedMaxWheelBrakeSlipByRSC: provided-interface=RequestedMaxWheelBrakeSlipByRSC
        RequestedWheelBrakeTorquebyRSC: provided-interface=RequestedWheelBrakeTorquebyRSC
        RscControlDisable: provided-interface=RscControlDisable
        RscInControl: provided-interface=RscInControl
      82 x require port:
        AcceleratorPedalRatio: required-interface=AcceleratorPedalRatio
        TargetGear: required-interface=TargetGear  # conditional to automatic gearbox
        ActualPowertrainTorqueAtWheels4: required-interface=ActualPowertrainTorqueAtWheels4
        ActualTotalPowertrainTorqueAtWheels: required-interface=ActualTotalPowertrainTorqueAtWheels
        ABSControlActive: required-interface=ABSControlActive
        ABSControlActiveWheel: required-interface=ABSControlActiveWheel
        AbsoluteEstimatedBodyPitchAngle: required-interface=AbsoluteEstimatedBodyPitchAngle
        AbsoluteEstimatedBodyRollAngle: required-interface=AbsoluteEstimatedBodyRollAngle
        AbsoluteMeasuredBodyRollAngleStandard: required-interface=AbsoluteMeasuredBodyRollAngleStandard
        ActiveDamperStatus: required-interface=ActiveDamperStatus
        ActiveStabilizerStatus: required-interface=ActiveStabilizerStatus  # Having active stabilizer
        ActualBodyLevelMode: required-interface=ActualBodyLevelMode
        ActualDamperControlTuning: required-interface=ActualDamperControlTuning
        ActualEstimatedRoadWheelAngleFront: required-interface=ActualEstimatedRoadWheelAngleFront
        ActualEstimatedRoadWheelAngleFrontSpeed: required-interface=ActualEstimatedRoadWheelAngleFrontSpeed
        ActualEstimatedRoadWheelAngleRear: required-interface=ActualEstimatedRoadWheelAngleRear  # Having BRWS
        BrakeActuatorOverheated: required-interface=BrakeActuatorOverheated
        BrakeActuatorSaturation: required-interface=BrakeActuatorSaturation
        BrakeActuatorSaturationWheel: required-interface=BrakeActuatorSaturationWheel
        BrakeActuatorStatus_BOD_RSC: required-interface=BrakeActuatorStatus_BOD_RSC
        BrakePedalPressed: required-interface=BrakePedalPressed
        ErrorStatusSteeringBSTS: required-interface=ErrorStatusSteeringBSTS  # Having BSTS and using steer torque interface
        ErrorStatusSteeringBSAS: required-interface=ErrorStatusSteeringBSAS  # Having BSAS
        ErrorStatusSteeringBRWS: required-interface=ErrorStatusSteeringBRWS  # Having BRWS
        EstimatedDamperForces: required-interface=EstimatedDamperForces
        EstimatedDriverRoadWheelAngleFrontSpeedWish: required-interface=EstimatedDriverRoadWheelAngleFrontSpeedWish
        EstimatedDriverRoadWheelAngleFrontWish: required-interface=EstimatedDriverRoadWheelAngleFrontWish  # having BSAS
        EstimatedRideHeightLevelFront: required-interface=EstimatedRideHeightLevelFront
        EstimatedRideHeightLevelRear: required-interface=EstimatedRideHeightLevelRear
        EstimatedSpringForces: required-interface=EstimatedSpringForces
        EstimatedVehicleBodyVerticalAccel: required-interface=EstimatedVehicleBodyVerticalAccel
        EstimatedVehicleMass: required-interface=EstimatedVehicleMass
        EstimatedVehicleMassFromVLC: required-interface=EstimatedVehicleMassFromVLC
        EstimatedVerticalWheelForces: required-interface=EstimatedVerticalWheelForces
        EstimatedWheelLoadDifferenceFront: required-interface=EstimatedWheelLoadDifferenceFront
        EstimatedWheelLoadDifferenceRear: required-interface=EstimatedWheelLoadDifferenceRear
        EstimatedWheelVerticalAcceleration: required-interface=EstimatedWheelVerticalAcceleration
        FullActiveSuspensionControlTuning: required-interface=FullActiveSuspensionControlTuning
        FullActiveSuspensionStatus: required-interface=FullActiveSuspensionStatus  # Having full active suspension
        IntendedVehicleBrakeTorque: required-interface=IntendedVehicleBrakeTorque
        LatAccBase: required-interface=LatAccBase
        LatAccRollCompStandardByESC: required-interface=LatAccRollCompStandardByESC
        LatAccStandardByESC: required-interface=LatAccStandardByESC
        LongAccBase: required-interface=LongAccBase
        LongAccFromWheelSpeedsStandard: required-interface=LongAccFromWheelSpeedsStandard
        LongAccPitchCompStandard: required-interface=LongAccPitchCompStandard
        LongAccStandard: required-interface=LongAccStandard
        MeasuredRideHeightLevelFrontStandard: required-interface=MeasuredRideHeightLevelFrontStandard
        MeasuredRideHeightLevelRearStandard: required-interface=MeasuredRideHeightLevelRearStandard
        MeasuredVehicleBodyVerticalAccel: required-interface=MeasuredVehicleBodyVerticalAccelStandard
        ActualSwitchableSpringControlTuning: required-interface=ActualSwitchableSpringControlTuning
        RelativeEstimatedBodyRollAngle: required-interface=RelativeEstimatedBodyRollAngle
        RequestedDeltaRoadWheelAngleFrontDAS: required-interface=RequestedDeltaRoadWheelAngleFrontDAS
        SteeringWheelAngleStandard: required-interface=SteeringWheelAngleStandard
        SuspensionYawStabilityControlActive: required-interface=SuspensionYawStabilityControlActive
        WheelVerticalAccelerationStandard: required-interface=WheelVerticalAccelerationStandard
        YawRateBase: required-interface=YawRateBase
        YawRateOffsetStandardByESC: required-interface=YawRateOffsetStandardByESC
        SwitchableSpringStatus: required-interface=SwitchableSpringStatus
        TractionControlActive: required-interface=TractionControlActive
        TractionControlBrakeActive: required-interface=TractionControlBrakeActive
        SpringTravel: required-interface=SpringTravel
        VehicleLongitudinalSpeed: required-interface=VehicleLongitudinalSpeed
        VehicleMotionState: required-interface=VehicleMotionState
        WheelAngularAccelerationStandard: required-interface=WheelAngularAccelerationStandard
        WheelBrakeOverheated: required-interface=WheelBrakeOverheated
        WheelBrakeTorque: required-interface=WheelBrakeTorque
        WheelCircumSpeedsStandard: required-interface=WheelCircumSpeedsStandard
        WheelRadiusToleranceCoefficient: required-interface=WheelRadiusToleranceCoefficient
        WheelRotationalDirectionStandard: required-interface=WheelRotationalDirectionStandard
        WheelTravelledDistanceStandard: required-interface=WheelTravelledDistanceStandard
        YawControlBrakeActiveWheel: required-interface=YawControlBrakeActiveWheel
        YawRateGradientStandardByESC: required-interface=YawRateGradientStandardByESC
        YawRateReferenceValueByESC: required-interface=YawRateReferenceValueByESC
        YawRateStandardByESC: required-interface=YawRateStandardByESC
        YawStabilityControlActive: required-interface=YawStabilityControlActive
        YawStabilityInformationByESC: required-interface=YawStabilityInformationByESC
        RollRateExtdRangeBase: required-interface=RollRateExtdRangeBase
        RollRateBase: required-interface=RollRateBase
        RollRateStandard: required-interface=RollRateStandard
        PitchRateBase: required-interface=PitchRateBase
        PitchRateStandard: required-interface=PitchRateStandard
    Steering
      16 x provide port:
        ActualEstimatedRoadWheelAngleFront: provided-interface=ActualEstimatedRoadWheelAngleFront
        ActualEstimatedRoadWheelAngleFrontSpeed: provided-interface=ActualEstimatedRoadWheelAngleFrontSpeed
        ActualEstimatedRoadWheelAngleRear: provided-interface=ActualEstimatedRoadWheelAngleRear  # Having BRWS
        DriverSteerTorqueStandard: provided-interface=DriverSteerTorqueStandard  # Having BSTS and high level steering functions
        ErrorStatusSteeringBSTS: provided-interface=ErrorStatusSteeringBSTS  # Having BSTS
        ErrorStatusSteeringBSAS: provided-interface=ErrorStatusSteeringBSAS  # Having BSAS
        ErrorStatusSteeringBRWS: provided-interface=ErrorStatusSteeringBRWS  # Having BRWS and using rear steer angle interface
        EstimatedDriverRoadWheelAngleFrontSpeedWish: provided-interface=EstimatedDriverRoadWheelAngleFrontSpeedWish
        EstimatedDriverRoadWheelAngleFrontWish: provided-interface=EstimatedDriverRoadWheelAngleFrontWish  # having BSAS
        PinionSteerAngleFrontStandard: provided-interface=PinionSteerAngleFrontStandard
        PinionSteerAngleFrontSpeedStandard: provided-interface=PinionSteerAngleFrontSpeedStandard
        PinionSteerAngleRearSpeedStandard: provided-interface=PinionSteerAngleRearSpeedStandard
        PinionSteerAngleRearStandard: provided-interface=PinionSteerAngleRearStandard
        SteeringWheelAngleStandard: provided-interface=SteeringWheelAngleStandard
        ActualPowerSteeringLoad: provided-interface=ActualPowerSteeringLoad
        RequestedPowerSteeringLoad: provided-interface=RequestedPowerSteeringLoad
      54 x require port:
        Voltage: required-interface=BatteryVoltage
        ABSControlActive: required-interface=ABSControlActive
        AbsoluteEstimatedBodyPitchAngle: required-interface=AbsoluteEstimatedBodyPitchAngle
        AbsoluteEstimatedBodyRollAngle: required-interface=AbsoluteEstimatedBodyRollAngle
        AbsoluteMeasuredBodyRollAngleStandard: required-interface=AbsoluteMeasuredBodyRollAngleStandard
        ActiveSteerMotorAngleFrontBase: required-interface=ActiveSteerMotorAngleFrontBase  # Having BSAS
        ActualBodyLevelMode: required-interface=ActualBodyLevelMode
        ActualDamperControlTuning: required-interface=ActualDamperControlTuning
        DriverSteerTorqueBase: required-interface=DriverSteerTorqueBase  # having BSTS
        EstimatedDamperForces: required-interface=EstimatedDamperForces
        EstimatedRideHeightLevelFront: required-interface=EstimatedRideHeightLevelFront
        EstimatedRideHeightLevelRear: required-interface=EstimatedRideHeightLevelRear
        EstimatedSpringForces: required-interface=EstimatedSpringForces
        EstimatedVehicleBodyVerticalAccel: required-interface=EstimatedVehicleBodyVerticalAccel
        EstimatedVehicleMass: required-interface=EstimatedVehicleMass
        EstimatedVerticalWheelForces: required-interface=EstimatedVerticalWheelForces
        EstimatedWheelLoadDifferenceFront: required-interface=EstimatedWheelLoadDifferenceFront
        EstimatedWheelLoadDifferenceRear: required-interface=EstimatedWheelLoadDifferenceRear
        EstimatedWheelVerticalAcceleration: required-interface=EstimatedWheelVerticalAcceleration
        MeasuredRideHeightLevelFrontStandard: required-interface=MeasuredRideHeightLevelFrontStandard
        MeasuredRideHeightLevelRearStandard: required-interface=MeasuredRideHeightLevelRearStandard
        MeasuredVehicleBodyVerticalAccel: required-interface=MeasuredVehicleBodyVerticalAccelStandard
        ActualSwitchableSpringControlTuning: required-interface=ActualSwitchableSpringControlTuning
        PinionSteerAngleFrontBase: required-interface=PinionSteerAngleFrontBase  # having BSAS with a pinion angle sensor required by safety concept
        PinionSteerAngleRearBase: required-interface=PinionSteerAngleRearBase  # Having BRWS with a rack and pinion and with a rear pinion angle sensor
        PulseGeneratorMode: required-interface=PulseGeneratorMode  # Having DAS that uses the pulse generator
        RelativeEstimatedBodyPitchAngle: required-interface=RelativeEstimatedBodyPitchAngle
        RelativeEstimatedBodyRollAngle: required-interface=RelativeEstimatedBodyRollAngle
        RequestedAbsoluteDriverTorqueFrontDAS: required-interface=RequestedAbsoluteDriverTorqueFrontDAS  # Having DAS function requesting absolute torque
        RequestedAbsoluteDriverTorqueFrontSTABILITY: required-interface=RequestedAbsoluteDriverTorqueFrontSTABILITY  # Having VSS function requesting absolute torque
        RequestedAbsoluteRoadWheelAngleFrontDAS: required-interface=RequestedAbsoluteRoadWheelAngleFrontDAS  # Having DAS function requesting absolute front steer angle
        RequestedAbsoluteRoadWheelAngleFrontSTABILITY: required-interface=RequestedAbsoluteRoadWheelAngleFrontSTABILITY  # Having VSS function requesting absolute front steer angle
        RequestedAbsoluteRoadWheelAngleRearDAS: required-interface=RequestedAbsoluteRoadWheelAngleRearDAS  # Having DAS function requesting absolute rear steer angle
        RequestedAbsoluteRoadWheelAngleRearSTABILITY: required-interface=RequestedAbsoluteRoadWheelAngleRearSTABILITY  # Having VSS function requesting absolute rear steer angle
        RequestedDeltaDriverTorqueFrontDAS: required-interface=RequestedDeltaDriverTorqueFrontDAS  # Having DAS function requesting relative torque
        RequestedDeltaDriverTorqueFrontSTABILITY: required-interface=RequestedDeltaDriverTorqueFrontSTABILITY  # Having VSS function requesting relative torque
        RequestedDeltaRoadWheelAngleFrontDAS: required-interface=RequestedDeltaRoadWheelAngleFrontDAS  # Having DAS function requesting relative front steer angle
        RequestedDeltaRoadWheelAngleFrontSTABILITY: required-interface=RequestedDeltaRoadWheelAngleFrontSTABILITY  # Having VSS function requesting relative front steer angle
        RequestedDeltaRoadWheelAngleRearDAS: required-interface=RequestedDeltaRoadWheelAngleRearDAS  # Having DAS function requesting relative rear steer angle
        RequestedDeltaRoadWheelAngleRearSTABILITY: required-interface=RequestedDeltaRoadWheelAngleRearSTABILITY  # Having VSS function requesting relative rear steer angle
        RollMomentDistribution: required-interface=RollMomentDistribution
        SteeringWheelAngleBase: required-interface=SteeringWheelAngleBase
        SuspensionYawStabilityControlActive: required-interface=SuspensionYawStabilityControlActive
        WheelVerticalAccelerationStandard: required-interface=WheelVerticalAccelerationStandard
        YawRateOffsetStandardByESC: required-interface=YawRateOffsetStandardByESC
        SwitchableSpringStatus: required-interface=SwitchableSpringStatus
        TractionControlActive: required-interface=TractionControlActive
        SpringTravel: required-interface=SpringTravel
        VehicleLongitudinalSpeed: required-interface=VehicleLongitudinalSpeed
        WheelCircumSpeedsStandard: required-interface=WheelCircumSpeedsStandard  # depends on OEM safety concept
        WheelRotationalDirectionStandard: required-interface=WheelRotationalDirectionStandard  # conditional to the sensor technology and OEM safety concept
        WheelTravelledDistanceStandard: required-interface=WheelTravelledDistanceStandard
        YawStabilityInformationByESC: required-interface=YawStabilityInformationByESC
        RoadBankAccelEstimationByESC: required-interface=RoadBankAccelEstimationByESC
    HighLevelSteeringVSS
      6 x provide port:
        RequestedAbsoluteDriverTorqueFrontSTABILITY: provided-interface=RequestedAbsoluteDriverTorqueFrontSTABILITY  # Having VSS function requesting absolute torque
        RequestedAbsoluteRoadWheelAngleFrontSTABILITY: provided-interface=RequestedAbsoluteRoadWheelAngleFrontSTABILITY  # Having VSS function requesting absolute front steer angle
        RequestedAbsoluteRoadWheelAngleRearSTABILITY: provided-interface=RequestedAbsoluteRoadWheelAngleRearSTABILITY  # Having VSS function requesting absolute rear steer angle
        RequestedDeltaDriverTorqueFrontSTABILITY: provided-interface=RequestedDeltaDriverTorqueFrontSTABILITY  # Having VSS function requesting relative torque
        RequestedDeltaRoadWheelAngleFrontSTABILITY: provided-interface=RequestedDeltaRoadWheelAngleFrontSTABILITY  # Having VSS function requesting relative front steer angle
        RequestedDeltaRoadWheelAngleRearSTABILITY: provided-interface=RequestedDeltaRoadWheelAngleRearSTABILITY  # Having VSS function requesting relative rear steer angle
      22 x require port:
        ActiveStabilizerStatus: required-interface=ActiveStabilizerStatus
        ActualEstimatedRoadWheelAngleFront: required-interface=ActualEstimatedRoadWheelAngleFront
        ActualEstimatedRoadWheelAngleFrontSpeed: required-interface=ActualEstimatedRoadWheelAngleFrontSpeed
        ActualEstimatedRoadWheelAngleRear: required-interface=ActualEstimatedRoadWheelAngleRear  # Having BRWS
        DriverSteerTorqueStandard: required-interface=DriverSteerTorqueStandard  # Having BSTS, and high level steer functions based on driver torque
        ErrorStatusSteeringBSTS: required-interface=ErrorStatusSteeringBSTS  # Having BSTS and using steer torque interface
        ErrorStatusSteeringBSAS: required-interface=ErrorStatusSteeringBSAS  # Having BSAS and using steer angle interface
        ErrorStatusSteeringBRWS: required-interface=ErrorStatusSteeringBRWS  # Having BRWS and using rear steer angle interface
        EstimatedDriverRoadWheelAngleFrontSpeedWish: required-interface=EstimatedDriverRoadWheelAngleFrontSpeedWish
        EstimatedDriverRoadWheelAngleFrontWish: required-interface=EstimatedDriverRoadWheelAngleFrontWish  # Having BSAS
        FullActiveSuspensionControlTuning: required-interface=FullActiveSuspensionControlTuning
        FullActiveSuspensionStatus: required-interface=FullActiveSuspensionStatus  # Having full active suspension
        LatAccRollCompStandardByESC: required-interface=LatAccRollCompStandardByESC
        LatAccStandardByESC: required-interface=LatAccStandardByESC
        PinionSteerAngleFrontStandard: required-interface=PinionSteerAngleFrontStandard
        PinionSteerAngleFrontSpeedStandard: required-interface=PinionSteerAngleFrontSpeedStandard
        PinionSteerAngleRearSpeedStandard: required-interface=PinionSteerAngleRearSpeedStandard
        PinionSteerAngleRearStandard: required-interface=PinionSteerAngleRearStandard
        SteeringWheelAngleStandard: required-interface=SteeringWheelAngleStandard
        YawRateGradientStandardByESC: required-interface=YawRateGradientStandardByESC
        YawRateStandardByESC: required-interface=YawRateStandardByESC
        YawStabilityControlActive: required-interface=YawStabilityControlActive
    HighLevelSteeringDAS
      7 x provide port:
        PulseGeneratorMode: provided-interface=PulseGeneratorMode  # Having DAS that uses the pulse generator
        RequestedAbsoluteDriverTorqueFrontDAS: provided-interface=RequestedAbsoluteDriverTorqueFrontDAS  # Having DAS function requesting absolute torque
        RequestedAbsoluteRoadWheelAngleFrontDAS: provided-interface=RequestedAbsoluteRoadWheelAngleFrontDAS  # Having DAS function requesting absolute front steer angle
        RequestedAbsoluteRoadWheelAngleRearDAS: provided-interface=RequestedAbsoluteRoadWheelAngleRearDAS  # Having DAS function requesting absolute rear steer angle
        RequestedDeltaDriverTorqueFrontDAS: provided-interface=RequestedDeltaDriverTorqueFrontDAS  # Having DAS function requesting relative torque
        RequestedDeltaRoadWheelAngleFrontDAS: provided-interface=RequestedDeltaRoadWheelAngleFrontDAS  # Having DAS function requesting relative front steer angle
        RequestedDeltaRoadWheelAngleRearDAS: provided-interface=RequestedDeltaRoadWheelAngleRearDAS  # Having DAS function requesting relative rear steer angle
      18 x require port:
        ActualEstimatedRoadWheelAngleFront: required-interface=ActualEstimatedRoadWheelAngleFront
        ActualEstimatedRoadWheelAngleFrontSpeed: required-interface=ActualEstimatedRoadWheelAngleFrontSpeed
        ActualEstimatedRoadWheelAngleRear: required-interface=ActualEstimatedRoadWheelAngleRear  # Having BRWS
        DriverSteerTorqueStandard: required-interface=DriverSteerTorqueStandard  # Having BSTS, and high level steer functions based on driver torque
        ErrorStatusSteeringBSTS: required-interface=ErrorStatusSteeringBSTS  # Having BSTS and using steer torque interface
        ErrorStatusSteeringBSAS: required-interface=ErrorStatusSteeringBSAS  # Having BSAS and using steer angle interface
        ErrorStatusSteeringBRWS: required-interface=ErrorStatusSteeringBRWS  # Having BRWS and using rear steer angle interface
        EstimatedDriverRoadWheelAngleFrontSpeedWish: required-interface=EstimatedDriverRoadWheelAngleFrontSpeedWish
        EstimatedDriverRoadWheelAngleFrontWish: required-interface=EstimatedDriverRoadWheelAngleFrontWish  # Having BSAS
        FullActiveSuspensionControlTuning: required-interface=FullActiveSuspensionControlTuning
        FullActiveSuspensionStatus: required-interface=FullActiveSuspensionStatus  # Having full active suspension
        LatAccRollCompStandardByESC: required-interface=LatAccRollCompStandardByESC
        PinionSteerAngleFrontStandard: required-interface=PinionSteerAngleFrontStandard
        PinionSteerAngleFrontSpeedStandard: required-interface=PinionSteerAngleFrontSpeedStandard
        PinionSteerAngleRearSpeedStandard: required-interface=PinionSteerAngleRearSpeedStandard
        PinionSteerAngleRearStandard: required-interface=PinionSteerAngleRearStandard
        SteeringWheelAngleStandard: required-interface=SteeringWheelAngleStandard
        YawStabilityControlActive: required-interface=YawStabilityControlActive
    Suspension
      33 x provide port:
        AbsoluteEstimatedBodyPitchAngle: provided-interface=AbsoluteEstimatedBodyPitchAngle
        AbsoluteEstimatedBodyRollAngle: provided-interface=AbsoluteEstimatedBodyRollAngle
        AbsoluteMeasuredBodyRollAngleStandard: provided-interface=AbsoluteMeasuredBodyRollAngleStandard
        ActiveDamperStatus: provided-interface=ActiveDamperStatus  # Having active dampers
        ActiveStabilizerStatus: provided-interface=ActiveStabilizerStatus  # Having active stabilizer
        ActualBodyLevelMode: provided-interface=ActualBodyLevelMode
        ActualDamperControlTuning: provided-interface=ActualDamperControlTuning
        BodyLevelActuatorStatus: provided-interface=BodyLevelActuatorStatus
        BodyLevelControl: provided-interface=BodyLevelControl
        EstimatedDamperForces: provided-interface=EstimatedDamperForces
        EstimatedRideHeightLevelFront: provided-interface=EstimatedRideHeightLevelFront
        EstimatedRideHeightLevelRear: provided-interface=EstimatedRideHeightLevelRear
        EstimatedSpringForces: provided-interface=EstimatedSpringForces
        EstimatedVehicleBodyVerticalAccel: provided-interface=EstimatedVehicleBodyVerticalAccel
        EstimatedVehicleMass: provided-interface=EstimatedVehicleMass
        EstimatedVerticalWheelForces: provided-interface=EstimatedVerticalWheelForces
        EstimatedWheelLoadDifferenceFront: provided-interface=EstimatedWheelLoadDifferenceFront
        EstimatedWheelLoadDifferenceRear: provided-interface=EstimatedWheelLoadDifferenceRear
        EstimatedWheelVerticalAcceleration: provided-interface=EstimatedWheelVerticalAcceleration
        FullActiveSuspensionControlTuning: provided-interface=FullActiveSuspensionControlTuning
        FullActiveSuspensionStatus: provided-interface=FullActiveSuspensionStatus  # Having full active suspension
        MeasuredRideHeightLevelFrontStandard: provided-interface=MeasuredRideHeightLevelFrontStandard
        MeasuredRideHeightLevelRearStandard: provided-interface=MeasuredRideHeightLevelRearStandard
        MeasuredVehicleBodyVerticalAccel: provided-interface=MeasuredVehicleBodyVerticalAccelStandard
        ActualSwitchableSpringControlTuning: provided-interface=ActualSwitchableSpringControlTuning
        RelativeEstimatedBodyPitchAngle: provided-interface=RelativeEstimatedBodyPitchAngle
        RelativeEstimatedBodyRollAngle: provided-interface=RelativeEstimatedBodyRollAngle
        RollMomentDistribution: provided-interface=RollMomentDistribution
        SuspensionYawStabilityControlActive: provided-interface=SuspensionYawStabilityControlActive
        WheelVerticalAccelerationStandard: provided-interface=WheelVerticalAccelerationStandard
        SwitchableSpringStatus: provided-interface=SwitchableSpringStatus  # having switchable spring system
        SpringTravel: provided-interface=SpringTravel
        RollRateStandard: provided-interface=RollRateStandard  # conditional to RSC
      53 x require port:
        Voltage: required-interface=BatteryVoltage
        AcceleratorPedalRatio: required-interface=AcceleratorPedalRatio
        ActualGear: required-interface=ActualGear
        ActualPowertrainTorqueAtWheels4: required-interface=ActualPowertrainTorqueAtWheels4
        ActualTotalPowertrainTorqueAtWheels: required-interface=ActualTotalPowertrainTorqueAtWheels
        AcceleratorPedalGradient: required-interface=AcceleratorPedalGradient
        ActualBrakeYawTorque: required-interface=ActualBrakeYawTorque
        ActualEstimatedRoadWheelAngleFront: required-interface=ActualEstimatedRoadWheelAngleFront  # Having Lateral dynamics functions
        ActualEstimatedRoadWheelAngleFrontSpeed: required-interface=ActualEstimatedRoadWheelAngleFrontSpeed
        ActualEstimatedRoadWheelAngleRear: required-interface=ActualEstimatedRoadWheelAngleRear  # Having BRWS and having lateral dynamics functions in suspension
        BrakePedalPressed: required-interface=BrakePedalPressed
        BrakePedalValue: required-interface=BrakePedalValue
        EstimatedDriverRoadWheelAngleFrontSpeedWish: required-interface=EstimatedDriverRoadWheelAngleFrontSpeedWish
        EstimatedDriverRoadWheelAngleFrontWish: required-interface=EstimatedDriverRoadWheelAngleFrontWish
        EstimatedVehicleMassFromVLC: required-interface=EstimatedVehicleMassFromVLC
        GearboxCountershaftActive: required-interface=GearboxCountershaftActive
        IntendedVehicleBrakeTorque: required-interface=IntendedVehicleBrakeTorque
        LatAccRollCompStandardByESC: required-interface=LatAccRollCompStandardByESC
        LatAccStandardByESC: required-interface=LatAccStandardByESC  # lateral dynamics functions
        EstimatedLateralSpeedByESC: required-interface=EstimatedLateralSpeedByESC
        LongAccBase: required-interface=LongAccBase
        LongAccFromWheelSpeedsStandard: required-interface=LongAccFromWheelSpeedsStandard
        LongAccPitchCompStandard: required-interface=LongAccPitchCompStandard
        LongAccStandard: required-interface=LongAccStandard
        MeasuredRideHeightLevelFrontBase: required-interface=MeasuredRideHeightLevelFrontBase  # Having front body level actuator
        MeasuredRideHeightLevelRearBase: required-interface=MeasuredRideHeightLevelRearBase  # Having rear body level actuator
        MeasuredVehicleBodyVerticalAccelBase: required-interface=MeasuredVehicleBodyVerticalAccelBase  # Having accel sensor
        RequestedDeltaRoadWheelAngleFrontDAS: required-interface=RequestedDeltaRoadWheelAngleFrontDAS
        YawRateOffsetStandardByESC: required-interface=YawRateOffsetStandardByESC
        TractionControlActive: required-interface=TractionControlActive
        TractionControlBrakeActive: required-interface=TractionControlBrakeActive
        VehicleLongitudinalSpeed: required-interface=VehicleLongitudinalSpeed
        WheelAngularAccelerationStandard: required-interface=WheelAngularAccelerationStandard
        WheelAngularVelocityStandard: required-interface=WheelAngularVelocityStandard
        WheelCircumSpeedsStandard: required-interface=WheelCircumSpeedsStandard
        WheelRotationalDirectionStandard: required-interface=WheelRotationalDirectionStandard
        WheelVerticalAccelerationBase: required-interface=WheelVerticalAccelerationBase  # having acc sensors
        YawControlBrakeActiveWheel: required-interface=YawControlBrakeActiveWheel
        YawRateGradientStandardByESC: required-interface=YawRateGradientStandardByESC
        YawRateReferenceValueByESC: required-interface=YawRateReferenceValueByESC
        YawRateStandardByESC: required-interface=YawRateStandardByESC  # Suspension has yaw control function
        YawStabilityControlActive: required-interface=YawStabilityControlActive
        YawStabilityInformationByESC: required-interface=YawStabilityInformationByESC
        DriverDoorState: required-interface=StaDoor
        PassengerDoorState: required-interface=StaDoor
        RearLeftDoorState: required-interface=StaDoor
        RearRightDoorState: required-interface=StaDoor
        RearLidState: required-interface=StaDoor
        BackliteWindowState: required-interface=StaDoor
        RollRateExtdRangeBase: required-interface=RollRateExtdRangeBase
        RollRateBase: required-interface=RollRateBase
        PitchRateBase: required-interface=PitchRateBase
        PitchRateStandard: required-interface=PitchRateStandard  # conditional to RSC
    ChassisSensorComponents
      16 x provide port:
        ActiveSteerMotorAngleFrontBase: provided-interface=ActiveSteerMotorAngleFrontBase
        DriverSteerTorqueBase: provided-interface=DriverSteerTorqueBase
        LatAccBase: provided-interface=LatAccBase
        LongAccBase: provided-interface=LongAccBase
        MeasuredRideHeightLevelFrontBase: provided-interface=MeasuredRideHeightLevelFrontBase
        MeasuredRideHeightLevelRearBase: provided-interface=MeasuredRideHeightLevelRearBase
        MeasuredVehicleBodyVerticalAccelBase: provided-interface=MeasuredVehicleBodyVerticalAccelBase
        PinionSteerAngleFrontBase: provided-interface=PinionSteerAngleFrontBase
        PinionSteerAngleRearBase: provided-interface=PinionSteerAngleRearBase
        SteeringWheelAngleBase: provided-interface=SteeringWheelAngleBase
        YawRateBase: provided-interface=YawRateBase
        WheelVerticalAccelerationBase: provided-interface=WheelVerticalAccelerationBase
        RollRateExtdRangeBase: provided-interface=RollRateExtdRangeBase
        RollRateBase: provided-interface=RollRateBase
        PitchRateBase: provided-interface=PitchRateBase
        PitchRateStandard: provided-interface=PitchRateStandard
    OPSafety
      provide port Crash: provided-interface=StaCrash
      provide port DriverPresenceFlag: provided-interface=DriverPresenceFlag
    MM_T_HMI
      32 x provide port:
        TankFlapHMI: provided-interface=ReqReleaseLatch
        BackliteWindowHMI: provided-interface=ReqReleaseLatch
        RearLidHMIInt: provided-interface=ReqReleaseLatch
        RearLidHMIExt: provided-interface=ReqReleaseLatch
        GloveBoxHMI: provided-interface=ReqToggle
        EmergencyLocking: provided-interface=ReqLockUnlock
        AutoTintRequest: provided-interface=ReqAutoTinting
        AutoAdjustPanel: provided-interface=ReqAutoAdjust
        Entry: provided-interface=ReqEntry
        ManAdjustPanel: provided-interface=ReqManAdjust
        MassageAdjust: provided-interface=ReqMassageAdjust
        MirrorManualMovementHMI: provided-interface=ReqManAdjustPanel
        MirrorAutoAdjStorePr0HMI: provided-interface=ReqAutoAdjustPanelMirror
        MirrorAutoAdjReStorePr0HMI: provided-interface=ReqAutoAdjustPanelMirror
        MirrorAutoAdjStorePr1HMI: provided-interface=ReqAutoAdjustPanelMirror
        MirrorAutoAdjReStorePr1HMI: provided-interface=ReqAutoAdjustPanelMirror
        MirrorAutoAdjStorePr2HMI: provided-interface=ReqAutoAdjustPanelMirror
        MirrorAutoAdjReStorePr2HMI: provided-interface=ReqAutoAdjustPanelMirror
        MirrorAutoAdjStorePr3HMI: provided-interface=ReqAutoAdjustPanelMirror
        MirrorAutoAdjReStorePr3HMI: provided-interface=ReqAutoAdjustPanelMirror
        DashBoardBrightness: provided-interface=ReqBrightness
        NightPanelActive: provided-interface=ReqNightPanel
        HMIActivateAutoWiping: provided-interface=ReqActivateAutoWiping
        HMIFrontWashing: provided-interface=ReqWashing
        HMIFrontWiping: provided-interface=ReqWiping
        HMIHeadLampWashing: provided-interface=ReqWashing
        HMIIntervalWipingSpeed: provided-interface=ReqIntervalWipingSpeed
        HMIRearWashing: provided-interface=ReqWashing
        HMIRearWiping: provided-interface=ReqWiping
        HMIWiperPosRequest: provided-interface=CmdWiperPos
        CabinLightFnCeIntLightHMI: provided-interface=ReqIntLight
        HazardWarningSwitchIlluminationIntLightHMI: provided-interface=ReqIntLight
      14 x require port:
        StaHotelMode: required-interface=StaHotelMode
        AutoTintStatus: required-interface=StaAutoTinting
        MassageStatus: required-interface=StaMassageAdjust
        ErrorStatusSteeringBSTS: required-interface=ErrorStatusSteeringBSTS
        ErrorStatusSteeringBSAS: required-interface=ErrorStatusSteeringBSAS
        ErrorStatusSteeringBRWS: required-interface=ErrorStatusSteeringBRWS
        FullActiveSuspensionStatus: required-interface=FullActiveSuspensionStatus
        SwitchableSpringStatus: required-interface=SwitchableSpringStatus
        ActiveDamperStatus: required-interface=ActiveDamperStatus
        ActiveStabilizerStatus: required-interface=ActiveStabilizerStatus
        ActualBodyLevelMode: required-interface=ActualBodyLevelMode
        BodyLevelActuatorStatus: required-interface=BodyLevelActuatorStatus
        BodyLevelControl: required-interface=BodyLevelControl
        DispRainSensActive: required-interface=DispRainSens  # Informs driver, if rain sensor is currently active.
