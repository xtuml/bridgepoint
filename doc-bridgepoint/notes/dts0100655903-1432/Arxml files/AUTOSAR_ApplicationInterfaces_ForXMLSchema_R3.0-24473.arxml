[part 2 of 4: packages /AUTOSAR/Interfaces to /AUTOSAR/ComponentTypes]
AUTOSAR XML (schema 3.0.2)
package /AUTOSAR/Interfaces
  346 x sender receiver interface:
    BatteryVoltage  # This interface provides the actual voltage level as measured at the battery.
      data value: type=t_BatteryVoltage
    CmdBrightness  # Request the brightness of a light source or the control panel. The percent-age value (independent of light actuator type and environment e.g. voltage of electrical system) depends on the functionality that the light source shall be switched on for. 100 percent means full power of the light actuator. Invalidation (in-band) might be choosen for emergency illumination in case of jammed network.
      data command: type=t_CmdBrightness
    CmdChildProt  # This is the functional command to the actuator component to execute activation or deactivation of child lock.
      data command: type=t_CmdChildProt
    CmdGlobalDimLight  # This is the command of light master to give a global exterior and interior light dimming information based on the outside brightness level. It is used e. g. to dim the exterior light depending on outside brightness. 0% means full darkness 100% means maximum brightness This interface gives the information of the actual outside brightness. E.g. exterior or interior light can use this information to adapt their own dimming calculation.
      data command: type=t_promille
    CmdLock  # This is the functional command to the actuator component to execute the command unlock, lock or safe (double lock) at the latch.
      data command: type=t_CmdLock
    CmdMirrorMove  # Command to move the axis in a certain direction.
      data request: type=t_MirrorAxisMove
    CmdMirrorTinting  # Command for tinting to the actuator component.
      data request: type=t_CmdMirrorTinting
    CmdPullAid  # This is the functional command to the actuator component to execute activation of pull/ push aid.
      data command: type=t_CmdPullAid
    DisExtLight  # Provides the information whether a certain function is on or off. As long as the function is on (activated), the value on should be provided. This inter-face can be used e.g. to provide feedback to the driver via MMI. This is considered as a status signal, which carries continuously a certain value as long as its semantic condition is present.
      data display: type=t_onoff
    DisParkingLights  # The interface is provided by a master component and provides feedback to e.g. the MMI whether the left parking lights, the right parking lights or the positioning lights are to be displayed as active. As long as this functionality is required the value should be on.
      data display: type=t_DisParkingLights
    ReqAutoAdjustPanelMirror  # User request to move the mirror automatically or to store the mirror position to the given profile.
      data request: type=t_ReqAutoAdjustPanelMirror
    ReqAutoTinting  # user request to set the mirrors tinting automatically
      data request: type=t_onoff
    ReqBrightness  # Request the brightness of a light source or the control panel. The percent-age value (independent of light actuator type and environment e.g. voltage of electrical system) depends on the functionality that the light source shall be switched on for. 100 percent means full power of the light actuator. Invalid is choosen for emergency illumination in case of jammed network.
      data request: type=t_promille
    ReqCarFinder  # Demand to activate/ deactivate carfinder functionality. The request can be set e.g. manually by the user or via user settings in the MMI.
      data request: type=t_onoff
    ReqComingHomeLeavingHome  # Demand to activate/ deactivate coming home/ leaving home functionalities. The request can be set e.g. manually by the user or via user settings in the MMI.
      data request: type=t_ReqComingHomeLeavingHome
    ReqHotelMode  # User request to activate hotel mode of the central door locking sys-tem. This feature allows to keep just the driver door open, while the rest (includes glove box to secure private goods) of the car is locked; &quot;on&quot; means hotel mode.
      data request: type=t_onoff
    ReqIntLight  # Request to activate / deactivate an interior light actuator denoted by [int_light] or a virtual interior light group also denoted by [int_light]. Faulty switch requires (in-band) invalidation. Also there might be a separate value be required for initialization.
      data request: type=t_ReqIntLight
    ReqLockingFeedback  # Request special blinking for feedback that the locking system was unlocked, locked or safed by user request. The blink sequence is represented by a separate interface.
      data status: type=t_ReqLockingFeedback
    ReqLockUnlock  # User request for emergency locking in case of danger.
      data status: type=t_ReqLockUnlock
    ReqManAdjustPanel  # User request to move the axis of the mirror manually in a certain di-rection.
      data request: type=t_ReqManAdjustPanel
    ReqMirrorAutoMove  # Request to move the mirror automatically to a certain position. This position could be determined by a user request from the mirror panel, an access from the remote key, a keyless access or if reverse gear was detected, to down outer mirror angle to provide the best view to the curb.
      data request: type=t_ReqMirrorAutoMove
    ReqMirrorMove  # Request to move the axis of the mentioned mirror to the indicated position.
      data request: type=t_MirrorAxisMove
    ReqReleaseLatch  # User request to release/unlock the latch of rear lid or tankflap or backlite window; &quot;on&quot; means latch release to unlock or open a lid or backlite window
      data request: type=t_onoff
    ReqStoreMirrorPos  # Request to store the position of a certain mirror to the corresponding profile number.
      data request: type=t_ReqStoreMirrorPos
    ReqStorePosMemory  # Request to store the position of a certain mirror and axis to the memory position 'profile'.
      data request: type=t_MirrorPosMemory
    ReqTintingValue  # Deliveres the desired value for mirror tinting.
      data status: type=t_ReqTintingValue
    ReqToggle  # User request to lock / unlock e.g. the glovebox (&quot;Toggle-Function&quot;); &quot;on&quot; means toggle.
      data request: type=t_onoff
    ReqVisualAlarm  # Request from anti theft system master to e.g. blink master to start requested blink sequence.
      data request: type=t_onoff
    StaAutoTinting  # Status of the automatic tinting.
      data status: type=t_StaAutoTinting
    StaCentralLocking  # Provides the information which status the central door locking currently has.
      data status: type=t_StaCentralLocking
    StaChildProt  # Status if child protection is activated or not.
      data command: type=t_onoff
    StaCrash  # This interface provides the current crash status (values as pre-crash, post-crash, ... )..
      data status: type=t_StaCrash
    StaDoor  # Provides information whether a door or a lid is open or closed. As long as the status is valid, the value should be provided.
      data status: type=t_StaDoor
    StaHotelMode  # Status if hotel mode is activated or not.; &quot;on&quot; means hotel mode acti-vated.
      data status: type=t_onoff
    StaLightFault  # Used as feedback from an actuator component to indicate that the light source is broken or not. Note that no details of the fault are transmitted, but just an operational / defective fault indication. This enables a control component to decide whether a broken light has to be replaced by another light source. Note: The interface Status[light] is not used for detailed diag-nostics. If the light source contains more than one e. g. bulb, it shall be de-fined how many actuators have to be broken to reach the state defec-tive. The decision to give the status defective is done by the actuator component.
      data status: type=t_StaLightFault
    StaLock  # Status of the latch. This interface provides the information about the current locking state of the latch. It does not distinguish between the source through which it was operated (mech. key, the internal motor or the internal knob). This Status is provided to the central locking in order to unlock/lock/save the other latches of the vehicle.
      data status: type=t_StaLock
    StaMirrorAction  # Feedback from the mirror manager about the kind of action that is currently running (mirror moving or mirror stopped). It might be necessary to immediately stop automatic positioning if the driver hits any key (panic-stop).
      data status: type=t_StaMirrorAction
    StaMirrorFault  # Used as feedback from an actuator component to indicate that the mirror is broken or not. Note that no details of the fault are transmit-ted, but just an operational / defective fault indication. This enables a control component to decide whether a mirror is broken and should not be actuated. Note:The interface is not used for detailed diagnostics.
      data status: type=t_StaMirrorFault
    StaMirrorMove  # Status of movement of a mirror on an axis in a certain direction.
      data request: type=t_MirrorAxisMove
    StaMirrorPos  # Actual mirror position
      data request: type=t_MirrorAxisPos
    StaMirrorPosMemory  # Memory-position data from storage memory for the current profile of a certain mirror and axis.
      data status: type=t_MirrorPosMemory
    StaMirrorTinting  # Current status of tinting as feedback in order to control the tinting command to the actuator component.
      data status: type=t_StaMirrorTinting
    StaOpenClosed  # Provides information whether glovebox is open or closed. As long as the status is valid the corresponding value should be provided.
      data status: type=t_openclosed
    StaOutsideBrightness  # This is the outside brightness quantizes in some levels. It is e. g. used from exterior light master to generate a CmdGlobalDim value
      data status: type=t_StaOutSideBrightness
    AcceleratorPedalRatio  # Position of the accelerator pedal, not &quot;simulated&quot; value for e.g. ACC driver. Evaluated signal jitter free without time filtering, including plausibility check, monitoring and replacement value. 0% is driver off the pedal, offsets are removed. 100% must be ensured at end point of the pedal. Shall cover the 100% as well Remark: signal is sent with initialisation
      data AcceleratorPedalRatio: type=AR_Percent
    AcceleratorPedalRatioFiltered  # shaped / time filtered value based on accelerator pedal ratio. (e.g. PT1 with calibratable time constant) Calibration shall make it sure that the signal range is 0 - 100%. 0% is driver off the pedal, offsets are removed. 100% must be ensured at end point of the pedal. Shall cover the 100% as well;
      data AcceleratorPedalRatioFiltered: type=AR_Percent
    ActualGear  # Shows the gear being currently engaged in the gear box. Mapping of physical gear to representation is left open, but according to: Negative values: Reverse gears. (Only for manual transmission: If no information about reverse gears is available then corresponding positive values are used for reverse gears.) Positive values: forward gears; 0 is drive train open (no torque at clutch is transmitted between the running engine(s) and the wheels). Additional Information about &quot;Selected Gear&quot; You will find in &quot;Gear lever position&quot;. The use of CVT has to be handled by separate SW-functionalities. Also for CVT 0 is defined as open drive train. Remark: Default value after reset is zero.
      data ActualGear: type=Gear
    GearboxCountershaftActive  # indicates whether the gear is in low range mode E.g. for SUV or Offroad-vehicles with countershaft gearboxes (high range / low range) 0 is the countershaft not used (standard cond.) 1 is the countershaft used
      data GearboxCountershaftActive: type=Boolean
    EngineSpeed  # The actual rotational speed of the engine crankshaft. The Signal will be evaluated from a segment synchronous source. The input has to be mapped from segment to 10ms repetition rate, for slow revolutions the value needs not to be updated during one segment.
      data EngineSpeed: type=AR_RPM
    GearLeverPosition  # Only defined for automatic transmissions. The signal is based on the lever position. Remark: signal is sent with initialisation
      data GearLeverPosition: type=GearLeverPosition
    TransmissionType  # Information on standard transmission. Initialization possible by EoL, Key on This information can come from compiler switch, calibration label, or as learned variant (SW identifies Gearbox type) Note: Depending on &quot;data transmitted during initialization&quot; and Autosar methodology currently under development. Remark: signal is sent with initialisation
      data TransmissionType: type=TransmissionType
    ActualEngineTorqueAtCrankshaft  # actual engine torque at crank level, assuming no auxiliary load = Indicated torque + Internal engine torque loss it is a computed interface including all interventions not considering inertia of the engine Example of realization: the torque is an average (cylinder average not time average) of all cylinders with current operating parameters including ignition timing, lambda, fuel cut level, fuel quantity, injection timing and others. REMARK: The signal is valid if the engine is higher than a certain engine speed threshold. This threshold depends on the engine (e.g.about 500 rpm for four cylinder engines). Below this limit the accuracy of this value may decrease significantly. For hybrid stop/start strategy the engine speed of the fired engine should always be above the speed threshold. Default value after reset is zero
      data ActualEngineTorqueAtCrankshaft: type=AR_Torque
    InternalEngineTorqueLosses  # The internal engine torque losses at the crankshaft consist of basic friction and pumping losses and losses for mechanical units directly driven by the engine and needed to drive the engine (e.g. oil pump, water pump...). Losses are negative or zero. This interface is equivalent to the absolute minimal torque at crankshaft. (The engine is in total fuel cut off) loss adaptation is included (Engine losses , Losses of all component mechanically driven by engine e.g A/C ) current ambient conditions. REMARK: The signal is valid if the engine speed is higher than a certain engine speed threshold. This threshold depends on the engine (e.g.about 500 rpm for four cylinder engines). Below this limit the accuracy of this value may decrease significantly. For hybrid stop/start strategy the engine speed of the fired engine should always be above the speed threshold. Default value after reset is zero
      data InternalEngineTorqueLosses: type=AR_Torque_neg
    MaximumTorqueImmediatelyAvailableForPTCatCrankshaft  # including current engine speed, the actual air mass (both gasoline and diesel) and the static power limitation of the engine (e.g. calibrated restrictions for engine protection), relevant for torque requests realized by fast path Example of realization: The maximum torque is realized by fast path [e.g with the earliest possible ignition angle at current lambda (gasoline in homogeneous mode) or the maximum fuel mass and optimum injection timing concerning torque (diesel)] , including Average knocking (average of cylinders), smoke limitation. REMARK: The same as &quot;Actual engine torque at crankshaft&quot; Default value after reset is zero
      data MaximumTorqueImmediatelyAvailableForPTCatCrankshaft: type=AR_Torque
    MinimumTorqueImmediatelyAvailableForPTCatCrankshaft  # including current engine speed and the actual air mass (both gasoline and diesel), defined for fired engine relevant for torque requests realized by fast path Example of realization: The minimum torque is realized by fast path [e.g. the latest possible ignition angle at current lambda (gasoline in homogeneous mode) or the minimum fuel mass and injection timing (diesel)] not considering Injection pattern intervention. For diesel engines this interface is possibly equivalent to the torque losses, because minimum fuel mass could be zero. REMARK: The same as &quot;Actual engine torque at crankshaft&quot; Default value after reset is zero
      data MinimumTorqueImmediatelyAvailableForPTCatCrankshaft: type=AR_Torque
    MaximumAvailableTorqueAtCrankshaftForPTC  # The maximum torque at crankshaft at the current engine speed and actual air mass (both gasoline and diesel), including the static power limitation of the engine (e.g. calibrated restrictions for engine protection) Example of realization: The maximum torque is realized by fast and slow path [e.g. with the earliest possible ignition angle at current lambda (gasoline in homogeneous mode ) or the maximum fuel mass and injection timing (diesel)] including average knocking (average of cylinders), smoke limitation. REMARK: The signal is valid if the engine speed is higher than a certain engine speed threshold. This threshold depends on the engine (e.g.about 500 rpm for four cylinder engines). Below this limit the accuracy of this value may decrease significantly. For hybrid stop/start strategy the engine speed of the fired engine should always be above the speed threshold. Default value after reset is zero
      data MaximumAvailableTorqueAtCrankshaftForPTC: type=AR_Torque
    MaximumTorqueAtCrankshaftForPTCatOptimumConditions  # The maximum torque at crankshaft at the current engine speed, maximum air mass, current ambient pressure and air temperature (both gasoline and diesel), including the static power limitation of the engine (e.g. calibrated restrictions for engine protection). calculated for ideal conditions. Example of Realization: The maximum torque is realized by fast and slow path [e.g. with the earliest possible ignition angle at optimum lambda concerning torque (gasoline) or the maximum fuel mass and injection timing (diesel)] Smoke limitation is included in the signal Average knocking is not considered (without knock control), but the precalibrated knocking limitation. REMARK: The signal is valid if the engine speed is higher than a certain engine speed threshold. This threshold depends on the engine (e.g.about 500 rpm for four cylinder engines). Below this limit the accuracy of this value may decrease significantly. For hybrid stop/start strategy the engine speed of the fired engine should always be above the speed threshold. Default value after reset is zero
      data MaximumTorqueAtCrankshaftForPTCatOptimumConditions: type=AR_Torque
    MinimumTorqueAtCrankshaftForPTCrealizedBySlowPath  # The minimum torque at crankshaft at the current engine speed and the minimum air mass (both gasoline and diesel) not including spark retard (gasoline) and fuel cut-off Example of realization: The minimum torque is realized by slow path [e.g. normal ignition timing for the minimum mass air at current lambda (gasoline homogeneous) or the minimum fuel mass and injection timing (diesel)] For diesel engines this interface is possibly equivalent to the torque losses, because minimum fuel mass could be zero. Otherwise minimum torque for fired engine REMARK: The signal is valid if the engine speed is higher than a certain engine speed threshold. This threshold depends on the engine (e.g.about 500 rpm for four cylinder engines). Below this limit the accuracy of this value may decrease significantly. For hybrid stop/start strategy the engine speed of the fired engine should always be above the speed threshold. Default value after reset is zero
      data MinimumTorqueAtCrankshaftForPTCrealizedBySlowPath: type=AR_Torque
    MinimumTorqueAtCrankshaftForPTCRealizedBySlowAndFastPath  # The minimum torque at crankshaft at the current engine speed and the minimum air mass (both gasoline and diesel) including spark retard (gasoline), not including fuel cut-off Equivalent to 'Minimum torque at crankshaft for PTC realized by slow path' for Diesel engines. Example of realization: The minimum torque is realized by slow and fast path [e.g. considering a certain spark retard for the minimum mass air at current lambda (gasoline homogeneous) or the minimum fuel mass and injection timing (diesel)]. The possible amount of spark retard can be defined depending on the application, e.g. according to driveability criteria. For diesel engines this interface is possibly equivalent to the torque losses, because minimum fuel mass could be zero. Otherwise minimum torque for fired engine REMARK: The signal is valid if the engine speed is higher than a certain engine speed threshold. This threshold depends on the engine (e.g.about 500 rpm for four cylinder engines). Below this limit the accuracy of this value may decrease significantly. For hybrid stop/start strategy the engine speed of the fired engine should always be above the speed threshold. Default value after reset is zero
      data MinimumTorqueAtCrankshaftForPTCRealizedBySlowAndFastPath: type=AR_Torque
    EngineTemperature  # engine water temperature (based on measurement) represents the engine temperature REMARK: signal is sent with initialisation
      data EngineTemperature: type=Temperature2
    MaxEngineSpeed  # Maximum permitted engine speed for engine protection, must not be exceeded by shifting REMARK: default value after reset: max value
      data MaxEngineSpeed: type=AR_RPM
    MaximumAllowedTorqueAtCrankshaftForEngineProtection  # Maximum crankshaft torque including engine protection. If no protection function is acitve, the value of this interface will be the upper limit of the chosen data type. Example of realization: Including catalyst protection, over heating, intake air system protection and fail safe etc. REMARK: signal is sent with initialisation
      data MaximumAllowedTorqueAtCrankshaftForEngineProtection: type=AR_Torque
    TorqueReserveRequestFromEngineToPTC  # Torque reserve request to be coordinated by the PTC. This torque reserve could be realized either by the combustion engine or by another torque source (e.g. electric motor in a hybrid system). It does not include torque reserve requests which will be coordinated inside the combustion engine, e.g. torque reserve for catalyst heating or torque reserve to realize a change in the engine operation mode. REMARK: Default value after reset is zero
      data TorqueReserveRequestFromEngineToPTC: type=AR_Torque
    MinimumEngineSpeedSetpoint  # Minimum engine speed from engine control point of view E.g. engine idle speed to be arbitrated by PTC with all other requested engine speeds.(A/C, alternator, transmission, ...) REMARK: signal is sent with initialisation
      data MinimumEngineSpeedSetpoint: type=AR_RPM
    MinimumTotalPowertrainTorqueAtWheelsRequestedByStabilityControlSlow  # Anticipated wheel torque (to all the driven wheels) after coordination among several stability systems (traction control, stability control, and yaw rate control) to be generated by the power-train. This is the minimum torque to be delivered by the powertrain, e.g. a torque increase request [absolute] for MSR (to prevent wheel lock up). If the maximum request is less than the minimum request the priority is the Maximum Request (which in the case is the lower value!) If no request is active, the value of this interface will be the lower limit of the chosen data type. REMARK: Must be initialised to the lower limit of the chosen data type.
      data MinimumTotalPowertrainTorqueAtWheelsRequestedByStabilityControlSlow: type=AR_TorqueAtWheel
    MinimumTotalPowertrainTorqueAtWheelsRequestedByStabilityControlFast  # Wheel torque (to all the driven wheels) after coordination among several stability systems (traction control, stability control, and yaw rate control) to be generated by the power-train. This is the minimum torque to be delivered by the powertrain, e.g. a torque increase request [absolute] for MSR (to prevent wheel lock up). If the maximum request is less than the minimum request the priority must be clearly defined. If no request is acitve, the value of this interface will be the lower limit of the chosen data type. REMARK: Must be initialised to the lower limit of the chosen data type.
      data MinimumTotalPowertrainTorqueAtWheelsRequestedByStabilityControlFast: type=AR_TorqueAtWheel
    MinimumTotalPowertrainTorqueAtWheelsRequestedByRSCSlow  # Requested wheel torque from RSC to ESC (slow). This is the minimum torque to be delivered by the powertrain, e.g. a torque increase request [absolute] for MSR (to prevent wheel lock up). If the maximum request is less than the minimum request the priority is the Maximum Request (which in the case is the lower value!) If no request is active, the value of this interface will be the lower limit of the chosen data type. REMARK: Must be initialised to the lower limit of the chosen data type.
      data MinimumTotalPowertrainTorqueAtWheelsRequestedByRSCSlow: type=AR_TorqueAtWheel
    MinimumTotalPowertrainTorqueAtWheelsRequestedByRSCFast  # Requested wheel torque from RSC to ESC (fast). This is the minimum torque to be delivered by the powertrain, e.g. a torque increase request [absolute] for MSR (to prevent wheel lock up). If the maximum request is less than the minimum request the priority must be clearly defined. If no request is acitve, the value of this interface will be the lower limit of the chosen data type. REMARK: Must be initialised to the lower limit of the chosen data type.
      data MinimumTotalPowertrainTorqueAtWheelsRequestedByRSCFast: type=AR_TorqueAtWheel
    MaximumTotalPowertrainTorqueAtWheelsRequestedByRSCSlow  # Requested wheel torque from RSC to ESC (slow). This is the maximum torque to be delivered by the powertrain, e.g. a torque decrease request [absolute] for ASR (to prevent wheel spin). If the maximum request is less than the minimum request the priority must be clearly defined. If no request is acitve, the value of this interface will be the upper limit of the chosen data type. REMARK: Must be initialised to the upper limit of the chosen data type.
      data MaximumTotalPowertrainTorqueAtWheelsRequestedByRSCSlow: type=AR_TorqueAtWheel
    MaximumTotalPowertrainTorqueAtWheelsRequestedByRSCFast  # Requested wheel torque from RSC to ESC (fast). This is the maximum torque to be delivered by the powertrain, e.g. a torque decrease request [absolute] for ASR (to prevent wheel spin). If the maximum request is less than the minimum request the priority must be clearly defined. If no request is acitve, the value of this interface will be the upper limit of the chosen data type. REMARK: Must be initialised to the upper limit of the chosen data type.
      data MaximumTotalPowertrainTorqueAtWheelsRequestedByRSCFast: type=AR_TorqueAtWheel
    MinimumTotalPowertrainTorqueAtWheelsRequestedByVehicleLongitudinalControl  # Requested wheel torque (to all the driven wheels) after coordination among several vehicle longitudinal control systems (e.g. cruise control, adaptive cruise control, collision mitigation) to be generated by the power-train. This is the minimum torque to be delivered by the powertrain, e.g. a torque request [absolute] for CC/ACC (Cruise Control, Adaptive Cruise Control). If the maximum request is less than the minimum request the priority must be clearly defined. If no request is acitve, the value of this interface will be the lower limit of the chosen data type. REMARK: Must be initialised to the lower limit of the chosen data type.
      data MinimumTotalPowertrainTorqueAtWheelsRequestedByVehicleLongitudinalControl: type=AR_TorqueAtWheel
    MaximumTotalPowertrainTorqueAtWheelsRequestedByStabilityControlSlow  # Anticipated wheel torque (to all the driven wheels) after coordination among several stability systems (traction control, stability control, and yaw rate control) to be generated by the power-train. This is the maximum torque to be delivered by the powertrain, e.g. a torque decrease request [absolute] for ASR (to prevent wheel spin). If the maximum request is less than the minimum request the priority must be clearly defined. If no request is acitve, the value of this interface will be the upper limit of the chosen data type. REMARK: Must be initialised to the upper limit of the chosen data type.
      data MaximumTotalPowertrainTorqueAtWheelsRequestedByStabilityControlSlow: type=AR_TorqueAtWheel
    MaximumTotalPowertrainTorqueAtWheelsRequestedByStabilityControlFast  # Wheel torque (to all the driven wheels) after coordination among several stability systems (traction control, stability control, and yaw rate control) to be generated by the power-train. This is the maximum torque to be delivered by the powertrain, e.g. a torque decrease request [absolute] for ASR (to prevent wheel spin). If the maximum request is less than the minimum request the priority must be clearly defined. If no request is acitve, the value of this interface will be the upper limit of the chosen data type. REMARK: Must be initialised to the upper limit of the chosen data type.
      data MaximumTotalPowertrainTorqueAtWheelsRequestedByStabilityControlFast: type=AR_TorqueAtWheel
    MaximumTotalPowertrainTorqueAtWheelsRequestedByVehicleLongitudinalControl  # Requested wheel torque (to all the driven wheels) after coordination among several vehicle longitudinal control systems (e.g. cruise control, adaptive cruise control, collision mitigation) to be generated by the power-train. This is the maximum torque to be delivered by the powertrain, e.g. a torque limit request [absolute] (vehicle speed limitation). If the maximum request is less than the minimum request the priority is the Maximum Request (which in the case is the lower value!). If no request is acitve, the value of this interface will be the upper limit of the chosen data type. REMARK: Must be initialised to the upper limit of the chosen data type.
      data MaximumTotalPowertrainTorqueAtWheelsRequestedByVehicleLongitudinalControl: type=AR_TorqueAtWheel
    VirtualAcceleratorPedalRatio  # Evaluated signal jitter free without time filtering, including plausibility check, monitoring and replacement value. 0% is driver off the pedal, offsets are removed. 100% must be ensured at end point of the pedal. Shall cover the 100% as well; includes virtual pedal ratio Example of realization: when in ACC/CC this is based on RequestedTotalPowertrainTorqueAtWheelsForLongitudinalControl), otherwise this is the &quot;Accelerator Pedal Ratio&quot; value. REMARK: signal is sent with initialisation
      data VirtualAcceleratorPedalRatio: type=AR_Percent
    ActualClutchState  # The interface informs about the current state of the clutch. There exist 4 principal states: open, intermediate, near closed, hard closed (Note: The definition of intermediate and near closed has to be made for each project separately) Definition of &quot;Clutch&quot;: - for AT, CVT it is the converter clutch - for MT, AMT it is the clutch between the gear box and the engine drivetrain Be aware that this information is not necessarily equal with the drivetrain open information. If a torque converter clutch is open, the drivetrain can still be closed. In contrary the drivetrain is open for MT and AMT, if the clutch is open! REMARK: Default value after reset is open.
      data ActualClutchState: type=ClutchState
    TargetClutchState  # The interface informs about the target state of the clutch. There exist 4 principal states: open, intermediate, near closed, hard closed (Note: The definition of intermediate and near closed has to be made for each project separately) Definition of &quot;Clutch&quot;: - for AT, CVT it is the converter clutch - for MT, AMT it is the clutch between the gear box and the engine drivetrain Be aware that this information is not necessarily equal with the drivetrain open information. If a torque converter clutch is open, the drivetrain can still be closed. In contrary the drivetrain is open for MT and AMT, if the clutch is open! REMARK: Default value after reset is open.
      data TargetClutchState: type=ClutchState
    TransmissionInputSpeed  # For Transmission with a Torque Converter this interface represents the turbine speed, which is the output speed of the Torque Converter and is computed out of the average value of all completely sensored periods during 10ms. For low speed values a virtual speed is computed. For DCT this speed represents the speed of the active clutch. During a shifting process the speed will be changed to the new active clutch. (It must be discussed, if the signal is necessary for DCT.)
      data TransmissionInputSpeed: type=AR_RPM
    ActualTorqueRatio  # Torque conversion ratio including everything between engine and wheel, i.e. converter gain (only for hydraulic converter), gear box and axle ratio: TQwheel = (TQclutch * FACconverter * ntransmission_in / nwheel) - TQlossDT TQ conversion ratio = FACconverter * ntransmission_in / nwheel (remark: TQlossDT is not considered here) FACconverter = converter gain transmissionin = after converter/clutch Inertia is not considered. The torque conversion ratio considers only the total powertrain torque at wheels, not the wheel individual torque distribution. At open drivetrain: - Driver or Strategy selects &quot;N&quot; or &quot;P&quot;: every transmission has an open drivetrain - Low vehicle speed: MT, AMT and DCT have an open drivetrain. For AT and CVT the drivetrain is still closed (hydraulic converter) - Shifting: Only MT and AMT have an open drivetrain To get a valid value during the open drivetrain always the lowest gear should be used except: - for AMT, if a gear shift is detected, the torque ratio calculation changes from using the current gear state to the target gear state at some point during the shift. This point of change must be agreed between transmitter and receiver. The torque ratio never indicates neutral during a shift. - for AT, CVT and DCT: While the drivetrain is open the transmission prepares a theoretical gear position to engage immediately after the driver selects &quot;D&quot;. This theoretical gear state information should be used. REMARK: Default value after reset is 1.0.
      data ActualTorqueRatio: type=AR_FactorU14_128
    TransmissionOilTemperature  # Transmission oil temperature (based on a measurement) REMARK: signal is sent with initialisation
      data TransmissionOilTemperature: type=Temperature2
    MaximumAllowedTorqueAtClutchForTransmissionProtection  # Protection of gearbox and drivetrain against mechanical and thermal overload. The &quot;maximum allowed torque at clutch&quot; (&quot;Actual engine torque at crankshaft&quot; plus the neg. auxilliary torques) must not be exceeded. The influence of the realized limit has to be considered in all torque signals used by the transmission. Lower limit: &quot;engine internal stall protection&quot; REMARK: Must be initialised to the upper limit of the chosen data type.
      data MaximumAllowedTorqueAtClutchForTransmissionProtection: type=AR_Torque
    MaximumTorqueAtClutchRequestedByTransmissionFast  # Maximum torque at clutch requested by transmission for Shift Energy Management (torque reduction) Example of realization: For each kind of gearshift the calculation of transmission intervention is based on data element &quot;Theoretical Actual torque at clutch without Shift Energy Management&quot;. For example, this request may be active for a duration up to 1000 ms (2000ms for DCT). In case of &quot;change in mind&quot; this time has to be initialized anew. Default value: &quot;no request&quot; = upper limit of the chosen data type REMARK: Must be initialised to the upper limit of the chosen data type.
      data MaximumTorqueAtClutchRequestedByTransmissionFast: type=AR_Torque
    MaximumTorqueAtClutchRequestedByTransmissionSlow  # Maximum torque at clutch requested by transmission for Shift Energy Management (torque reduction) on the Torque Reserve path. Example of realisation: For each kind of gearshift the calculation of transmission intervention is based on data element &quot;Theoretical Actual torque at clutch without Shift Energy Management&quot;. For example, this request may be active for a duration up to 1000 ms (2000ms for DCT). In case of &quot;change in mind&quot; this time has to be initialized anew. Default value: &quot;no request&quot; = upper limit of the chosen data type REMARK: Must be initialised to the upper limit of the chosen data type.
      data MaximumTorqueAtClutchRequestedByTransmissionSlow: type=AR_Torque
    MinimumTorqueAtClutchRequestedByTransmissionFast  # Minimum torque at clutch requested by transmission for Shift Energy Management (torque increase) Example of realisation: For each kind of gearshift the calculation of transmission intervention is based on data element &quot;Theoretical Actual torque at clutch without Shift Energy Management&quot;. For example, this request may be active for a duration up to 1000 ms (2000ms for DCT). In case of &quot;change in mind&quot; this time has to be initialized anew. Default value: &quot;no request&quot; = lower limit of the chosen data type REMARK: Must be initialised to the lower limit of the chosen data type.
      data MinimumTorqueAtClutchRequestedByTransmissionFast: type=AR_Torque
    MinimumTorqueAtClutchRequestedByTransmisssionSlow  # Minimum torque at clutch requested by transmission for Shift Energy Management (torque increase) on the Torque Reserve path. Example of realisation: For each kind of gearshift the calculation of transmission intervention is based on data element &quot;Theoretical Actual torque at clutch without Shift Energy Management&quot;. For example, this request may be active for a duration up to 1000 ms (2000ms for DCT). In case of &quot;change in mind&quot; this time has to be initialized anew. Default value: &quot;no request&quot; = lower limit of the chosen data type REMARK: Must be initialised to the lower limit of the chosen data type.
      data MinimumTorqueAtClutchRequestedByTransmisssionSlow: type=AR_Torque
    ActualPowerSteeringLoad  # Power steering load from hydralic type at engine crank shaft. This value must take into account all relevant dynamic effects. If electric type, this should be zero Nm, because the load is included in alternator load. It is converted to engine crankshaft torque by the provider. REMARK: Default value after reset is zero.
      data ActualPowerSteeringLoad: type=AR_Torque_neg
    TargetGear  # This type shows the gear which will be engaged in the gear box. Mapping of physical gear to representation is left open, but according to AUTOSAR proposal: Negative values: reverse gears. Positive values: forward gears; 0 is drive train open (no torque at clutch is transmitted between the running engine(s) and the wheels). During the shifting process this value informs about the gear which is expected to be engaged in the gear box after the shifting process. Therefore it switches to the expected gear state with the beginning of the shifting process.
      data TargetGear: type=Gear
    KickdownDetected  # kickdown-switch (pushed, not pushed) or derived from pedal value
      data KickdownDetected: type=Boolean
    RequestedPowerSteeringLoad  # Requested power steering load from hydralic type at engine crank shaft. This value represents the torque consumption in a predicted future state. If electric type, this should be zero Nm, because the load is included in alternator load. It is converted to engine crankshaft torque by the provider. REMARK: Default value after reset is zero.
      data RequestedPowerSteeringLoad: type=AR_Torque_neg
    ActualTransmissionOilPumpLoad  # Transmission oil pump load from hydralic type at engine crank shaft. This value must take into account all relevant dynamic effects. If electric type, this should be zero Nm, because the load is included in alternator load. It is converted to engine crankshaft torque by the provider. REMARK: Default value after reset is zero.
      data ActualTransmissionOilPumpLoad: type=AR_Torque_neg
    RequestedTransmissionOilPumpLoad  # Requested transmission oil pump load from hydralic type at engine crank shaft. This value represents the torque consumption in a predicted future state. If electric type, this should be zero Nm, because the load is included in alternator load. It is converted to engine crankshaft torque by the provider. REMARK: Default value after reset is zero.
      data RequestedTransmissionOilPumpLoad: type=AR_Torque_neg
    MaximumTotalPowertrainTorqueAtWheelsForSafetyVehicleSpeedLimitation  # Torque limit calculated from the vehicle's maximum speed limit. This speed limit is not the &quot;comfort&quot; speed limit; it is the safety or vehicle protection limit, not normally selectable by the driver.
      data MaximumTotalPowertrainTorqueAtWheelsForSafetyVehicleSpeedLimitation: type=AR_TorqueAtWheel
    TotalPowertrainTorqueAtWheelsRequestedByDriverSlow  # Anticipated wheel torque (to all the driven wheels) requested by the driver to be generated by the power-train.
      data TotalPowertrainTorqueAtWheelsRequestedByDriverSlow: type=AR_TorqueAtWheel
    TotalPowertrainTorqueAtWheelsRequestedByDriverFast  # Wheel torque (to all the driven wheels) requested by the driver to be generated by the power-train.
      data TotalPowertrainTorqueAtWheelsRequestedByDriverFast: type=AR_TorqueAtWheel
    TorqueAtClutchRequestedByDriverSlow  # Anticipated torque at clutch requested by the driver to be generated by the power-train.
      data TorqueAtClutchRequestedByDriverSlow: type=AR_Torque
    TorqueAtClutchRequestedByDriverFast  # Torque at clutch requested by the driver to be generated by the power-train.
      data TorqueAtClutchRequestedByDriverFast: type=AR_Torque
    ActualPowertrainTorqueAtWheelsFromTransmissionSystem4  # Vector of 4 signals. The AWD component in the Transmission System realizes the torque distribution request and PTC sends the coordinated actual wheel torques as feedback to the Chassis. This interface only considers the torque which can be distributed from one or more central torque producers to the wheels by the transmission system. It does not consider additional torque producers located e.g. at the individual wheels. Where no torque is distributed to the wheels by the transmission system (e.g. one axle not driven or directly driven by an electric machine), the respective values are zero. In case of actor/sensor failures or if there is no possibility to determine the correct distribution an rough estimation is done. Additionally a qualifier has to be set, to inform about invalid or backup values.
      4 x data, all with type=AR_TorqueAtWheel:
        ActualPowertrainTorqueAtWheelsFromTransmissionSystemFL  # Front left wheel
        ActualPowertrainTorqueAtWheelsFromTransmissionSystemFR  # Front right wheel
        ActualPowertrainTorqueAtWheelsFromTransmissionSystemRL  # Rear left wheel
        ActualPowertrainTorqueAtWheelsFromTransmissionSystemRR  # Rear right wheel
    DynamicEngineTorqueCorrection  # This signal has to consider all engine internal inertia torques: correction Tq_dyn.corr = - I dw/dt It can be used to perform a correction of other torque values (e.g. &quot;Actual engine torque at crankshaft&quot;) in order to consider inertia effects. Note: The moment of inertia is a &quot;consumer&quot; in case of positive engine speed gradient. The sign is in accordance to definition of torque losses. REMARK: Default value after reset is zero
      data DynamicEngineTorqueCorrection: type=AR_Torque
    EngineSpeedSetpoint  # calculated engine speed setpoint e.g. idle engine speed setpoint during idle REMARK: Default value after reset:zero
      data EngineSpeedSetpoint: type=AR_RPM
    EngineTorqueAtCrankshaftRequestedByPTCslow  # Crankshaft torque which should be realized by the slow path to prepare the engine for a future torque setpoint. The engine will restrict this request to its internal limits. Example of realization: If there is no distinction between slow and fast path control within the engine management (e.g. for a Diesel engine), this signal can be ignored by the engine management. without fast torque intervention from brake control, transmission control etc.
      data EngineTorqueAtCrankshaftRequestedByPTCslow: type=AR_Torque
    EngineTorqueAtCrankshaftRequestedByPTCfast  # Required crankshaft torque which should be generated by engine. The engine will restrict this request to its internal limits. Example of realization: including fast torque intervention from brake control, transmission control etc.
      data EngineTorqueAtCrankshaftRequestedByPTCfast: type=AR_Torque
    AllowedPowerSteeringLoad  # Allowed power steering load from hydralic type at engine crank shaft. If electric type, this should be zero Nm, because the load is included in alternator load. It is an engine crankshaft torque. REMARK: Default value after reset is zero.
      data AllowedPowerSteeringLoad: type=AR_Torque_neg
    AllowedTransmissionOilPumpLoad  # Allowed transmission oil pump load from hydralic type at engine crank shaft. If electric type, this should be zero Nm, because the load is included in alternator load. It is an engine crankshaft torque. REMARK: Default value after reset is zero.
      data AllowedTransmissionOilPumpLoad: type=AR_Torque_neg
    MaximumAvailableTotalPowertrainTorqueAtWheels  # Maximum possible total torque at wheels. Example of realization: Could take into account: current engine speed, ambient pressure, air temperature, static power limitation due to engine, auxiliaries (everything with impact to the torque output, e.g. power steering pump, AC, generator or starter generator), smoke limitation, fuel quality correction Incl. actual overboost (whilst temporarily active - triggered by driver request). The calculation of torque at wheel could take into account the current gear, hydraulic converter and all losses in the transmission system. REMARK: Must be initialised to the upper limit of the chosen data type.
      data MaximumAvailableTotalPowertrainTorqueAtWheels: type=AR_TorqueAtWheel
    MaximumAvailableTotalPowertrainTorqueAtWheelsForDriver  # Maximum possible total torque at wheels at optimum conditions delivered by powertrain for Driver Example of realization: Could take into account: current engine speed, ambient pressure, air temperature, static power limitation due to engine, auxiliaries (everything with impact to the torque output, e.g. power steering pump, AC, generator or starter generator), smoke limitation, fuel quality correction Incl. maximum overboost The calculation of torque at wheel could take into account the current gear, hydraulic converter and all losses in the transmission system. REMARK: Must be initialised to the upper limit of the chosen data type.
      data MaximumAvailableTotalPowertrainTorqueAtWheelsForDriver: type=AR_TorqueAtWheel
    MinimumAvailableTotalPowertrainTorqueAtWheels  # Minimum possible total powertrain torque at wheels. Chassis can request any torque value between min and max and expect PTC to deliver that value. Example of realization: Could take into account: Losses of auxiliaries, integral part of idle speed controller, indicated torque, engine friction, fuel cut off Complete fuel cut-off excluded, since this is just the complete losses. This is the minimum torque value which can be achieved without any discontinuity and/or impact on emissions. REMARK: Must be initialised to the lower limit of the chosen data type.
      data MinimumAvailableTotalPowertrainTorqueAtWheels: type=AR_TorqueAtWheel
    MinimumAvailableTotalPowertrainTorqueAtWheelsForDriver  # Minimum possible total torque at wheels delivered by powertrain for Driver Example of realization: Could take into account: Losses of auxiliaries, integral part of idle speed controller, indicated torque, engine friction, fuel cut off REMARK: Must be initialised to the lower limit of the chosen data type.
      data MinimumAvailableTotalPowertrainTorqueAtWheelsForDriver: type=AR_TorqueAtWheel
    TorqueReserveRequestFromPTCtoEngine  # Torque Reserve Request coordinated in the PTC to be realized by the combustion engine. The coordination can consider multiple torque reserve requirements, e.g. auxiliary loads such as A/C compressor. REMARK: Default value after reset is zero
      data TorqueReserveRequestFromPTCtoEngine: type=AR_Torque
    ActualTorqueAtClutch  # This signal is computed from &quot;actual torque at crankshaft&quot; and other torque losses with influence on clutch torque (e.g. alternator, air-cond., ...). It considers all torque interventions. REMARK: Default value after reset is zero
      data ActualTorqueAtClutch: type=AR_Torque
    TheoreticalActualTorqueAtClutchWithoutShiftEnergyManagement  # Theoretical value of the actual torque at clutch that would be realised if no shift energy management intervention was active. Implementation and accuracy details (not standardized) have to be agreed on project basis and will have an influence on the calculation complexity. Example of realisation: When no shift energy management intervention is active, the value will be the same as actual torque at clutch. For gasoline engines: If the shift energy management intervention is realized only with ignition angle, this signal takes into account the torque limits at the current air mass and current engine speed. For diesel engines: This signal is computed similar as Theoretical requested torque at clutch without Shift Energy Management. REMARK: Default value after reset is zero
      data TheoreticalActualTorqueAtClutchWithoutShiftEnergyManagement: type=AR_Torque
    TheoreticalRequestedTorqueAtClutchWithoutShiftEnergyManagement  # Arbitrated torque information based on a &quot;Driver demand torque&quot; and all external torque modifications except Shift Energy Management requests. REMARK: Default value after reset is zero
      data TheoreticalRequestedTorqueAtClutchWithoutShiftEnergyManagement: type=AR_Torque
    DynamicActualTorqueAtClutch  # This signal has to consider all engine internal and auxiliary inertia torques, but no transmission inertia torques. Example of usage: Used for Transmission to calculate a predictive slipping time of the clutch to prepare an ideal termination of shifting. Note definition of &quot;dynamic torque correction&quot; This signal has to consider all internal inertia torques of specific components: Tq_dyn.corr = - I dw/dt Tq_dyn = Tq_int + Tq_dyn.corr REMARK: Default value after reset is zero
      data DynamicActualTorqueAtClutch: type=AR_Torque
    PowertrainTorqueDistributionToWheelsRequestedByPTC4  # Vector of 4 signals. This interface only considers the torque which can be distributed from one or more central torque producers to the wheels by the transmission system. It does not consider additional torque producers located e.g. at the individual wheels. Where no torque is distributed to the wheels by the transmission system (e.g. one axle not driven or directly driven by an electric machine), the respective values are zero. The sum of all 4 values must be 100%.
      4 x data, all with type=Percent005:
        PowertrainTorqueDistributionToWheelsRequestedByPTCFL  # Front left wheel
        PowertrainTorqueDistributionToWheelsRequestedByPTCFR  # Front right wheel
        PowertrainTorqueDistributionToWheelsRequestedByPTCRL  # Rear left wheel
        PowertrainTorqueDistributionToWheelsRequestedByPTCRR  # Rear right wheel
    ActualPowertrainTorqueAtWheels4  # Vector of 4 signals. Actual torque delivered by the powertrain to the individual wheels. The sum of all 4 signals must be equal to Actual total powertrain torque at wheels. In case of actor/sensor failures or if there is no possibility to determine the correct distribution an rough estimation is done. Additionally a qualifier has to be set, to inform about invalid or backup values.
      4 x data, all with type=AR_TorqueAtWheel:
        ActualPowertrainTorqueAtWheelsFL  # Front left wheel
        ActualPowertrainTorqueAtWheelsFR  # Front right wheel
        ActualPowertrainTorqueAtWheelsRL  # Rear left wheel
        ActualPowertrainTorqueAtWheelsRR  # Rear right wheel
    ActualTotalPowertrainTorqueAtWheels  # Total wheel torque provided by PT (sum of torques at wheels) This signal is computed from &quot;Actual torque at clutch&quot; and other torque losses with influence on wheel torque (e.g. converter, differential). It considers all torque interventions. It includes the actual torque ratio. Negative values indicate drag torque, independently from driving direction. REMARK: Default value after reset is zero
      data ActualTotalPowertrainTorqueAtWheels: type=AR_TorqueAtWheel
    RequestedTotalPowertrainTorqueAtWheelsForLongitudinalControl  # Total powertrain wheel torque request (sum of torques at wheel) of the driver or VLC ; result of arbitration of driver vs. Driver assistance functions in PTC
      data RequestedTotalPowertrainTorqueAtWheelsForLongitudinalControl: type=AR_TorqueAtWheel
    MaximumAvailableTorqueAtClutchForDriver  # Maximum possible torque at clutch at optimum conditions delivered by powertrain for Driver Example of realization: Could take into account: current engine speed, ambient pressure, air temperature, static power limitation due to engine, auxiliaries (everything with impact to the torque output, e.g. power steering pump, AC, generator or starter generator), smoke limitation, fuel quality correction Incl. maximum overboost
      data MaximumAvailableTorqueAtClutchForDriver: type=AR_Torque
    MinimumAvailableTorqueAtClutchForDriver  # Minimum possible torque at clutch delivered by powertrain for Driver Example of realization: Could take into account: Losses of auxiliaries, integral part of idle speed controller, indicated torque, engine friction, fuel cut off
      data MinimumAvailableTorqueAtClutchForDriver: type=AR_Torque
    SpeedAtClutch  # This interface is used only for vehicles, where the engine speed can be different from the speed at converter or clutch. This signal is a combination of the engine speed and the speed of the electr. machine, at the engine/electric machine side of the transmission clutch or converter. Definition of &quot;Clutch&quot;: - for AT, CVT it is the converter clutch - for MT, AMT it is the clutch between the gear box and the engine drivetrain REMARK: signal is sent with initialisation
      data SpeedAtClutch: type=AR_RPM
    ABSControlActive  # ABS control is active (at least one wheel) 0 = No wheel is in ABS control 1 = At least one wheel is in ABS control
      data ABSControlActive: type=Boolean
    ABSControlActiveWheel  # ABS control is active (Vector of 4) 0 = Wheel is not in ABS control, 1 = Wheel is in ABS control
      4 x data, all with type=Boolean:
        ABSControlActiveWheelFL  # Front left wheel ABS control is active,
        ABSControlActiveWheelFR  # Front right wheel ABS control is active,
        ABSControlActiveWheelRL  # Rear leftwheel ABS control is active,
        ABSControlActiveWheelRR  # Rear right wheel ABS control is active,
    AbsoluteEstimatedBodyPitchAngle  # Estimation of the absolute pitch angle of the vehicle body.
      data AbsoluteEstimatedBodyPitchAngle: type=AbsoluteEstimatedBodyPitchAngle
    AbsoluteEstimatedBodyRollAngle  # Estimation of the absolute roll angle of the vehicle body.
      data AbsoluteEstimatedBodyRollAngle: type=AbsoluteEstimatedBodyRollAngle
    AbsoluteMeasuredBodyRollAngleBase  # Measured absolute vehicle body roll angle.
      data AbsoluteMeasuredBodyRollAngle: type=AbsoluteMeasuredBodyRollAngleBase
    AbsoluteMeasuredBodyRollAngleStandard  # Measured absolute vehicle body roll angle. Filtered and offset compensated.
      data AbsoluteMeasuredBodyRollAngleStandard: type=AbsoluteMeasuredBodyRollAngleStandard
    DriverRequestOverridesVLCrequest  # Information that driver overrides SW-C VLC with acceleration pedal. This means that the torque request from the driver is higher than the torque request from the VLC. false: no override true: override
      data DriverRequestOverridesVLCrequest: type=Boolean
    AcceleratorPedalGradient  # time-derivative of AcceleratorPedalRatio
      data AcceleratorPedalGradient: type=AcceleratorPedalGradient
    ActiveDamperStatus  # Status provided by the semi-active or switchable damper
      data ActiveDamperStatus: type=ActiveDamperStatus
    ActiveDifferentialYawStabilityControlActive  # Indicates whether the yaw stability control is active or not, 0=Yaw stability control not active 1=Yaw stability control active
      data ActiveDifferentialYawStabilityControlActive: type=Boolean
    ActiveStabilizerStatus  # Status provided by the active or switchable stabilizer on front and rear axle.
      data ActiveStabilizerStatusFrontAxle: type=ActiveStabilizerStatus  # Status provided by the active or switchable stabilizer (front axle)
      data ActiveStabilizerStatusRearAxle: type=ActiveStabilizerStatus  # Status provided by the active or switchable stabilizer (rear axle)
    ActiveSteerMotorAngleFrontBase  # measures the angle of the front steering device at the steer motor (for steering angle superposition systems)
      data ActiveSteerMotorAngleFrontBase: type=ActiveSteerMotorAngleFrontBase
    ActiveSteerMotorAngleFrontStandard  # Conditioned angle of the front steering device at the steer motor (for steering angle superposition systems) (Filtered and Offset corrected)
      data ActiveSteerMotorAngleFrontStandard: type=ActiveSteerMotorAngleFrontStandard
    ActiveSteerMotorAngleSpeedFrontStandard  # Conditioned derivative of the angular position measured at the front steering device with respect to the motor shaft.
      data ActiveSteerMotorAngleSpeedFrontStandard: type=ActiveSteerMotorAngleSpeedFrontStandard
    ActiveSteerYawStabilityControlActive  # Indicates whether the yaw stability control is active or not 0=Yaw stability control not active 1=Yaw stability control active
      data ActiveSteerYawStabilityControlActive: type=Boolean
    ActualBodyLevelMode  # Actual or target body level displayed to the driver and provided to other systems
      data ActualBodyLevelMode: type=ActualBodyLevelMode
    ActualBrakeYawTorque  # Component of the total yaw torque realized by brake actuator BrakeYawTorque is defined as the difference of brake forces from left and right wheels times the track width
      data ActualBrakeYawTorque: type=ActualBrakeYawTorque
    ActualDamperControlTuning  # Damper tuning mode displayed to the driver
      data ActualDamperControlTuning: type=ActualSuspensionControlTuning
    ActualExtYawTorque  # Component of the total yaw torque realized by ext yaw rate controller using additional actuators (steering, suspenssion, ...)
      data ActualExtYawTorque: type=ActualExtYawTorque
    ActualEstimatedRoadWheelAngleFront  # road wheel angle at front steered wheels (e.g. calculated by a relation converter: steer wheel angle - road wheel angle using a characteristic map)
      data ActualEstimatedRoadWheelAngleFront: type=ActualEstimatedRoadWheelAngleFront
    ActualEstimatedRoadWheelAngleFrontSpeed  # time-derivative of ActualEstimatedRoadWheelAngleFront
      data ActualEstimatedRoadWheelAngleFrontSpeed: type=ActualEstimatedRoadWheelAngleFrontSpeed
    ActualEstimatedRoadWheelAngleRear  # Actual estimated road wheel angle at rear steered wheels
      data ActualEstimatedRoadWheelAngleRear: type=ActualEstimatedRoadWheelAngleRear
    ActualRollMomentFront  # Estimation of roll moment compensated by the front stabilizer.
      data ActualRollMomentFront: type=ActualRollMomentFront
    ActualRollMomentRear  # Estimation of roll moment compensated by the rear stabilizer.
      data ActualRollMomentRear: type=ActualRollMomentRear
    ActualStabilizerControlTuning  # Stabilizer tuning mode displayed to driver and provided to other systems
      data ActualStabilizerControlTuning: type=ActualSuspensionControlTuning
    ActualSwitchableSpringControlTuning  # Spring tuning mode displayed to the driver and provided to other systems
      data ActualSwitchableSpringControlTuning: type=ActualSuspensionControlTuning
    DirectionIndication  # Information about if driver has activated turning indicators, and if so in which direction (left/right).
      data DirectionIndication: type=DirectionIndication
    BodyLevelActuatorStatus  # Status provided by body level actuator system (ON, OFF, FAULT).
      data BodyLevelActuatorStatus: type=BodyLevelActuatorStatus
    BodyLevelControl  # Activity of the body level control
      data BodyLevelControl: type=BodyLevelControl
    BrakeActuatorActive  # Brake actuator is used to slow down the vehicle (either due to brake pedal being applied or external brake request, e.g. from ACC)
      data BrakeActuatorActive: type=Boolean
    BrakeActuatorMode  # Indicates the action executed by the brake actuator or its state, with regards to parking brake functionality,
      data BrakeActuatorMode: type=BrakeActuatorMode
    BrakeActuatorOverheated  # temperature of at least one actuator component is too high. One flag indicating that temperature of at least one actuator component is high, e.g. valves overheated. If this flag is set the actuator is in a critical condition. The external function, e.g. RSC can decide whether to use the brake or not, 0: normal brake temperature 1: brake overheated
      data BrakeActuatorOverheated: type=Boolean
    BrakeActuatorSaturation  # indicates that a brake actuator is in saturation mode. This is a not wheel individual but global information.
      data BrakeActuatorSaturation: type=BrakeActuatorSaturation
    BrakeActuatorSaturationWheel  # indicates which brake actuator is in saturation mode for the individual wheels in the order front left, front right, rear left, rear right.
      4 x data, all with type=BrakeActuatorSaturation:
        BrakeActuatorSaturationWheelFL  # Front left wheel
        BrakeActuatorSaturationWheelFR  # Front right wheel
        BrakeActuatorSaturationWheelRL  # Rear left wheel
        BrakeActuatorSaturationWheelRR  # Rear right wheel
    BrakeActuatorStatus_BOD_RSC  # Indicates failure state of the brake actuators with respect to brake-on-demand functions within RSC 0: no failure 1: failure
      data BrakeActuatorStatus_BOD_RSC: type=Boolean
    BrakeActuatorStatus_BOD_SSM  # Indicates failure state of the brake actuators with respect to brake-on-demand functions within SSM, 0: no failure 1: failure
      data BrakeActuatorStatus_BOD_SSM: type=Boolean
    BrakeActuatorStatus_BOD_VLC  # Indicates failure state of the brake actuators with respect to brake-on-demand functions within VLC, 0: no failure 1: failure
      data BrakeActuatorStatus_BOD_VLC: type=Boolean
    BrakeAssistRequest  # Indicates that the brake system should modify its brake assist mode for hazard situations, 0: no brake assist request 1: brake assist request
      data BrakeAssistRequest: type=Boolean
    BrakeLightsIntensity  # indicates requested intensity of brake lights 0: no brake light activation 100: full intensity
      data BrakeLightsIntensity: type=BrakeLightsIntensity
    BrakeLightsOnRequest  # Request to illuminate brake lights. Condition: ESC intervention does not illuminate brake lights (e.g. active booster) 0: brake lights off 1: if brake lights are to be illuminated (driver braking or active controlled decelleration (e.g. ACC brakes slowly));
      data BrakeLightsOnRequest: type=Boolean
    BrakePedalOverride  # Information that driver overrides SW-C &quot;Comfort Acceleration Arbitration&quot; with brake pedal. (Remark: Result of brake torque arbitration), 0: no override 1: override
      data BrakePedalOverride: type=Boolean
    BrakePedalPressed  # Information that driver presses the brake pedal. (Remark: with i.e. an active booster BLS and pressure is not sufficient to provide this information) 0: not pressed 1: pressed
      data BrakePedalPressed: type=Boolean
    BrakePedalValue  # position of the brake pedal physical Lower Limit: no pedal activation physical Upper Limit: full pedal stroke
      data BrakePedalValue: type=AR_Percent
    BrakeReadyRequest  # Indicates that the brake system is to be prepared for braking (e.g. air gap elimination), 0: no brake ready request 1: brake ready request
      data BrakeReadyRequest: type=Boolean
    BrakeRequestMode  # Indicates whether the brake request is comfort or safety-related. 0 : comfort relevant 1 : safety relevant
      data BrakeRequestMode: type=Boolean
    BrakeYawTorqueRequestStatus  # Indicates whether a yaw torque is requested
      data BrakeYawTorqueRequestStatus: type=Boolean
    ByPassSlipControlRequestByRSC  # Request from RSC to inhibit internal ESC slip control. Note: to be able to brake beyond pressure corresponding to slip control. (e.g for wheel lift detection) 0=SlipControl shall be active 1=SlipControl shall be bypassed
      4 x data, all with type=Boolean:
        ByPassSlipControlRequestByRSCFL  # Front left wheel.
        ByPassSlipControlRequestByRSCFR  # Front right wheel
        ByPassSlipControlRequestByRSCRL  # Rear left wheel
        ByPassSlipControlRequestByRSCRR  # Rear right wheel
    ComfortAccelerationCommandInterface  # Cluster of DataElements regarding acceleration and jerk commands from ACC to VLC. This information is used for comfort reasons.
      6 x data:
        AccelerationRequest: type=AccelerationRequest  # Acceleration which is desired if obtainable within comfort limits.
        LowerAccelerationRequestTolerance: type=LowerAccelerationRequestTolerance  # Allowed acceleration offset below Acceleration Request. Allowable from comfort point of view.
        UpperAccelerationRequestTolerance: type=UpperAccelerationRequestTolerance  # Allowed acceleration offset above Acceleration Request. Allowable from comfort point of view.
        AccelerationRequestStatus: type=Boolean  # Information about the status of &quot;Acceleration Request&quot;. Only expresses the functional aspects, neither error handling, diagnose nor fail-safe. 0: Acceleration Request enable 1: Acceleration Request disable
        MinimumJerkRequest: type=MinimumJerkRequest  # Minimum acceleration change rate which is acceptable from function point of view. E.g. from traffic point of view if Follow Control is sender of request.
        MaximumJerkRequest: type=MaximumJerkRequest  # Maximum acceleration change rate which is acceptable from function point of view. E.g. from traffic point of view if Follow Control is sender of request.
    ComfortAccelerationFeedbackInterface  # Cluster of DataElements regarding acceleration and acceleration saturation feedbacks from VLC to ACC. This information is used for comfort reasons.
      5 x data:
        MinimumAccelerationWithoutBrakeAndShift: type=MinimumAccelerationWithoutBrakeAndShift  # Lowest acceleration (often negative, i.e. decceleration) which can be requested before Brake or Shift takes place.
        MaximumAccelerationWithoutShift: type=MaximumAccelerationWithoutShift  # Highest acceleration which can be requested before Shift takes place.
        BrakeActuatorSaturation: type=BrakeActuatorSaturation  # indicates that a brake actuator is in saturation mode bit 0=0: No Saturation bit 0=1: Saturation bit 1=0: Saturation due to actuator limitation (if saturated) bit 1=1: Saturation due to road friction limitation (if saturated)
        LowerActuatorAccelerationDeadband: type=LowerActuatorAccelerationDeadband  # Information about how much lower acceleration request relative to the internal controller value (VLC actual acceleration) have to be before reduction in acceleration can be expected. Actuator working point dependent, e.g. when brake is close to be engaged, the brake transition behaviour will be reflected. 0,255 Upper limit or change the resolution to 0,1?
        UpperActuatorAccelerationDeadband: type=UpperActuatorAccelerationDeadband  # Information about how much higher acceleration request relative to the internal controller value (VLC actual acceleration) have to be before increase in acceleration can be expected. Actuator working point dependent.
    DriverPresenceFlag  # indicates whether the driver is sitting in driver seat 0 : Driver not present 1 : Driver present
      data DriverPresenceFlag: type=Boolean
    DriverSteerTorqueBase  # Measured driver steer torque at the column (does not include the wheel inertia effect, some friction between the sensor and the steering wheel, the steering kinematics...) (includes pinion torque sensor for rack drive system and ONLY denotes the driver torque)
      data DriverSteerTorqueBase: type=DriverSteerTorqueBase
    DriverSteerTorqueStandard  # Measured driver steer torque at the column (does not include the wheel inertia effect, some friction between the sensor and the steering wheel, the steering kinematics...) (includes pinion torque sensor for rack drive system and ONLY denotes the driver torque) Conditioned Signal (Filtering, Offset-Compensation, Model-based Plausibility Check, etc.)
      data DriverSteerTorqueStandard: type=DriverSteerTorqueStandard
    DriveTrainOpen  # indicates whether the drive train is open due to driver input. Transitional states between fully open and fully closed drivetrain shall be indicated as open in this signal. AT: Lever in N or in P MT: Estimation based on clutch pedal pressed and optional neutral gear recognition. 0 : Drivetrain fully closed 1 : Drivetrain fully open or between fully open and fully closed)
      data DriveTrainOpen: type=Boolean
    EngineSpeedGradient  # Engine speed gradient
      data EngineSpeedGradient: type=EngineSpeedGradient
    EPBActuatorMode  # Indicates the action executed by the parking brake actuator or its state.
      data EPBActuatorMode: type=EPBActuatorMode
    EPBActuatorStatus  # Indicates the state of the parking brake actuators
      data EPBActuatorStatus: type=EPBActuatorStatus
    EPBActuatorTorque  # Brake torque applied by EPB actuator. Based on nominal brake parameters (e.g. constant pads friction) and (estimated or measured) brake clamp forces.
      data EPBActuatorTorque: type=EPBActuatorTorque
    EPBControlButtonState  # Indicates the state of EPB control button. Note: depending on implementation of HMI. Case 1: push only type will use values 0,3,4 Case 2: push/pull type will use values 0,1,2,4 More info can be added in the reserved bits, e.g. qualifiers or states for fail degraded operation, see also generic qualifier concept
      data EPBControlButtonState: type=EPBControlButtonState
    ErrorStatusSteeringBSTS  # steering status visualisation BSTS error lamp (red), warning lamp (yellow) and/ or acoustic signal.
      data ErrorStatusSteering: type=ErrorStatusSteeringBSTS
    ErrorStatusSteeringBSAS  # steering status visualisation BSAS error lamp (red), warning lamp (yellow) and/ or acoustic signal.
      data ErrorStatusSteering: type=ErrorStatusSteeringBSAS
    ErrorStatusSteeringBRWS  # steering status visualisation BRWS error lamp (red), warning lamp (yellow) and/ or acoustic signal.
      data ErrorStatusSteering: type=ErrorStatusSteeringBRWS
    EstimatedDamperForces  # Estimation of the actual damper forces provided by the damper system. Vector of 4 scalars in the order front left, front right, rear left, rear right. Refer to ISO 8855.
      4 x data, all with type=EstimatedDamperForces:
        EstimatedDamperForceFL  # Front left wheel
        EstimatedDamperForceFR  # Front right wheel
        EstimatedDamperForceRL  # Rear left wheel
        EstimatedDamperForceRR  # Rear right wheel
    EstimatedDriverRoadWheelAngleFrontWish  # EstimatedDriverRoadWheelAngleFrontWish = driver angle wish + VGR + DAS function angle
      data EstimatedDriverRoadWheelAngleFrontWish: type=EstimatedDriverRoadWheelAngleFrontWish
    EstimatedDriverRoadWheelAngleFrontSpeedWish  # EstimatedDriverRoadWheelAngleFrontSpeedWish = driver angle speed wish + VGR speed + DAS function angle speed
      data EstimatedDriverRoadWheelAngleFrontSpeedWish: type=EstimatedDriverRoadWheelAngleFrontSpeedWish
    EstimatedRideHeightLevelFront  # The actual estimated ride height at the front axle.
      data EstimatedRideHeightLevelFront: type=EstimatedRideHeightLevelFront
    EstimatedRideHeightLevelRear  # The actual estimated ride height at the rear axle.
      data EstimatedRideHeightLevelRear: type=EstimatedRideHeightLevelRear
    EstimatedSpringForces  # Estimation of the actual spring forces provided by the spring system. Vector of 4 scalars in the order front left, front right, rear left, rear right. Refer to ISO 8855.
      4 x data, all with type=EstimatedSpringForces:
        EstimatedSpringForceFL  # Front left wheel
        EstimatedSpringForceFR  # Front right wheel
        EstimatedSpringForceRL  # Rear left wheel
        EstimatedSpringForceRR  # Rear right wheel
    EstimatedVehicleBodyVerticalAccel  # Vector of estimated vehicle vertical body accelerations. Vector of 4 scalars in the order front left, front right, rear left, rear right. Refer to ISO 8855. Location could differ dependening on the number of sensors (2,3,4).
      4 x data, all with type=EstimatedVehicleBodyVerticalAccel:
        EstimatedVehicleBodyVerticalAccelFL  # Front left wheel
        EstimatedVehicleBodyVerticalAccelFR  # Front right wheel
        EstimatedVehicleBodyVerticalAccelRL  # Rear left wheel
        EstimatedVehicleBodyVerticalAccelRR  # Rear right wheel
    EstimatedVehicleMass  # Estimation of the vehicle mass provided by the suspension systems.
      data EstimatedVehicleMass: type=EstimatedVehicleMass
    EstimatedVehicleMassFromVLC  # Estimation of the vehicle mass provided by the VLC based on the longitudinal dynamics of the vehicle.
      data EstimatedVehicleMassFromVLC: type=EstimatedVehicleMassFromVLC
    EstimatedVerticalWheelForces  # Estimation of the actual vehicle wheel forces provided by the suspension systems. Vector of 4 scalars in the order front left, front right, rear left, rear right. Refer to ISO 8855.
      4 x data, all with type=EstimatedVerticalWheelForces:
        EstimatedVerticalWheelForceFL  # Front left wheel
        EstimatedVerticalWheelForceFR  # Front right wheel
        EstimatedVerticalWheelForceRL  # Rear left wheel
        EstimatedVerticalWheelForceRR  # Rear right wheel
    EstimatedWheelLoadDifferenceFront  # Estimated wheel load difference on the front axle defined as the total front axle load applied the left wheel (100%: Total axle load on left wheel, 0%: Total axle load on right wheel)
      data EstimatedWheelLoadDifferenceFront: type=EstimatedWheelLoadDifferenceFront
    EstimatedWheelLoadDifferenceRear  # Estimated wheel load difference on the rear axle defined as the total rear axle load applied the left wheel (100%: Total axle load on left wheel, 0%: Total axle load on right wheel)
      data EstimatedWheelLoadDifferenceRear: type=EstimatedWheelLoadDifferenceRear
    EstimatedWheelVerticalAcceleration  # Vector of estimated vehicle vertical wheel acceleration. Vector of 4 scalars in the order front left, front right, rear left, rear right. Refer to ISO 8855
      4 x data, all with type=EstimatedWheelVerticalAcceleration:
        EstimatedWheelVerticalAccelerationFL  # Front left wheel
        EstimatedWheelVerticalAccelerationFR  # Front right wheel
        EstimatedWheelVerticalAccelerationRL  # Rear left wheel
        EstimatedWheelVerticalAccelerationRR  # Rear right wheel
    ExtYawActuatorStatus  # Indicates capability of the ext. yaw rate controller using additional actuators (steering, suspension, ...)
      data ExtYawActuatorStatus: type=ExtYawActuatorStatus
    FullActiveSuspensionControlTuning  # Full active suspension tuning mode displayed to the driver and provided to other systems
      data FullActiveSuspensionControlTuning: type=ActualSuspensionControlTuning
    FullActiveSuspensionStatus  # Status provided by full active suspension system.
      data FullActiveSuspensionStatus: type=FullActiveSuspensionStatus
    HoldOnDemand_state  # Indicates a failure state of the HOD function
      data HoldOnDemand_State: type=HoldOnDemand_state
    GearshiftPreventionComfortbyVLC  # Avoid change of gear for comfort reasons: request to avoid shifting request includes aspects from traffic point of view. Final decision remains in the actuator control. Acceleration request tolerance band has higher priority than the Inhibit Flag.
      data GearshiftPreventionComfortbyVLC: type=GearShiftPrevention
    IntendedVehicleBrakeTorque  # Sum of 4 wheel intended brake torques. Result of arbitration between driver and e.g. ACC
      data IntendedVehicleBrakeTorque: type=IntendedVehicleBrakeTorque
    LatAccBase  # Lateral acceleration measured at sensor position; compensated for orientation. Coordinate system according to ISO 8855
      data LatAccBase: type=LatAccBase
    LatAccRollCompStandardByESC  # Lateral acceleration estimated for vehicle COG (ISO 10392) provided by ESC. Coordinate system according to ISO 8855. Compensated for roll movement of the vehicle body. Compensated for long term drift.
      data LatAccRollCompStandardByESC: type=LatAccRollCompStandard
    LatAccStandardByESC  # Lateral acceleration based on accelerometer provided by ESC. Compensated for long term drift. Coordinate system according to ISO 8855. Remark: Transformation into COG not relevant for known receivers.
      data LatAccStandardByESC: type=LatAccStandard
    EstimatedLateralSpeedByESC  # Lateral speed component at COG Measured in vehicle coordinates.
      data EstimatedLateralSpeedByESC: type=EstimatedLateralSpeed
    LongAccBase  # Longitudinal acceleration measured at sensor position; compensated for orientation. Coordinate system according to ISO 8855
      data LongAccBase: type=LongAccBase
    LongAccFromWheelSpeedsStandard  # Longitudinal acceleration based on wheel speeds. Coordinate system according to ISO 8855. Remark: Degraded during slip control Invalid in case of failure of slip control functions.
      data LongAccFromWheelSpeedsStandard: type=LongAccFromWheelSpeedsStandard
    LongAccPitchCompStandard  # Longitudinal acceleration based on accelerometer. Coordinate system according to ISO 8855. Compensated for pitch movement of the vehicle body. Compensated for long term drift. Remark: Transformation into COG not relevant for known receivers.
      data LongAccPitchCompStandard: type=LongAccPitchCompStandard
    LongAccStandard  # Longitudinal acceleration based on accelerometer. Compensated for long term drift. Coordinate system according to ISO 8855. Remark: Transformation into COG not relevant for known receivers.
      data LongAccStandard: type=LongAccStandard
    LowerBrakeActuatorDeadband  # Minimum decrease of the requested brake torque (relative to the current actual value) which will lead to a change in the current torque
      data LowerBrakeActuatorDeadband: type=LowerBrakeActuatorDeadband
    MaxVehicleSpeedBrakeActuator  # Maximum vehicle speed requested by chassis for safety vehicle speed limitation. Arbitrated with a minimum function in PT domain, together with similar requests from other domains. Limit vehicle speed on case of brake system deterioration
      data MaxVehicleSpeedBrakeActuator: type=MaxVehicleSpeedBrakeActuator
    MeasuredRideHeightLevelFrontBase
      data MeasuredRideHeightLevelFrontBase: type=MeasuredRideHeightLevelFrontBase
    MeasuredRideHeightLevelFrontStandard
      data MeasuredRideHeightLevelFrontStandard: type=MeasuredRideHeightLevelFrontStandard
    MeasuredRideHeightLevelRearBase  # The actual measured ride height at the front axle.
      data MeasuredRideHeightLevelRearBase: type=MeasuredRideHeightLevelRearBase
    MeasuredRideHeightLevelRearStandard  # The actual measured ride height at the front axle. (Filtered and offset compensated)
      data MeasuredRideHeightLevelRearStandard: type=MeasuredRideHeightLevelRearStandard
    MeasuredVehicleBodyVerticalAccelBase  # Vector of measured vehicle vertical body accelerations. Vector of 4 scalars in the order front left, front right, rear left, rear right. Refer to ISO 8855. Location could differ dependening on the number of sensors (2,3,4).
      4 x data, all with type=MeasuredVehicleBodyVerticalAccelBase:
        MeasuredVehicleBodyVerticalAccelFL  # Front left wheel
        MeasuredVehicleBodyVerticalAccelFR  # Front right wheel
        MeasuredVehicleBodyVerticalAccelRL  # Rear left wheel
        MeasuredVehicleBodyVerticalAccelRR  # Rear right wheel
    MeasuredVehicleBodyVerticalAccelStandard  # Vector of measured vehicle vertical body accelerations. Vector of 4 scalars in the order front left, front right, rear left, rear right. Refer to ISO 8855. Location could differ dependening on the number of sensors (2,3,4). (Filtered and offset compensated)
      4 x data, all with type=MeasuredVehicleBodyVerticalAccelStandard:
        MeasuredVehicleBodyVerticalAccelFL  # Front left wheel
        MeasuredVehicleBodyVerticalAccelFR  # Front right wheel
        MeasuredVehicleBodyVerticalAccelRL  # Rear left wheel
        MeasuredVehicleBodyVerticalAccelRR  # Rear right wheel
    Mileage  # Travelled total distance (in km) of the vehicle.
      data Mileage: type=Mileage
    OverRideABSControlbyRSC  # Flag indicating RSC brake torque overrides ABS. This enables RSC to request more braking torque than ABS. For wheel lift detection. (Vector of 4) 0 = RSC not over ride ABS 1 = RSC over ride ABS
      4 x data, all with type=Boolean:
        OverRideABSControlbyRSCFL  # Front left wheel
        OverRideABSControlbyRSCFR  # Front right wheel
        OverRideABSControlbyRSCRL  # Rear left wheel
        OverRideABSControlbyRSCRR  # Rear right wheel
    OverRideTractionControlByRSC  # Flag indicating RSC brake torque overrides TC. This enables RSC to request more torque than TC. (Vector of 4) 0 = RSC not over ride TC 1 = RSC over ride TC
      4 x data, all with type=Boolean:
        OverRideTractionControlByRSCFL  # Front left wheel
        OverRideTractionControlByRSCFR  # Front right wheel
        OverRideTractionControlByRSCRL  # Rear left wheel
        OverRideTractionControlByRSCRR  # Rear right wheel
    OverRideYawControlByRSC  # Flag indicating RSC brake torque overrides yaw control. This enables RSC to win over AYC also if RSC requests less braking. To avoid conflict between ESC UnderSteer ctrl and RSC. (Vector of 4) 0 = RSC not over ride yaw control brake torque 1 = RSC over ride yaw control.
      4 x data, all with type=Boolean:
        OverRideYawControlByRSCFL  # Front left wheel
        OverRideYawControlByRSCFR  # Front right wheel
        OverRideYawControlByRSCRL  # Rear left wheel
        OverRideYawControlByRSCRR  # Rear right wheel
    ParkingBrakeActive  # Information that Parking Brake (conventional or electrical) is activated 0: not active 1: active
      data ParkingBrakeActive: type=Boolean
    PGearRequest  # Parking brake request to AT to set parking posotion (P drive) 0 : No request 1 : Request active
      data PGearRequest: type=Boolean
    PinionSteerAngleFrontBase  # measured pinion steer angle at the front steering device
      data PinionSteerAngleFrontBase: type=PinionSteerAngleFrontBase
    PinionSteerAngleFrontSpeedStandard  # Calculated pinion steer angle speed at the front steering device. Conditioned Signal (Filtering, Offset-Compensation, Model-based Plausibility Check, etc.)
      data PinionSteerAngleFrontSpeedStandard: type=PinionSteerAngleFrontSpeedStandard
    PinionSteerAngleFrontStandard  # Calculated pinion steer angle speed at the front steering device. Conditioned Signal (Filtering, Offset-Compensation, Model-based Plausibility Check, etc.)
      data PinionSteerAngleFrontStandard: type=PinionSteerAngleFrontStandard
    PinionSteerAngleRearBase  # Pinon angle at rear wheels (measured) if the rear wheel steering system is rack and pinion based
      data PinionSteerAngleRearBase: type=PinionSteerAngleRearBase
    PinionSteerAngleRearSpeedStandard  # Pinon speed at rear wheels (measured) if the rear wheel steering system is rack and pinion based. Conditioned Signal (Filtering, Offset-Compensation, Model-based Plausibility Check, etc.)
      data PinionSteerAngleRearSpeedStandard: type=PinionSteerAngleRearSpeedStandard
    PinionSteerAngleRearStandard  # Pinon angle at rear wheels (measured) if the rear wheel steering system is rack and pinion based. Conditioned Signal (Filtering, Offset-Compensation, Model-based Plausibility Check, etc.)
      data PinionSteerAngleRearStandard: type=PinionSteerAngleRearStandard
    PitchRateBase  # Pitch rate measured along vehicle y- axis (i.e. compensated for orientation). Coordinate system according to ISO 8855
      data PitchRateBase: type=PitchRateBase
    PitchRateStandard  # Pitch rate calulated along vehicle y-axis. Coordinate system according to ISO 8855 Filtered and offset-compensated
      data PitchRateStandard: type=PitchRateStandard
    PulseGeneratorMode  # Switch that enables / disables the pulse generator (for haptic driver feedback / vibration) which residues within the low level actuator SW Component. Mode definition has to be decided on project level (e.g.: set of amplitude, direction,etc.)
      data PulseGeneratorMode: type=PulseGeneratorMode
    RelativeEstimatedBodyPitchAngle  # Estimation of the relative pitch angle of the vehicle body.
      data RelativeEstimatedBodyPitchAngle: type=RelativeEstimatedBodyPitchAngle
    RelativeEstimatedBodyRollAngle  # Estimation of the relative roll angle of the vehicle body.
      data RelativeEstimatedBodyRollAngle: type=RelativeEstimatedBodyRollAngle
    RequestedMaxWheelBrakeSlipByRSC  # Requested maximum whell brake slip from RSC to ESC for individual wheels. ABS is expected to limit the wheel slips to these maximum values.
      4 x data, all with type=RequestedMaxWheelBrakeSlipByRSC:
        RequestedMaxWheelBrakeSlipByRSCFL  # Front left wheel
        RequestedMaxWheelBrakeSlipByRSCFR  # Front right wheel
        RequestedMaxWheelBrakeSlipByRSCRL  # Rear left wheel
        RequestedMaxWheelBrakeSlipByRSCRR  # Rear right wheel
    RequestedAbsoluteDriverTorqueFrontDAS  # Requested absolute driver steering torque by Driver Assistance Steering (does not include the wheel inertia effect, some friction between the sensor and the steering wheel, the steering kinematics...)
      data RequestedAbsoluteDriverTorqueFront: type=RequestedAbsoluteDriverTorqueFront
    RequestedAbsoluteDriverTorqueFrontSTABILITY  # Requested absolute driver steering torque by Vehicle Stability Steering (does not include the wheel inertia effect, some friction between the sensor and the steering wheel, the steering kinematics...)
      data RequestedAbsoluteDriverTorqueFront: type=RequestedAbsoluteDriverTorqueFront
    RequestedAbsoluteRoadWheelAngleFrontDAS  # Requested road wheel angle for front steering actuator by Driver Assistance Steering
      data RequestedAbsoluteRoadWheelAngleFront: type=RequestedAbsoluteRoadWheelAngleFront
    RequestedAbsoluteRoadWheelAngleFrontSTABILITY  # Requested road wheel angle for front steering actuator by Vehicle Stability Steering
      data RequestedAbsoluteRoadWheelAngleFront: type=RequestedAbsoluteRoadWheelAngleFront
    RequestedAbsoluteRoadWheelAngleRearDAS  # Requested absolute road wheel angle for rear wheel steering actuator. by Driver Assistance Steering
      data RequestedAbsoluteRoadWheelAngleRear: type=RequestedAbsoluteRoadWheelAngleRear
    RequestedAbsoluteRoadWheelAngleRearSTABILITY  # Requested absolute road wheel angle for rear wheel steering actuator. by Vehicle Stability Steering
      data RequestedAbsoluteRoadWheelAngleRear: type=RequestedAbsoluteRoadWheelAngleRear
    RequestedAddSteerAngleFront  # Requested steer angle for front steering actuator using variable steering ratio (comfort function, steering assistance) Multiple Data Elements angle related to steering wheel
      data RequestedAddSteerAngleFront: type=RequestedAddSteerAngleFront
    RequestedBrakeTorquesByYawCtrl  # The output requests from YawCtrl outputted for information. Needed for hand-over ESC to RSC and back. Also to enable RSC to &quot;emulate a max arbitration&quot;. Absolute request.
      4 x data, all with type=RequestedBrakeTorquesByYawCtrl:
        RequestedBrakeTorquesByYawCtrlFL  # Front left wheels
        RequestedBrakeTorquesByYawCtrlFR  # at wheels front right
        RequestedBrakeTorquesByYawCtrlRL  # at wheels rear left
        RequestedBrakeTorquesByYawCtrlRR  # at wheels rear right
    RequestedDeltaDriverTorqueFrontDAS  # DAS requested delta driver steering torque (does not include the wheel inertia effect, some friction between the sensor and the steering wheel, the steering kinematics...) Multiple Data Elements (meaning : request can come from different High Level Functions) Ddriver steering torque measured at the steering column.
      data RequestedDeltaDriverTorqueFront: type=RequestedDeltaDriverTorqueFront
    RequestedDeltaDriverTorqueFrontSTABILITY  # STABILITY requested delta driver steering torque (does not include the wheel inertia effect, some friction between the sensor and the steering wheel, the steering kinematics...) Multiple Data Elements (meaning : request can come from different High Level Functions) Driver steering torque measured at the steering column.
      data RequestedDeltaDriverTorqueFront: type=RequestedDeltaDriverTorqueFront
    RequestedDeltaRoadWheelAngleFrontDAS  # DAS requested additional (road wheel) steer angle interventions via front steering actuator (= delta steer angle at steered wheels, at angle superposition steering systems: middle front axle delta steering angle). Angle related to average front wheel angle.
      data RequestedDeltaRoadWheelAngleFront: type=RequestedDeltaRoadWheelAngleFront
    RequestedDeltaRoadWheelAngleFrontSTABILITY  # STABILITY requested additional (road wheel) steer angle interventions via front steering actuator (= delta steer angle at steered wheels, at angle superposition steering systems: middle front axle delta steering angle). Angle related to average front wheel angle.
      data RequestedDeltaRoadWheelAngleFront: type=RequestedDeltaRoadWheelAngleFront
    RequestedDeltaRoadWheelAngleRearDAS  # DAS requested additional road wheel steer angle interventions via rear steering actuator (= delta steer angle at steered wheels Actual not mediated.
      data RequestedDeltaRoadWheelAngleRear: type=RequestedDeltaRoadWheelAngleRear
    RequestedDeltaRoadWheelAngleRearSTABILITY  # STABILITY requested additional road wheel steer angle interventions via rear steering actuator (= delta steer angle at steered wheels Actual not mediated.
      data RequestedDeltaRoadWheelAngleRear: type=RequestedDeltaRoadWheelAngleRear
    RequestedExtYawTorque  # Component of the total yaw torque to be realized by ext yaw rate controller using additional actuators (steering, suspenssion, ...)
      data RequestedExtYawTorque: type=RequestedExtYawTorque
    RequestedVehicleBrakeTorque  # Requested longitudinal vehicle brake torque based on nominal brake parameters and (estimated) brake pressures (clamp forces).
      data RequestedVehicleBrakeTorque: type=RequestedVehicleBrakeTorque
    RequestedWheelBrakeTorquebyRSC  # Requested Brake Torques (vector of 4) to be acting on the wheels. Based on nominal brake parameters and (estimated) brake pressures (clamp forces). Absolute requested.
      4 x data, all with type=RequestedWheelBrakeTorquebyRSC:
        RequestedWheelBrakeTorquebyRSCFL  # Front left wheel
        RequestedWheelBrakeTorquebyRSCFR  # Front right wheel
        RequestedWheelBrakeTorquebyRSCRL  # Rear left wheel
        RequestedWheelBrakeTorquebyRSCRR  # Rear right wheel
    RoadBankAccelEstimationByESC  # Acceleration component resulting from a banked road provided by ESC. Rotation about x-axis, angle betweeen z-y-axis. Coordinate system according to ISO 8855. Note that this signal will not be reliable and probably must be replaced by function specific signals, e.g. to prevent wrong interventions
      data RoadBankAccelEstimationByESC: type=RoadBankAccelEstimation
    RoadInclinationAccelEstimation  # Acceleration component resulting from road inclination. Measured in vehicle coordinates! Calculated from LongAcc from wheel speeds and acceleration sensor. Resolution corresponds to 0,25% slope
      data RoadInclinationAccelEstimation: type=RoadInclinationAccelEstimation
    RollMomentDistribution  # Estimated stabilizer roll moment difference front to rear defined relative to the total stabilizer moment (front and rear) (100%: Only stabilizer moment on front, 0%: Only stabilizer moment on rear)
      data RollMomentDistribution: type=RollMomentDistribution
    RollRateBase  # Roll Rate from sensor element. Coordinate system according to ISO 8855.
      data RollRateBase: type=RollRateBase
    RollRateExtdRangeBase  # Roll Rate from sensor element. Coordinate system according to ISO 8855. Extended signal range
      data RollRateExtdRangeBase: type=RollRateExtdRangeBase
    RollRateStandard  # Roll Rate from sensor element. Coordinate system according to ISO 8855. Compensated for long-term drift
      data RollRateStandard: type=RollRateStandard
    RscControlDisable  # RSC Control Disabled due to detected fault or ECU initialization 0= RSC enabled 1 = RSC Control Disabled due to detected fault
      data RscControlDisable: type=Boolean
    RscInControl  # Confimration of that RSC is in control. Information of &quot;ability type&quot;. (Vector of 4) 0=RSC not in control 1= RSC in control
      4 x data, all with type=Boolean:
        RscInControlFL  # Front left wheel
        RscInControlFR  # Front right wheel
        RscInControlRL  # Rear left wheel
        RscInControlRR  # Rear right wheel
    GearShiftPreventionStability  # avoid change of gear for stability reasons.
      data GearShiftPreventionStability: type=GearShiftPrevention
    ShiftInProgress  # Indicates that a gear shift is in progress, i.e. transient torque transfer
      data ShiftInProgress: type=Boolean
    SpringTravel  # Vector of 4 spring travel continuous values at individual wheels (one for each corner)
      4 x data, all with type=SpringTravel:
        SpringTravelFL  # Front left wheel
        SpringTravelFR  # Front right wheel
        SpringTravelRL  # Rear left wheel
        SpringTravelRR  # Rear right wheel
    SSM2EPBRequestedVehicleBrakeTorque  # Requested total vehicle brake torque from SSM to EPB. Based on nominal brake parameters (e.g. constant pads friction) and (estimated or measured) brake clamp forces.
      data SSM2EPBRequestedVehicleBrakeTorque: type=SSM2EPBRequestedVehicleBrakeTorque
    SSM2EPBRequestedVehicleBrakeTorqueGradient  # Time Derivative of the requested total vehicle brake torque from SSM to EPB. Based on nominal brake parameters (e.g. constant pads friction) and (estimated or measured) brake clamp forces.
      data SSM2EPBRequestedVehicleBrakeTorqueGradient: type=SSM2EPBRequestedVehicleBrakeTorqueGradient
    SSM2EPBRequestStatus  # Indicates a failure state of the SSM requests to EPB brake system
      data SSM2EPBRequestStatus: type=SSM2EPBRequestStatus
    SSM2EPBRequestType  # Indicates whether a vehicle decelleration force is requested.
      data SSM2EPBRequestType: type=SSM2EPBRequestType
    SSM2ESCRequestedVehicleBrakeTorque  # Requested longitudinal vehicle force Based on nominal brake parameters and (estimated) brake pressures (clamp forces).
      data SSM2ESCRequestedVehicleBrakeTorque: type=SSM2ESCRequestedVehicleBrakeTorque
    SSM2ESCRequestedVehicleBrakeTorqueGradient  # Time Derivative of the requested total vehicle brake torque from SSM to ESC. Based on nominal brake parameters (e.g. constant pads friction) and (estimated or measured) brake clamp forces.
      data SSM2ESCRequestedVehicleBrakeTorqueGradient: type=SSM2ESCRequestedVehicleBrakeTorqueGradient
    SSM2ESCRequestStatus  # Indicates a failure state of the SSM requests to ESC brake system
      data SSM2ESCRequestStatus: type=SSM2ESCRequestStatus
    SSM2ESCVehicleBrakeTorqueRequestType  # Indicates whether a vehicle deceleration force is requested. More modes can be required here NOTE ON SELF-UNLOCKING PROPERTIES OF SERVICE BRAKE: since the wheel brakes are designed to be self-unlocking
      data SSM2ESCVehicleBrakeTorqueRequestType: type=SSM2ESCVehicleBrakeTorqueRequestType
    StatusESC  # Information on activation/ deactivation of ESC
      data StatusESC: type=StatusESC
    SteeringWheelAngleBase  # Measured steer angle at steering postioned between the steering wheel and the BSAS system if it is there. Driving intention of driver. (Does not include steering kinematic effects).
      data SteeringWheelAngleBase: type=SteeringWheelAngle
    SteeringWheelAngleSpeedStandard  # Conditioned steer angle speed at steering postioned between the steering wheel and the BSAS system if it is there. Driving intention of driver. (Does not include steering kinematic effects, offset-compensated, filtered). Derived from measured steering wheel angular position)
      data SteeringWheelAngleSpeedStandard: type=SteeringWheelAngleSpeed
    SteeringWheelAngleStandard  # Conditioned steer angle at steering postioned between the steering wheel and the BSAS system if it is there. Driving intention of driver. (Does not include steering kinematic effects, offset-compensated, filtered). Derived from measured steering wheel angular position)
      data SteeringWheelAngleStandard: type=SteeringWheelAngle
    SuspensionYawStabilityControlActive  # Indicates an active intervention from yaw stability control performed by the suspension SWC
      data SuspensionYawStabilityControlActive: type=Boolean
    SwitchableSpringStatus  # Status provided by switchable spring.
      data SwitchableSpringStatus: type=SwitchableSpringStatus
    TractionControlActive  # Traction control is active 0 = Traction control is not active 1 = At least one wheel is in TCS control
      data TractionControlActive: type=Boolean
    TractionControlBrakeActive  # At least one wheel is in TCS brake control 0 = TCS is off or TCS does not use the brakes 1 = At least one wheel is in TCS brake control
      data TractionControlBrakeActive: type=Boolean
    TractionControlBrakeActiveWheel  # Wheel is in TCS brake control. (Vector of 4) 1 = Wheel is in TCS brake control
      4 x data, all with type=Boolean:
        TractionControlBrakeActiveWheelFL  # Front left wheel
        TractionControlBrakeActiveWheelFR  # Front right wheel
        TractionControlBrakeActiveWheelRL  # Rear left wheel
        TractionControlBrakeActiveWheelRR  # Rear right wheel
    TractionControlEngineActive  # Traction control is active by requesting a torque reduction at wheel to powertrain
      data TractionControlEngineActive: type=Boolean
    UpperBrakeActuatorDeadband  # Minimum increase of the requested torque (relative to the current actual value) which will lead to a change in the current torque
      data UpperBrakeActuatorDeadband: type=UpperBrakeActuatorDeadband
    VehicleLongitudinalSpeed  # Based on wheel speeds. Possibly extended by acceleration sensor. Coordinate system according to ISO 8855. Refers to COG Remark: Behaviour t.b.d. during slip control or failure of slip control functions.
      data VehicleLongitudinalSpeed: type=VehicleLongitudinalSpeed
    VehicleMotionState  # Information about if vehicle is moving forward or backward or if it is in stand-still
      data VehicleMotionState: type=VehicleMotionState
    VLC2SSMRequestStatus  # Indicates a failure state of VLC requests 00: valid commads to SSM 01: invalid commads to SSM
      data VLC2SSMRequestStatus: type=Boolean
    VLC2SSMVehicleHoldRequest  # Indicates whether a vehicle hold is requested 0 : No hold request 1 : Hold request
      data VLC2SSMVehicleHoldRequest: type=Boolean
    WheelAngularAccelerationStandard  # Angular acceleration of the four individual wheels.
      4 x data, all with type=WheelAngularAccelerationStandard:
        WheelAngularAccelerationStandardFL  # Front left
        WheelAngularAccelerationStandardFR  # Front right
        WheelAngularAccelerationStandardRL  # rear left
        WheelAngularAccelerationStandardRR  # rear right
    WheelAngularVelocityStandard  # Angular velocity of individual wheels in the order front left, front right, rear left, rear right.
      4 x data, all with type=WheelAngularVelocityStandard:
        WheelAngularVelocityStandardFL  # Front left
        WheelAngularVelocityStandardFR  # Front right
        WheelAngularVelocityStandardRL  # rear left
        WheelAngularVelocityStandardRR  # rear right
    WheelBrakeOverheated  # One flag indicating that at least one wheel brake (caliper, disc, pad) temperature is high 0: normal brake temperature 1: brake overheated
      data WheelBrakeOverheated: type=Boolean
    WheelBrakeTorque  # Vector of 4 brake torque acting on the wheel in the order front left, front right, rear left, rear right. Based on nominal brake parameters (e.g. constant pads friction) and (estimated) brake pressures (clamp forces). Not included: parking brake torque.
      4 x data, all with type=WheelBrakeTorque:
        WheelBrakeTorqueFL  # Front left
        WheelBrakeTorqueFR  # Front right
        WheelBrakeTorqueRL  # rear left
        WheelBrakeTorqueRR  # rear right
    WheelBrakeTorqueRequestStatusbyRSC  # Indicates whether wheel brake torques are requested. (Vector of 4) 0 = Don't actuate RSC requested Torque 1 = Actuate RSC requested Torque
      4 x data, all with type=Boolean:
        WheelBrakeTorqueRequestStatusbyRSCFL  # Front left wheel
        WheelBrakeTorqueRequestStatusbyRSCFR  # Front right wheel
        WheelBrakeTorqueRequestStatusbyRSCRL  # Rear left wheel
        WheelBrakeTorqueRequestStatusbyRSCRR  # Rear right wheel
    WheelCircumSpeedsStandard  # Vector of 4 scalars in the order front left, front right, rear left, rear right. These scalars are the product of the individual angular velocities with the nominal (or static) rolling radius. The nominal (or static) rolling radius is representative of each vehicle, and is a value such that the WheelCircumSpeedStandard is very close to the vehicle longitudinal speed of the vehicle. If signal is not provided (optional) the radius must be available as a parameter
      4 x data, all with type=WheelCircumSpeedsStandard:
        WheelCircumSpeedsStandardFL  # Front left wheel
        WheelCircumSpeedsStandardFR
        WheelCircumSpeedsStandardRL  # Rear left wheel
        WheelCircumSpeedsStandardRR  # Rear right wheel
    WheelRadiusToleranceCoefficient  # Vector of 4 estimated scalars assigned to the individual wheels in the order front left, front right, rear left, rear right. The product of each scalar with the corresponding WheelCircumSpeedsStandard data element allows to get a better estimation of the linear velocity of the contact patch of the wheel over ground . These scalars do not compensate for the possible wheel slip
      4 x data, all with type=WheelRadiusToleranceCoefficient:
        WheelRadiusToleranceCoefficientFL  # Front left wheel
        WheelRadiusToleranceCoefficientFR  # Front right wheel
        WheelRadiusToleranceCoefficientRL  # Rear left wheel
        WheelRadiusToleranceCoefficientRR  # Rear right wheel
    WheelRotationalDirectionStandard  # Vector of 4 scalars assigned to the individual wheels in the order front left, front right, rear left, rear right. Each scalar indicates if the wheel is moving ahead or in reverse
      4 x data:
        WheelRotationalDirectionStandardFL: type=WheelRotationalDirectionStandard  # Front left wheel
        WheelRotationalDirectionStandardFR: type=Boolean  # Front right wheel
        WheelRotationalDirectionStandardRL: type=Boolean  # Rear left wheel
        WheelRotationalDirectionStandardRR: type=Boolean  # Rear right wheel
    WheelTravelledDistanceStandard  # Distance travelled by every wheel at circumference, determined on the base of wheel rotation and standard rolling radius; not compensated for wheel slip
      data WheelTravelledDistanceStandard: type=WheelTravelledDistanceStandard
    WheelVerticalAccelerationBase  # Vector of 4 measured vertical wheel accelerations in the order front left, front right, rear left, rear right.
      data WheelVerticalAccelerationBase: type=WheelVerticalAccelerationBase
    WheelVerticalAccelerationStandard  # Vector of 4 calculated vertical wheel accelerations in the order front left, front right, rear left, rear right. Refer to ISO 8855.
      data WheelVerticalAccelerationStandard: type=WheelVerticalAccelerationStandard
    YawControlBrakeActiveWheel  # Wheel is in yaw stability brake control 0 = No brake intervention from yaw control 1 = Wheel is in yaw stability brake control
      4 x data, all with type=Boolean:
        YawControlBrakeActiveWheelFL  # Front left wheel
        YawControlBrakeActiveWheelFR  # Front right wheel
        YawControlBrakeActiveWheelRL  # Rear left wheel
        YawControlBrakeActiveWheelRR  # Rear right wheel
    YawRateBase  # Yaw rate measured along vehicle z- axis (i.e. compensated for orientation). Coordinate system according to ISO 8855
      data YawRateBase: type=YawRateBase
    YawRateGradientStandardByESC  # Time-derivative of YawRateStandard provided by ESC
      data YawRateGradientStandardByESC: type=YawRateGradientStandard
    YawRateOffsetStandardByESC  # Yaw rate offset calulated (dynamic value) along vehicle z-axis and provided by ESC. Coordinate system according to ISO 8855
      data YawRateOffsetStandardByESC: type=YawRateOffsetStandard
    YawRateReferenceValueByESC  # Target yaw rate of the Yaw Stability Control feature provided by ESC
      data YawRateReferenceValueByESC: type=YawRateReferenceValue
    YawRateStandardByESC  # Yaw rate calulated along vehicle z-axis provided by ESC. Coordinate system according to ISO 8855 Filtered and offset-compensated
      data YawRateStandardByESC: type=YawRateStandard
    YawStabilityControlActive  # Indicates whether the yaw stability control is active or not 0=Yaw stability control not active 1=Yaw stability control active
      data YawStabilityControlActive: type=Boolean
    YawStabilityInformationByESC  # Yaw stability information provided by ESC: Negative shows understeer. Positive shows oversteer. 0 is designed vehicle stable state. +/-100 is start of Yaw Control intervention.
      data YawStabilityInformationByESC: type=YawStabilityInformation
    BrakePreventionComfortbyVLC  # Request to avoid braking. Request includes aspects from traffic point of view. Final decision remains in the actuator control. Acceleration Request Tolerance Band has higher priority than the Inhibit Flag. 0: No request 1: Inhibit brake
      data BrakePrevention: type=Boolean
    VehicleBrakeTorqueRequestStatus  # Indicates wether the VLC wants ESC to apply a desired vehicle global brake torque or not
      data VehicleBrakeTorqueRequestStatus: type=Boolean
    ReqNightPanel  # This interface provides the information about the &quot;Night-Panel-Switch&quot; (e.g. switch for dimming down all interior lights except for speedometer)
      data request: type=t_onoff
    ReqAutoAdjust  # Request to move the seat automatically to a stored position or to store the actual position to the memory-position &quot;profile&quot;.
      data request: type=t_AutoAdjust
    ReqEntry  # Request to move the seat to a certain position for easy-entry functionality.
      data request: type=t_EasyEntry
    ReqManAdjust  # Request to move the axis of the seat manually to a certain direction.
      data request: type=t_MovementType
    ReqMassageAdjust  # Request to activate different massage programs. One or more different programs at the same time are possible.
      data request: type=t_SeatMassageProgram
    StaMassageAdjust  # Feedback of the seat manager indicating which kind of massage program is currently running. This information may be used by a seat's massage control panel to switch status LEDs
      data status: type=t_SeatMassageProgram
    CmdStorePosition  # Request to store the position of a certain seat and a certain axis to the memory-position &quot;profile&quot;. This interface is mainly provided for centralized storage of memory positions (NV-RAM Manager supports only local NV-RAM)
      data command: type=t_SeatStoragePosition
    ReqAutoMove  # Request to move the seat automatically in a certain position. This position could be determined by a user request from the seat panel, an access from the remote key, a keyless access, driver-easy-entry request or if reverse gear was detected, to move the head-rest in the &quot;down position&quot;. If it is clear, that the driver is outside the car (e.g. easy entry) it may be necessary to move the seat very fast. In this case 'highspeed' indicates this situation
      data request: type=t_SeatMove
    ReqStorePosition  # Request to store the position of a certain seat and a certain axis to the memory-position &quot;profile&quot;.
      data request: type=t_SeatStoragePosition
    StaStorePosition  # Request to recall the position of a certain seat and a certain axis to the memory-position &quot;profile&quot;.
      data status: type=t_SeatStoragePosition
    ReqMove  # Request to move the axis of the mentioned seat to the mentioned position. In case of manually adjustment there would appear 0% or 100%.
      data request: type=t_SeatMove
    CmdMove  # Command to move the axis of the seat manually to a certain direction.
      data command: type=t_MovementType
    StaAxisPos  # Status of the current position of an axis.
      data status: type=t_ActuatorStatus
    ReqCentralLocking  # Request to activate CL master including (extended) source information
      data request: type=t_ReqInfosCentralLocking
    CmdWashing  # Provides information to activate the washing of windows (front or rear) or headlamps. As long as the information is provided the actuator should be on. The actual command to activate the washing.
      data command: type=t_onoff
    CmdWindowWiping  # Provides information to activate the front wiper. As long as the infor-mation is provided the actuator should be on.
      data command: type=t_wiping
    CmdWiperPos  # Provides information to run in a pre defined position. As long as the information is provided the actuator should run/ stay in this position. If there is a valid CmdWindowWiper this supersedes commands given via this interface.
      data requested_position: type=t_wiper_pos_req
    CmdNozzleHeater  # Command to turn on or off the heating element within a washer nozzle
      data command: type=t_onoff
    CountryCode  # This interface is used to provide all software components with the cur-rent country coding in the car. For example, depending on the country coding it is decided which light is switched on if the engine is running.
      data parameter: type=t_country_code
    DateTimeStamp  # Represents the current date and the current time. Supposed to be transmitted cyclically with a cycle time of one second.
      data stamp: type=t_date_time
    ErrRainsensing  # Provides information if there is a rain-sensor failure detected (e. g. broken or no adaptation to windscreen possible)
      data status: type=t_failure
    ReqActivateAutoWiping  # Represents users demand to activate/ deactivate automatic front wiping. Supersedes off and interval modes of normal ReqWiping interface. As long as automatic front wiping is requested, the value is on.
      data request: type=t_onoff
    ReqAutoWiping  # Requests by the rain sensor the wiping with different interval time and speed. During interval wiping the wiper speed is the lowest possible speed (e.g. speed1). As long as automatic front wiping is requested the provided value of interval time or speed has to be used.
      data request: type=t_auto_front_wiping_request
    ReqDisableWiperWasher  # Request to the wiper washer manager, to suppress wash or wipe actions.
      data request: type=t_onoff
    ReqIntervalWipingSpeed  # Requests the interval speed. As long as a interval wipe sequence is requested the provided value of interval speed has to be used.
      data request: type=t_interval_wiping_speed
    ReqRainSensing  # Request switching on off rainsensing. After the request the value should be kept as long no other request is sent.
      data request: type=t_onoff
    ReqRainSensingSensitivity  # Requests the front wiper rainsensing sensitivity. Values are typically provided by MMI. As long as a sensitivity for automatic wipe sequence is requested the provided value of sensitivity has to be used.
      data value: type=t_rainsensing_sensitivity
    ReqWashing  # Carries a user request to activate the washing of windows (front or rear) or headlamps. As long as the information is provided the actuator should be on. The actual command to activate the washing.
      data request: type=t_onoff
    ReqWiping  # User request for wiping to switch on one strike, interval, low speed or high speed wiping. As long as a wipe sequence is requested, the corresponding value in the table below should be set.
      data request: type=t_wiping_user_request
    StaConvertibleRoof  # Status of the convertible roof [open or closed]
      data status: type=Boolean
    StaEngineHood  # Provides information whether the engine hood is open or closed. As long as the status is valid the corresponding value should be provided.
      data status: type=t_openclosed
    StaNozzleHeater  # Status of the heating element of a nozzle
      data failure: type=t_failure
      data status: type=t_onoff
    StaRainAmount  # Non normative interface. For illustration purposes only.
      data element: type=Boolean
    StaSlidingRoof  # Status of the sliding roof
      data status: type=Boolean
    StaWasher  # Provides the status and failure state information typically sent by a washer.
      data failure: type=t_failure  # Used as feedback from an actuator component to indicate that the front washer is broken. Note that no details of the fault are transmitted, but just an operational / defective fault indication.
      data status: type=t_onoff  # Provides information whether the front washer is on or off. As long as the status is valid the corresponding value should be provided.
    StaWasherFluid  # provides information if the low limit of washer fluid is reached. (enough=above threshold; low_level=below threshold) As long as the water level is under the low limit the status is on.
      data element: type=t_low_level_washer_fluid
    StaWiper  # During a wipe cycle (i.e. as long as status is &quot;on&quot;), the wiper position is moving. Thus, the following condition shall hold: Iff status == on then position == intermediate_position
      4 x data:
        active: type=t_onoff  # Provides information whether the wiper is currently running. (This is different to the status data-element, as the status may report an active interval-wiping - with that, it can not be determined, if the wiper is currently running.) As long as the status is valid the corresponding value should be provided.
        failure: type=t_failure  # Used as feedback from an actuator component to indicate that the front wiper is broken. Note that no details of the fault are transmitted, but just an operational / defective fault indication. Note:This data-element shall not be used for detailed diagnostics
        position: type=t_wiper_pos_meas  # Provides information in which position the wiper is in. As long as the status is valid the corresponding value should be provided.
        status: type=t_wiping  # Provides information what effective mode the front wiping system is currently in (e.g. despite CmdWiping requests speed8 the actuator is effectively in mode off due to overload). As long as the status is valid the corresponding valueshould be provided.
    GearshiftPreventionComfortRequestedbyACC  # avoid change of gear for comfort reasons requested by ACC to be arbitrated by VLC
      data GearshiftPreventionComfortRequestedbyACC: type=GearShiftPrevention
    BrakePreventionComfortRequestbyACC  # Request to avoid braking due to comfort aspects of ACC. Request includes aspects from traffic point of view. Final decision remains in the actuator control. Acceleration Request Tolerance Band has higher priority than the Inhibit Flag. 0: No request 1: Inhibit brake
      data BrakePrevention: type=Boolean
    StaMirrorOutsideBrightness  # This is the outside brightness value for front and rear brightness used by the Mirror Tinting component
      data valuefront: type=t_StaOutSideBrightness  # front brightness value
      data valuerear: type=t_StaOutSideBrightness  # Rear brightness value
    DispRainSens  # Informs driver, if rain sensor is currently active.
      data DispRainSens: type=t_onoff
package /AUTOSAR/ComponentTypes
  83 x composition type:
    TOPLEVEL
      5 x component:
        Body: type=Body
        Powertrain: type=Powertrain
        Chassis: type=Chassis
        OPSafety: type=OPSafety
        MM_T_HMI: type=MM_T_HMI
      connect MM_T_HMI.EmergencyLocking -> Body.EmergencyLocking
      connect MM_T_HMI.RearLidHMIInt -> Body.RearLidHMIInt
      connect MM_T_HMI.RearLidHMIExt -> Body.RearLidHMIExt
      connect MM_T_HMI.BackliteWindowHMI -> Body.BackliteWindowHMI
      connect MM_T_HMI.TankFlapHMI -> Body.TankFlapHMI
      connect MM_T_HMI.GloveBoxHMI -> Body.GloveBoxHMI
      connect OPSafety.Crash -> Body.Crash
      connect OPSafety.Crash -> Powertrain.Crash
      connect Body.Voltage -> Powertrain.Voltage
      connect Body.Voltage -> Chassis.Voltage
      connect Body.StaHotelMode -> MM_T_HMI.StaHotelMode
      connect Powertrain.ActualGear -> Body.ActualGear
      connect Powertrain.ActualGear -> Chassis.ActualGear
      connect MM_T_HMI.AutoTintRequest -> Body.AutoTintRequest
      connect Body.AutoTintStatus -> MM_T_HMI.AutoTintStatus
      connect MM_T_HMI.AutoAdjustPanel -> Body.AutoAdjustPanel
      connect MM_T_HMI.Entry -> Body.Entry
      connect MM_T_HMI.ManAdjustPanel -> Body.ManAdjustPanel
      connect MM_T_HMI.MassageAdjust -> Body.MassageAdjust
      connect Body.MassageStatus -> MM_T_HMI.MassageStatus
      connect Body.DriverDoorState -> Chassis.DriverDoorState
      connect Body.PassengerDoorState -> Chassis.PassengerDoorState
      connect Body.RearLeftDoorState -> Chassis.RearLeftDoorState
      connect Body.RearRightDoorState -> Chassis.RearRightDoorState
      connect Body.RearLidState -> Chassis.RearLidState
      connect Body.BackliteWindowState -> Chassis.BackliteWindowState
      connect Chassis.BrakeLightsOnRequestFromChassis -> Body.BrakeLightsOnRequestFromChassis
      connect MM_T_HMI.MirrorManualMovementHMI -> Body.MirrorManualMovementHMI
      connect MM_T_HMI.MirrorAutoAdjStorePr0HMI -> Body.MirrorAutoAdjStorePr0HMI
      connect MM_T_HMI.MirrorAutoAdjReStorePr0HMI -> Body.MirrorAutoAdjReStorePr0HMI
      connect MM_T_HMI.MirrorAutoAdjStorePr1HMI -> Body.MirrorAutoAdjStorePr1HMI
      connect MM_T_HMI.MirrorAutoAdjReStorePr1HMI -> Body.MirrorAutoAdjReStorePr1HMI
      connect MM_T_HMI.MirrorAutoAdjStorePr2HMI -> Body.MirrorAutoAdjStorePr2HMI
      connect MM_T_HMI.MirrorAutoAdjReStorePr2HMI -> Body.MirrorAutoAdjReStorePr2HMI
      connect MM_T_HMI.MirrorAutoAdjStorePr3HMI -> Body.MirrorAutoAdjStorePr3HMI
      connect MM_T_HMI.MirrorAutoAdjReStorePr3HMI -> Body.MirrorAutoAdjReStorePr3HMI
      connect MM_T_HMI.DashBoardBrightness -> Body.DashBoardBrightness
      connect MM_T_HMI.NightPanelActive -> Body.NightPanelActive
      connect MM_T_HMI.HMIActivateAutoWiping -> Body.HMIActivateAutoWiping
      connect MM_T_HMI.HMIFrontWashing -> Body.HMIFrontWashing
      connect MM_T_HMI.HMIFrontWiping -> Body.HMIFrontWiping
      connect MM_T_HMI.HMIHeadLampWashing -> Body.HMIHeadLampWashing
      connect MM_T_HMI.HMIIntervalWipingSpeed -> Body.HMIIntervalWipingSpeed
      connect MM_T_HMI.HMIRearWashing -> Body.HMIRearWashing
      connect MM_T_HMI.HMIRearWiping -> Body.HMIRearWiping
      connect MM_T_HMI.HMIWiperPosRequest -> Body.HMIWiperPosRequest
      connect Chassis.BrakePedalPressed -> Body.BrakePedalPressed
      connect Chassis.BrakePedalPressed -> Powertrain.BrakePedalPressed
      connect MM_T_HMI.CabinLightFnCeIntLightHMI -> Body.CabinLightFnCeIntLightHMI
      connect MM_T_HMI.HazardWarningSwitchIlluminationIntLightHMI -> Body.HazardWarningSwitchIlluminationIntLightHMI
      connect Chassis.BrakeLightsIntensity -> Body.BrakeLightsIntensity
      connect Chassis.VehicleLongitudinalSpeed -> Body.VehicleLongitudinalSpeed
      connect Chassis.VehicleLongitudinalSpeed -> Powertrain.VehicleLongitudinalSpeed
      connect Powertrain.AcceleratorPedalRatio -> Chassis.AcceleratorPedalRatio
      connect Powertrain.GearboxCountershaftActive -> Chassis.GearboxCountershaftActive
      connect Powertrain.EngineSpeed -> Chassis.EngineSpeed
      connect Chassis.MinimumTotalPowertrainTorqueAtWheelsRequestedByStabilityControlSlow -> Powertrain.MinimumTotalPowertrainTorqueAtWheelsRequestedByStabilityControlSlow
      connect Chassis.MinimumTotalPowertrainTorqueAtWheelsRequestedByStabilityControlFast -> Powertrain.MinimumTotalPowertrainTorqueAtWheelsRequestedByStabilityControlFast
      connect Chassis.MinimumTotalPowertrainTorqueAtWheelsRequestedByVehicleLongitudinalControl -> Powertrain.MinimumTotalPowertrainTorqueAtWheelsRequestedByVehicleLongitudinalControl
      connect Chassis.MaximumTotalPowertrainTorqueAtWheelsRequestedByStabilityControlSlow -> Powertrain.MaximumTotalPowertrainTorqueAtWheelsRequestedByStabilityControlSlow
      connect Chassis.MaximumTotalPowertrainTorqueAtWheelsRequestedByStabilityControlFast -> Powertrain.MaximumTotalPowertrainTorqueAtWheelsRequestedByStabilityControlFast
      connect Chassis.MaximumTotalPowertrainTorqueAtWheelsRequestedByVehicleLongitudinalControl -> Powertrain.MaximumTotalPowertrainTorqueAtWheelsRequestedByVehicleLongitudinalControl
      connect Chassis.ActualPowerSteeringLoad -> Powertrain.ActualPowerSteeringLoad
      connect Powertrain.TargetGear -> Chassis.TargetGear
      connect Chassis.GearshiftPreventionComfortbyVLC -> Powertrain.GearshiftPreventionComfortbyVLC
      connect Chassis.RequestedPowerSteeringLoad -> Powertrain.RequestedPowerSteeringLoad
      connect Powertrain.MaximumAvailableTotalPowertrainTorqueAtWheels -> Chassis.MaximumAvailableTotalPowertrainTorqueAtWheels
      connect Powertrain.MinimumAvailableTotalPowertrainTorqueAtWheels -> Chassis.MinimumAvailableTotalPowertrainTorqueAtWheels
      connect Powertrain.DriverRequestOverridesVLCrequest -> Chassis.DriverRequestOverridesVLCrequest
      connect Powertrain.ActualPowertrainTorqueAtWheels4 -> Chassis.ActualPowertrainTorqueAtWheels4
      connect Powertrain.ActualTotalPowertrainTorqueAtWheels -> Chassis.ActualTotalPowertrainTorqueAtWheels
      connect Powertrain.RequestedTotalPowertrainTorqueAtWheelsForLongitudinalControl -> Chassis.RequestedTotalPowertrainTorqueAtWheelsForLongitudinalControl
      connect Chassis.ABSControlActive -> Powertrain.ABSControlActive
      connect Powertrain.AcceleratorPedalGradient -> Chassis.AcceleratorPedalGradient
      connect Powertrain.DriveTrainOpen -> Chassis.DriveTrainOpen
      connect Powertrain.EngineSpeedGradient -> Chassis.EngineSpeedGradient
      connect Chassis.GearShiftPreventionStability -> Powertrain.GearShiftPreventionStability
      connect Powertrain.ShiftInProgress -> Chassis.ShiftInProgress
      connect Chassis.BrakePedalValue -> Powertrain.BrakePedalValue
      connect Chassis.MaxVehicleSpeedBrakeActuator -> Powertrain.MaxVehicleSpeedBrakeActuator
      connect Chassis.PGearRequest -> Powertrain.PGearRequest
      connect Chassis.ActiveDamperStatus -> MM_T_HMI.ActiveDamperStatus
      connect Chassis.ActiveStabilizerStatus -> MM_T_HMI.ActiveStabilizerStatus
      connect Chassis.ActualBodyLevelMode -> MM_T_HMI.ActualBodyLevelMode
      connect Chassis.BodyLevelActuatorStatus -> MM_T_HMI.BodyLevelActuatorStatus
      connect Chassis.BodyLevelControl -> MM_T_HMI.BodyLevelControl
      connect OPSafety.DriverPresenceFlag -> Chassis.DriverPresenceFlag
      connect Chassis.ErrorStatusSteeringBSTS -> MM_T_HMI.ErrorStatusSteeringBSTS
      connect Chassis.ErrorStatusSteeringBSAS -> MM_T_HMI.ErrorStatusSteeringBSAS
      connect Chassis.ErrorStatusSteeringBRWS -> MM_T_HMI.ErrorStatusSteeringBRWS
      connect Chassis.FullActiveSuspensionStatus -> MM_T_HMI.FullActiveSuspensionStatus
      connect Chassis.SwitchableSpringStatus -> MM_T_HMI.SwitchableSpringStatus
      connect Chassis.WheelCircumSpeedsStandard -> Powertrain.WheelCircumSpeedsStandard
      connect Body.DispRainSensActive -> MM_T_HMI.DispRainSensActive
    Body
      11 x provide port:
        Voltage: provided-interface=BatteryVoltage
        StaHotelMode: provided-interface=StaHotelMode
        AutoTintStatus: provided-interface=StaAutoTinting
        MassageStatus: provided-interface=StaMassageAdjust
        DriverDoorState: provided-interface=StaDoor
        PassengerDoorState: provided-interface=StaDoor
        RearLeftDoorState: provided-interface=StaDoor
        RearRightDoorState: provided-interface=StaDoor
        RearLidState: provided-interface=StaDoor
        BackliteWindowState: provided-interface=StaDoor
        DispRainSensActive: provided-interface=DispRainSens
      38 x require port:
        EmergencyLocking: required-interface=ReqLockUnlock
        RearLidHMIInt: required-interface=ReqReleaseLatch
        RearLidHMIExt: required-interface=ReqReleaseLatch
        BackliteWindowHMI: required-interface=ReqReleaseLatch
        TankFlapHMI: required-interface=ReqReleaseLatch
        GloveBoxHMI: required-interface=ReqToggle
        Crash: required-interface=StaCrash
        ActualGear: required-interface=ActualGear
        AutoTintRequest: required-interface=ReqAutoTinting
        AutoAdjustPanel: required-interface=ReqAutoAdjust
        Entry: required-interface=ReqEntry
        ManAdjustPanel: required-interface=ReqManAdjust
        MassageAdjust: required-interface=ReqMassageAdjust
        BrakeLightsOnRequestFromChassis: required-interface=BrakeLightsOnRequest
        MirrorManualMovementHMI: required-interface=ReqManAdjustPanel
        MirrorAutoAdjStorePr0HMI: required-interface=ReqAutoAdjustPanelMirror
        MirrorAutoAdjReStorePr0HMI: required-interface=ReqAutoAdjustPanelMirror
        MirrorAutoAdjStorePr1HMI: required-interface=ReqAutoAdjustPanelMirror
        MirrorAutoAdjReStorePr1HMI: required-interface=ReqAutoAdjustPanelMirror
        MirrorAutoAdjStorePr2HMI: required-interface=ReqAutoAdjustPanelMirror
        MirrorAutoAdjReStorePr2HMI: required-interface=ReqAutoAdjustPanelMirror
        MirrorAutoAdjStorePr3HMI: required-interface=ReqAutoAdjustPanelMirror
        MirrorAutoAdjReStorePr3HMI: required-interface=ReqAutoAdjustPanelMirror
        DashBoardBrightness: required-interface=ReqBrightness
        NightPanelActive: required-interface=ReqNightPanel
        HMIActivateAutoWiping: required-interface=ReqActivateAutoWiping
        HMIFrontWashing: required-interface=ReqWashing
        HMIFrontWiping: required-interface=ReqWiping
        HMIHeadLampWashing: required-interface=ReqWashing
        HMIIntervalWipingSpeed: required-interface=ReqIntervalWipingSpeed
        HMIRearWashing: required-interface=ReqWashing
        HMIRearWiping: required-interface=ReqWiping
        HMIWiperPosRequest: required-interface=CmdWiperPos
        BrakePedalPressed: required-interface=BrakePedalPressed
        CabinLightFnCeIntLightHMI: required-interface=ReqIntLight
        HazardWarningSwitchIlluminationIntLightHMI: required-interface=ReqIntLight
        BrakeLightsIntensity: required-interface=BrakeLightsIntensity
        VehicleLongitudinalSpeed: required-interface=VehicleLongitudinalSpeed
      14 x component:
        CentralLocking: type=CentralLocking
        InteriorLight: type=InteriorLight
        MirrorAdjustment: type=MirrorAdjustment
        MirrorTinting: type=MirrorTinting
        SeatAdjustment: type=SeatAdjustment
        WiperWasher: type=WiperWasher
        RemoteKey: type=RemoteKey
        KeylessAccess: type=KeylessAccess
        KeyPad: type=KeyPad
        AntiTheftSystem: type=AntiTheftSystem
        ExteriorLight: type=ExteriorLight
        WindowControl: type=WindowControl
        ClampControl: type=ClampControl
        BatteryMonitor: type=BatteryMonitor
      connect BatteryMonitor.Voltage -> CentralLocking.Voltage
      connect BatteryMonitor.Voltage -> InteriorLight.Voltage
      connect BatteryMonitor.Voltage -> MirrorAdjustment.Voltage
      connect BatteryMonitor.Voltage -> MirrorTinting.Voltage
      connect BatteryMonitor.Voltage -> SeatAdjustment.Voltage
      connect BatteryMonitor.Voltage -> WiperWasher.Voltage
      connect CentralLocking.CentralLocking -> InteriorLight.CentralLocking
      connect CentralLocking.CentralLocking -> MirrorAdjustment.CentralLocking
      connect CentralLocking.CentralLocking -> SeatAdjustment.CentralLocking
      connect CentralLocking.LockingFeedback -> ExteriorLight.LockingFeedback
      connect ExteriorLight.GlobalDimLight -> InteriorLight.GlobalDimLight
      connect ExteriorLight.LowBeamInd -> InteriorLight.LowBeamInd
      connect ExteriorLight.CHLHome -> InteriorLight.CHLHome
      connect RemoteKey.CarFinder -> InteriorLight.CarFinder
      connect AntiTheftSystem.VisualAlarm -> InteriorLight.VisualAlarm
      connect MirrorAdjustment.MirrorPosition -> MirrorTinting.MirrorPosition
      connect MirrorAdjustment.MirrorMoveStatus -> MirrorTinting.MirrorMoveStatus
      connect ExteriorLight.OutsideBrightness -> InteriorLight.OutsideBrightness
      connect ExteriorLight.OutsideBrightness -> MirrorTinting.OutsideBrightness
      connect ExteriorLight.OutsideBrightness -> WiperWasher.OutsideBrightness
      connect CentralLocking.DriverDoorState -> InteriorLight.DriverDoorState
      connect CentralLocking.DriverDoorState -> SeatAdjustment.DriverDoorState
      connect CentralLocking.DriverDoorState -> WiperWasher.DriverDoorState
      connect CentralLocking.PassengerDoorState -> InteriorLight.PassengerDoorState
      connect CentralLocking.PassengerDoorState -> SeatAdjustment.PassengerDoorState
      connect CentralLocking.PassengerDoorState -> WiperWasher.PassengerDoorState
      connect CentralLocking.RearLeftDoorState -> InteriorLight.RearLeftDoorState
      connect CentralLocking.RearRightDoorState -> InteriorLight.RearRightDoorState
      connect CentralLocking.RearLidState -> InteriorLight.RearLidState
      connect CentralLocking.RearLidState -> WiperWasher.RearLidState
      connect CentralLocking.BackliteWindowState -> InteriorLight.BackliteWindowState
      connect CentralLocking.BackliteWindowState -> WiperWasher.BackliteWindowState
      connect CentralLocking.ComfortOpenClose -> WindowControl.ComfortOpenClose
      connect KeylessAccess.BrakeLightsOnRequestFromKeyless -> ExteriorLight.BrakeLightsOnRequestFromKeyless
      connect KeyPad.AccessRemoteRearLid -> CentralLocking.AccessRemoteRearLid
      connect KeyPad.DriverDoorKeypadDoor -> CentralLocking.DriverDoorKeypadDoor
      connect KeyPad.PassengerDoorKeypadDoor -> CentralLocking.PassengerDoorKeypadDoor
      connect KeyPad.RearLeftKeypadDoor -> CentralLocking.RearLeftKeypadDoor
      connect KeyPad.RearRightKeypadDoor -> CentralLocking.RearRightKeypadDoor
      connect KeyPad.RearLidKeypadDoor -> CentralLocking.RearLidKeypadDoor
      connect KeyPad.DriverDoorKeypadRearLid -> CentralLocking.DriverDoorKeypadRearLid
      connect KeyPad.PassengerDoorKeypadRearLid -> CentralLocking.PassengerDoorKeypadRearLid
      connect KeyPad.RearLeftDoorKeypadRearLid -> CentralLocking.RearLeftDoorKeypadRearLid
      connect KeyPad.RearRightDoorKeypadRearLid -> CentralLocking.RearRightDoorKeypadRearLid
      connect KeyPad.RearLidKeypadRearLid -> CentralLocking.RearLidKeypadRearLid
      connect ExteriorLight.DisplayParkingLights -> InteriorLight.DisplayParkingLights
      connect ExteriorLight.DisplayParkingLights -> WiperWasher.DisplayParkingLights
      connect KeylessAccess.AccessKeyless -> CentralLocking.AccessKeyless
      connect KeylessAccess.AccessKeyless -> InteriorLight.AccessKeyless
      connect KeylessAccess.AccessKeyless -> MirrorAdjustment.AccessKeyless
      connect RemoteKey.AccessRemoteKey -> CentralLocking.AccessRemoteKey
      connect RemoteKey.AccessRemoteKey -> InteriorLight.AccessRemoteKey
      connect RemoteKey.AccessRemoteKey -> MirrorAdjustment.AccessRemoteKey
      connect CentralLocking.DriverDoorMechKey -> InteriorLight.DriverDoorMechKey
      connect CentralLocking.PassengerDoorMechKey -> InteriorLight.PassengerDoorMechKey
      connect CentralLocking.RearLeftDoorMechKey -> InteriorLight.RearLeftDoorMechKey
      connect CentralLocking.RearRightDoorMechKey -> InteriorLight.RearRightDoorMechKey
      connect CentralLocking.RearLidMechKey -> InteriorLight.RearLidMechKey
      delegate CentralLocking.EmergencyLocking <-> outer port Body/EmergencyLocking
      delegate CentralLocking.RearLidHMIInt <-> outer port Body/RearLidHMIInt
      delegate CentralLocking.RearLidHMIExt <-> outer port Body/RearLidHMIExt
      delegate CentralLocking.BackliteWindowHMI <-> outer port Body/BackliteWindowHMI
      delegate CentralLocking.TankFlapHMI <-> outer port Body/TankFlapHMI
      delegate CentralLocking.GloveBoxHMI <-> outer port Body/GloveBoxHMI
      delegate CentralLocking.Crash <-> outer port Body/Crash
      delegate InteriorLight.Crash <-> outer port Body/Crash
      delegate BatteryMonitor.Voltage <-> outer port Body/Voltage
      delegate CentralLocking.StaHotelMode <-> outer port Body/StaHotelMode
      delegate MirrorAdjustment.ActualGear <-> outer port Body/ActualGear
      delegate SeatAdjustment.ActualGear <-> outer port Body/ActualGear
      delegate WiperWasher.ActualGear <-> outer port Body/ActualGear
      delegate MirrorTinting.AutoTintRequest <-> outer port Body/AutoTintRequest
      delegate MirrorTinting.AutoTintStatus <-> outer port Body/AutoTintStatus
      delegate SeatAdjustment.AutoAdjustPanel <-> outer port Body/AutoAdjustPanel
      delegate SeatAdjustment.Entry <-> outer port Body/Entry
      delegate SeatAdjustment.ManAdjustPanel <-> outer port Body/ManAdjustPanel
      delegate SeatAdjustment.MassageAdjust <-> outer port Body/MassageAdjust
      delegate SeatAdjustment.MassageStatus <-> outer port Body/MassageStatus
      delegate CentralLocking.DriverDoorState <-> outer port Body/DriverDoorState
      delegate CentralLocking.PassengerDoorState <-> outer port Body/PassengerDoorState
      delegate CentralLocking.RearLeftDoorState <-> outer port Body/RearLeftDoorState
      delegate CentralLocking.RearRightDoorState <-> outer port Body/RearRightDoorState
      delegate CentralLocking.RearLidState <-> outer port Body/RearLidState
      delegate CentralLocking.BackliteWindowState <-> outer port Body/BackliteWindowState
      delegate ExteriorLight.BrakeLightsOnRequestFromChassis <-> outer port Body/BrakeLightsOnRequestFromChassis
      delegate MirrorAdjustment.MirrorManualMovementHMI <-> outer port Body/MirrorManualMovementHMI
      delegate MirrorAdjustment.MirrorAutoAdjStorePr0HMI <-> outer port Body/MirrorAutoAdjStorePr0HMI
      delegate MirrorAdjustment.MirrorAutoAdjReStorePr0HMI <-> outer port Body/MirrorAutoAdjReStorePr0HMI
      delegate MirrorAdjustment.MirrorAutoAdjStorePr1HMI <-> outer port Body/MirrorAutoAdjStorePr1HMI
      delegate MirrorAdjustment.MirrorAutoAdjReStorePr1HMI <-> outer port Body/MirrorAutoAdjReStorePr1HMI
      delegate MirrorAdjustment.MirrorAutoAdjStorePr2HMI <-> outer port Body/MirrorAutoAdjStorePr2HMI
      delegate MirrorAdjustment.MirrorAutoAdjReStorePr2HMI <-> outer port Body/MirrorAutoAdjReStorePr2HMI
      delegate MirrorAdjustment.MirrorAutoAdjStorePr3HMI <-> outer port Body/MirrorAutoAdjStorePr3HMI
      delegate MirrorAdjustment.MirrorAutoAdjReStorePr3HMI <-> outer port Body/MirrorAutoAdjReStorePr3HMI
      delegate InteriorLight.DashBoardBrightness <-> outer port Body/DashBoardBrightness
      delegate InteriorLight.NightPanelActive <-> outer port Body/NightPanelActive
      delegate WiperWasher.HMIActivateAutoWiping <-> outer port Body/HMIActivateAutoWiping
      delegate WiperWasher.HMIFrontWashing <-> outer port Body/HMIFrontWashing
      delegate WiperWasher.HMIFrontWiping <-> outer port Body/HMIFrontWiping
      delegate WiperWasher.HMIHeadLampWashing <-> outer port Body/HMIHeadLampWashing
      delegate WiperWasher.HMIIntervalWipingSpeed <-> outer port Body/HMIIntervalWipingSpeed
      delegate WiperWasher.HMIRearWashing <-> outer port Body/HMIRearWashing
      delegate WiperWasher.HMIRearWiping <-> outer port Body/HMIRearWiping
      delegate WiperWasher.HMIWiperPosRequest <-> outer port Body/HMIWiperPosRequest
      delegate InteriorLight.CabinLightFnCeIntLightHMI <-> outer port Body/CabinLightFnCeIntLightHMI
      delegate InteriorLight.HazardWarningSwitchIlluminationIntLightHMI <-> outer port Body/HazardWarningSwitchIlluminationIntLightHMI
      delegate ExteriorLight.BrakeLightsIntensity <-> outer port Body/BrakeLightsIntensity
      delegate CentralLocking.VehicleLongitudinalSpeed <-> outer port Body/VehicleLongitudinalSpeed
      delegate InteriorLight.VehicleLongitudinalSpeed <-> outer port Body/VehicleLongitudinalSpeed
      delegate MirrorAdjustment.VehicleLongitudinalSpeed <-> outer port Body/VehicleLongitudinalSpeed
      delegate SeatAdjustment.VehicleLongitudinalSpeed <-> outer port Body/VehicleLongitudinalSpeed
      delegate WiperWasher.VehicleLongitudinalSpeed <-> outer port Body/VehicleLongitudinalSpeed
      delegate WiperWasher.DispRainSensActive <-> outer port Body/DispRainSensActive
    RemoteKey
      provide port CarFinder: provided-interface=ReqCarFinder
      provide port AccessRemoteKey: provided-interface=ReqCentralLocking
    KeylessAccess
      provide port BrakeLightsOnRequestFromKeyless: provided-interface=BrakeLightsOnRequest
      provide port AccessKeyless: provided-interface=ReqCentralLocking
    KeyPad
      11 x provide port, all with provided-interface=ReqCentralLocking:
        AccessRemoteRearLid
        DriverDoorKeypadDoor
        PassengerDoorKeypadDoor
        RearLeftKeypadDoor
        RearRightKeypadDoor
        RearLidKeypadDoor
        DriverDoorKeypadRearLid
        PassengerDoorKeypadRearLid
        RearLeftDoorKeypadRearLid
        RearRightDoorKeypadRearLid
        RearLidKeypadRearLid
    AntiTheftSystem
      provide port VisualAlarm: provided-interface=ReqVisualAlarm
    ClampControl
    BatteryMonitor
      provide port Voltage: provided-interface=BatteryVoltage
    CentralLocking
      15 x provide port:
        DriverDoorState: provided-interface=StaDoor
        PassengerDoorState: provided-interface=StaDoor
        RearLeftDoorState: provided-interface=StaDoor
        RearRightDoorState: provided-interface=StaDoor
        RearLidState: provided-interface=StaDoor
        BackliteWindowState: provided-interface=StaDoor
        DriverDoorMechKey: provided-interface=ReqCentralLocking
        PassengerDoorMechKey: provided-interface=ReqCentralLocking
        RearLeftDoorMechKey: provided-interface=ReqCentralLocking
        RearRightDoorMechKey: provided-interface=ReqCentralLocking
        RearLidMechKey: provided-interface=ReqCentralLocking
        ComfortOpenClose: provided-interface=ReqCentralLocking
        CentralLocking: provided-interface=StaCentralLocking
        LockingFeedback: provided-interface=ReqLockingFeedback
        StaHotelMode: provided-interface=StaHotelMode
      22 x require port:
        EmergencyLocking: required-interface=ReqLockUnlock
        RearLidHMIInt: required-interface=ReqReleaseLatch
        RearLidHMIExt: required-interface=ReqReleaseLatch
        BackliteWindowHMI: required-interface=ReqReleaseLatch
        TankFlapHMI: required-interface=ReqReleaseLatch
        GloveBoxHMI: required-interface=ReqToggle
        AccessKeyless: required-interface=ReqCentralLocking
        AccessRemoteKey: required-interface=ReqCentralLocking
        AccessRemoteRearLid: required-interface=ReqCentralLocking
        VehicleLongitudinalSpeed: required-interface=VehicleLongitudinalSpeed
        Crash: required-interface=StaCrash
        Voltage: required-interface=BatteryVoltage
        DriverDoorKeypadDoor: required-interface=ReqCentralLocking
        PassengerDoorKeypadDoor: required-interface=ReqCentralLocking
        RearLeftKeypadDoor: required-interface=ReqCentralLocking
        RearRightKeypadDoor: required-interface=ReqCentralLocking
        RearLidKeypadDoor: required-interface=ReqCentralLocking
        DriverDoorKeypadRearLid: required-interface=ReqCentralLocking
        PassengerDoorKeypadRearLid: required-interface=ReqCentralLocking
        RearLeftDoorKeypadRearLid: required-interface=ReqCentralLocking
        RearRightDoorKeypadRearLid: required-interface=ReqCentralLocking
        RearLidKeypadRearLid: required-interface=ReqCentralLocking
      9 x component:
        CentralLockingMaster: type=CentralLockingMaster
        DriverDoorLock: type=DriverDoorLock
        PassengerDoorLock: type=PassengerDoorLock
        RearLeftDoorLock: type=RearLeftDoorLock
        RearRightDoorLock: type=RearRightDoorLock
        RearLidDoorLock: type=RearLidDoorLock
        BackliteWindowDoorLock: type=BackliteWindowDoorLock
        GloveBox: type=GloveBox
        TankFlap: type=TankFlap
      connect DriverDoorLock.DriverDoorState -> CentralLockingMaster.DriverDoorState
      connect PassengerDoorLock.PassengerDoorState -> CentralLockingMaster.PassengerDoorState
      connect RearLeftDoorLock.RearLeftDoorState -> CentralLockingMaster.RearLeftDoorState
      connect RearRightDoorLock.RearRightDoorState -> CentralLockingMaster.RearRightDoorState
      connect RearLidDoorLock.RearLidState -> CentralLockingMaster.RearLidState
      connect BackliteWindowDoorLock.BackliteWindowState -> CentralLockingMaster.BackliteWindowState
      connect DriverDoorLock.DriverDoorMechKey -> CentralLockingMaster.DriverDoorMechKey
      connect PassengerDoorLock.PassengerDoorMechKey -> CentralLockingMaster.PassengerDoorMechKey
      connect RearLeftDoorLock.RearLeftDoorMechKey -> CentralLockingMaster.RearLeftDoorMechKey
      connect RearRightDoorLock.RearRightDoorMechKey -> CentralLockingMaster.RearRightDoorMechKey
      connect RearLidDoorLock.RearLidMechKey -> CentralLockingMaster.RearLidMechKey
      connect CentralLockingMaster.DriverDoorLockingCmd -> DriverDoorLock.DriverDoorLockingCmd
      connect CentralLockingMaster.PassengerDoorLockingCmd -> PassengerDoorLock.PassengerDoorLockingCmd
      connect CentralLockingMaster.RearLeftDoorLockingCmd -> RearLeftDoorLock.RearLeftDoorLockingCmd
      connect CentralLockingMaster.RearRightDoorLockingCmd -> RearRightDoorLock.RearRightDoorLockingCmd
      connect CentralLockingMaster.RearLidLockingCmd -> RearLidDoorLock.RearLidLockingCmd
      connect CentralLockingMaster.BackliteWindowLockingCmd -> BackliteWindowDoorLock.BackliteWindowLockingCmd
      connect DriverDoorLock.DriverDoorLockState -> CentralLockingMaster.DriverDoorLockState
      connect PassengerDoorLock.PassengerDoorLockState -> CentralLockingMaster.PassengerDoorLockState
      connect RearLeftDoorLock.RearLeftDoorLockState -> CentralLockingMaster.RearLeftDoorLockState
      connect RearRightDoorLock.RearRightDoorLockState -> CentralLockingMaster.RearRightDoorLockState
      connect RearLidDoorLock.RearLidLockState -> CentralLockingMaster.RearLidLockState
      connect BackliteWindowDoorLock.BackliteWindowLockState -> CentralLockingMaster.BackliteWindowLockState
      connect CentralLockingMaster.RearLeftDoorChildDoorCmd -> RearLeftDoorLock.RearLeftDoorChildDoorCmd
      connect CentralLockingMaster.RearRightDoorChildDoorCmd -> RearRightDoorLock.RearRightDoorChildDoorCmd
      connect RearLeftDoorLock.RearLeftDoorChildDoorState -> CentralLockingMaster.RearLeftDoorChildDoorState
      connect RearRightDoorLock.RearRightDoorChildDoorState -> CentralLockingMaster.RearRightDoorChildDoorState
      connect CentralLockingMaster.DriverDoorPullAid -> DriverDoorLock.DriverDoorPullAid
      connect CentralLockingMaster.PassengerDoorPullAid -> PassengerDoorLock.PassengerDoorPullAid
      connect CentralLockingMaster.RearLeftDoorPullAid -> RearLeftDoorLock.RearLeftDoorPullAid
      connect CentralLockingMaster.RearRightDoorPullAid -> RearRightDoorLock.RearRightDoorPullAid
      connect CentralLockingMaster.RearLidPullAid -> RearLidDoorLock.RearLidPullAid
      connect CentralLockingMaster.BackliteWindowPullAid -> BackliteWindowDoorLock.BackliteWindowPullAid
      connect CentralLockingMaster.TankFlapLockingCmd -> TankFlap.TankFlapLockingCmd
      connect TankFlap.TankFlapLockingState -> CentralLockingMaster.TankFlapLockingState
      connect GloveBox.GloveboxState -> CentralLockingMaster.GloveboxState
      connect CentralLockingMaster.GloveboxLockingCmd -> GloveBox.GloveboxLockingCmd
      connect GloveBox.GloveboxLockState -> CentralLockingMaster.GloveboxLockState
      delegate CentralLockingMaster.EmergencyLocking <-> outer port CentralLocking/EmergencyLocking
      delegate CentralLockingMaster.RearLidHMIInt <-> outer port CentralLocking/RearLidHMIInt
      delegate CentralLockingMaster.RearLidHMIExt <-> outer port CentralLocking/RearLidHMIExt
      delegate CentralLockingMaster.BackliteWindowHMI <-> outer port CentralLocking/BackliteWindowHMI
      delegate CentralLockingMaster.TankFlapHMI <-> outer port CentralLocking/TankFlapHMI
      delegate CentralLockingMaster.GloveBoxHMI <-> outer port CentralLocking/GloveBoxHMI
      delegate CentralLockingMaster.AccessKeyless <-> outer port CentralLocking/AccessKeyless
      delegate CentralLockingMaster.AccessRemoteKey <-> outer port CentralLocking/AccessRemoteKey
      delegate CentralLockingMaster.AccessRemoteRearLid <-> outer port CentralLocking/AccessRemoteRearLid
      delegate CentralLockingMaster.VehicleLongitudinalSpeed <-> outer port CentralLocking/VehicleLongitudinalSpeed
      delegate CentralLockingMaster.Crash <-> outer port CentralLocking/Crash
      delegate CentralLockingMaster.Voltage <-> outer port CentralLocking/Voltage
      delegate DriverDoorLock.DriverDoorState <-> outer port CentralLocking/DriverDoorState
      delegate PassengerDoorLock.PassengerDoorState <-> outer port CentralLocking/PassengerDoorState
      delegate RearLeftDoorLock.RearLeftDoorState <-> outer port CentralLocking/RearLeftDoorState
      delegate RearRightDoorLock.RearRightDoorState <-> outer port CentralLocking/RearRightDoorState
      delegate RearLidDoorLock.RearLidState <-> outer port CentralLocking/RearLidState
      delegate BackliteWindowDoorLock.BackliteWindowState <-> outer port CentralLocking/BackliteWindowState
      delegate DriverDoorLock.DriverDoorMechKey <-> outer port CentralLocking/DriverDoorMechKey
      delegate PassengerDoorLock.PassengerDoorMechKey <-> outer port CentralLocking/PassengerDoorMechKey
      delegate RearLeftDoorLock.RearLeftDoorMechKey <-> outer port CentralLocking/RearLeftDoorMechKey
      delegate RearRightDoorLock.RearRightDoorMechKey <-> outer port CentralLocking/RearRightDoorMechKey
      delegate RearLidDoorLock.RearLidMechKey <-> outer port CentralLocking/RearLidMechKey
      delegate CentralLockingMaster.DriverDoorKeypadDoor <-> outer port CentralLocking/DriverDoorKeypadDoor
      delegate CentralLockingMaster.PassengerDoorKeypadDoor <-> outer port CentralLocking/PassengerDoorKeypadDoor
      delegate CentralLockingMaster.RearLeftKeypadDoor <-> outer port CentralLocking/RearLeftKeypadDoor
      delegate CentralLockingMaster.RearRightKeypadDoor <-> outer port CentralLocking/RearRightKeypadDoor
      delegate CentralLockingMaster.RearLidKeypadDoor <-> outer port CentralLocking/RearLidKeypadDoor
      delegate CentralLockingMaster.DriverDoorKeypadRearLid <-> outer port CentralLocking/DriverDoorKeypadRearLid
      delegate CentralLockingMaster.PassengerDoorKeypadRearLid <-> outer port CentralLocking/PassengerDoorKeypadRearLid
      delegate CentralLockingMaster.RearLeftDoorKeypadRearLid <-> outer port CentralLocking/RearLeftDoorKeypadRearLid
      delegate CentralLockingMaster.RearRightDoorKeypadRearLid <-> outer port CentralLocking/RearRightDoorKeypadRearLid
      delegate CentralLockingMaster.RearLidKeypadRearLid <-> outer port CentralLocking/RearLidKeypadRearLid
      delegate CentralLockingMaster.ComfortOpenClose <-> outer port CentralLocking/ComfortOpenClose
      delegate CentralLockingMaster.CentralLocking <-> outer port CentralLocking/CentralLocking
      delegate CentralLockingMaster.LockingFeedback <-> outer port CentralLocking/LockingFeedback
      delegate CentralLockingMaster.StaHotelMode <-> outer port CentralLocking/StaHotelMode
